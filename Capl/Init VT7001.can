/*@!Encoding:1252*/
variables
{
 /* Handwheel Torque Simulation Information */
   // msTimer     TrqLoop_tmr;
   
    int         cTrqLoopRate = 1;       /* ms per torque loop */
    float       gTbar_NmpDeg ;
    float       gTrqSensor_VpDeg ;

    int         gTrqRampActive = 0;
    float       gCurrentTrq_Nm = 0.0;
    float       gT1_V;
    float       gT2_V;

    float       gTrqStepSize;
    float       gTrqNumLoops;
    float       gDeltaMagTrq;

    float       gDigTrq1_PWMOutputDC;
    float       gDigTrq2_PWMOutputDC;

   /* Handwheel Position Simulation Information */
   // msTimer     PosLoop_tmr;
    int         cPosLoopRate = 1;       /* ms per torque loop */

    int         gPosRampActive = 0;
    float       gCurrentPos_Deg = 0.0;
    float       gP1_V;
    float       gP2_V;
    float       gP3_V;
    float       gP4_V;

    float       gPosStepSize;
    float       gPosNumLoops;
    float       gDeltaMagPos;

    /* NCS Nominal offset and amplitude constants */
    float       cP12Amp_V = 1.5;
    float       cP12Offset_V = 2.5;
    float       cP34Amp_V = 1.5;
    float       cP34Offset_V = 2.5;
  

   /* Motor Position Simulation Information - Digital */    
    float       gMtr1_V;
    float       gMtr2_V;
    float       gMtr3_V;
    float       gMtr4_V;
    float       gMtr5_V;
    float       gMtr6_V;  // Used for both Tach (when Dig MSB) and Turns Counter (when Analog MSB) 
    float       gMtr7_V;  // Used for both Tach (when Dig MSB) and Turns Counter (when Analog MSB) 
    float       cDigMsbHigh_V = 3.3;
    float       cDigMsbLow_V = 0.0;
    
    float       gMtrVel_DegpSec;  //Motor Velocity in Degrees Per Second (angular velocity)
    float       cTachAmpMult_VpDegpSec = 0.0003;
    float       cTachOffset_V = 2.5;

    
   /* Motor Position Simulation Information - Analog */    
    float       gSina_V;
    float       gCosa_V;
    float       gSinb_V;
    float       gCosb_V;

    /*Turns Counter Simulation Information - Analog*/
    float      gTC1_V;  
    float      gTC2_V;  
    float      cAnalogTcAmp_V = 1;
    float      cAnalogTcOffset_V =  1.5;


    /* Sensor Type Information */
    int         gColPosSensorType ;
    int         cDTWRel = 0;
    int         cDTWAbs = 1;
    int         cNCSRel = 2;
    int         cNCSAbs = 3;
    int         cSensorLess = 4;

    int         gMsbSensorType ;
    int         cDigitalMsb = 0;
    int         cAnalogMsb = 1;

    float       cAnalogMsbAmp_V = 1.0;
    float       cAnalogMsbOffset_V = 2.5;

    float       gGearRatio ;
    int         gTurnsCntrEnable; 

	/* SensorFail used for detection of all Failures */
	    int         gSensorFail;

    /* Constant Masks for Induced Failures for torque sensor */
    int         gTrqFail;
    int         cT1_Fail = 0x0001;
    int         cT2_Fail = 0x0002;

    /* Constant Masks for Induced Failures for torque sensor */
    int         cDigTrq1_Fail = 0x2000;
    int         cDigTrq2_Fail = 0x4000;

    /* Constant Masks for Induced Failures for column sensor */
    int         gPosFail;
    int         cP1_Fail = 0x0004;
    int         cP2_Fail = 0x0008;
    int         cP3_Fail = 0x0010;
    int         cP4_Fail = 0x0020;

    /* Constant Masks for Induced Failures for MSB */
    int         gMsbFail;
    int         cM1_Fail = 0x0040;
    int         cM2_Fail = 0x0080;
    int         cM3_Fail = 0x0100;
    int         cM4_Fail = 0x0200;
    int         cM5_Fail = 0x0400;
    int         cM6_Fail = 0x0800;
    int         cM7_Fail = 0x1000;
   

    /* Battery Voltage Information */
   // msTimer     VoltageLoop_tmr;
    int         cVoltLoopRate = 10;       /* ms per torque loop */
    float       gVoltRate_VpSec;
    
    int         gVoltRampActive = 0;
    float       gCurrentVolt_V = 12.0;
    float       gVoltStepSize;
    float       gVoltNumLoops;
    float       gDeltaMagVolt;
    float       gSlotID = 0;

  

float CurrTime;
 
}

void MainTest()
{


    sysvar::VTS::PowerSupply.SetInterconnectionMode (8);

    sysvar::VTS::ExtSupp1.SetRefVoltageMode (1, 0.167);
    sysvar::VTS::ExtSupp1.SetMaxCurrentMode (1, 0.2);

    
    @sysvar::VTS::ExtSupp1::RefVoltage = 12.0;
    @sysvar::VTS::ExtSupp1::MaxCurrent = 20.0;
    
    @sysvar::VTS::Battery::Active = 1;

  
    @sysvar::VTS::Ignition::Active = 1;

    gTbar_NmpDeg = 2.5;
    gTrqSensor_VpDeg = 0.453125;
    gColPosSensorType = 4;
    gMsbSensorType = 1;
    gGearRatio = 24;

      /* Set voltage stimulation mode */
    sysvar::VTS::Torque1.SetStimulationMode(1);
    sysvar::VTS::Torque2.SetStimulationMode(1);
    sysvar::VTS::Position1.SetStimulationMode(1);
    sysvar::VTS::Position2.SetStimulationMode(1);
    sysvar::VTS::Position3.SetStimulationMode(1);
    sysvar::VTS::Position4.SetStimulationMode(1);
    sysvar::VTS::Motor1.SetStimulationMode(1);
    sysvar::VTS::Motor2.SetStimulationMode(1);
    sysvar::VTS::Motor3.SetStimulationMode(1);
    sysvar::VTS::Motor4.SetStimulationMode(1);
    sysvar::VTS::Motor5.SetStimulationMode(1);
    sysvar::VTS::Motor6.SetStimulationMode(1);
    sysvar::VTS::Motor7.SetStimulationMode(1);
    sysvar::VTS::DigTrq1.SetStimulationMode(1);
    sysvar::VTS::DigTrq2.SetStimulationMode(1);
    sysvar::VTS::DigTrq1.StartStimulation ();
    sysvar::VTS::DigTrq2.StartStimulation ();

    /* Set curve type constant value */
    sysvar::VTS::Torque1.SetCurveType(0);
    sysvar::VTS::Torque2.SetCurveType(0);
    sysvar::VTS::Position1.SetCurveType(0);
    sysvar::VTS::Position2.SetCurveType(0);
    sysvar::VTS::Position3.SetCurveType(0);
    sysvar::VTS::Position4.SetCurveType(0);
    sysvar::VTS::Motor1.SetCurveType(0);
    sysvar::VTS::Motor2.SetCurveType(0);
    sysvar::VTS::Motor3.SetCurveType(0);
    sysvar::VTS::Motor4.SetCurveType(0);
    sysvar::VTS::Motor5.SetCurveType(0);
    sysvar::VTS::Motor6.SetCurveType(0);
    sysvar::VTS::Motor7.SetCurveType(0);
    sysvar::VTS::DigTrq1.SetCurveType(1);
    sysvar::VTS::DigTrq2.SetCurveType(1);

    /* Set output voltages to a starting value */

    @sysvar::VTS::Torque1::Voltage = 2.5;
    @sysvar::VTS::Torque2::Voltage = 2.5;

    if((gColPosSensorType == cDTWRel) || (gColPosSensorType == cDTWAbs)) 
    {
        @sysvar::VTS::Position1::Voltage = 2.5;
        @sysvar::VTS::Position2::Voltage = 0.0;
        @sysvar::VTS::Position3::Voltage = 2.5;
    }
    else
    {
        /* Put NCS init here */
        @sysvar::VTS::Position1::Voltage = cP12Amp_V * sin(0 * 2 * PI / 360) + cP12Offset_V;
        @sysvar::VTS::Position2::Voltage = cP12Amp_V * cos(0 * 2 * PI / 360) + cP12Offset_V;;
        @sysvar::VTS::Position3::Voltage = cP34Amp_V * SIN(_floor((0+900) / 180) * 36 * 2 * PI / 360) + cP34Offset_V;
        @sysvar::VTS::Position4::Voltage = cP34Amp_V * COS(_floor((0+900) / 180) * 36 * 2 * PI / 360) + cP34Offset_V;

    }
    
    if(gMsbSensorType == cDigitalMsb)
    {
        @sysvar::VTS::Motor1::Voltage = 5.0;
        @sysvar::VTS::Motor2::Voltage = 0.0;
        @sysvar::VTS::Motor3::Voltage = 5.0;
        @sysvar::VTS::Motor4::Voltage = 5.0;
        @sysvar::VTS::Motor5::Voltage = 0.0;
        @sysvar::VTS::Motor6::Voltage = 2.5; //Used for Tach1 when dig MSB
        @sysvar::VTS::Motor7::Voltage = 2.5; //Used for Tach2 when dig MSB
    }
    else
    {
        /* Put analog MSB init here */
        @sysvar::VTS::Motor1::Voltage = cAnalogMsbAmp_V * sin(0) + cAnalogMsbOffset_V;
        @sysvar::VTS::Motor2::Voltage = cAnalogMsbAmp_V * cos(0) + cAnalogMsbOffset_V;
        @sysvar::VTS::Motor3::Voltage = cAnalogMsbAmp_V * SIN(pi) + cAnalogMsbOffset_V;
        @sysvar::VTS::Motor4::Voltage = cAnalogMsbAmp_V * COS(pi) + cAnalogMsbOffset_V;
        
        /*Used for Turns Counter when Analog MSB*/
        @sysvar::VTS::Motor6::Voltage = cAnalogTcAmp_V * sin(0+(45 * PI / 360)) + cAnalogMsbOffset_V;
        @sysvar::VTS::Motor7::Voltage = cAnalogTcAmp_V * cos(0+(45 * PI / 360)) + cAnalogMsbOffset_V;

    }

    /* Set supply to 13.8V as a starting point with ignition On */
   sysvar::VTS::PowerSupply.SetInterconnectionMode (8);

   

   // The factor of the external power supply is transmitted to the VT7001:
    sysvar::VTS::ExtSupp1.SetRefVoltageMode (1, 0.167);
    sysvar::VTS::ExtSupp1.SetMaxCurrentMode (1, 0.2);

    
    @sysvar::VTS::ExtSupp1::RefVoltage = 12.0;
    @sysvar::VTS::ExtSupp1::MaxCurrent = 1.0;
    
    @sysvar::VTS::Battery::Active = 1;

  
    @sysvar::VTS::Ignition::Active = 1;

    /* Set PWM settings */

    @sysvar::VTS::DigTrq1::PWMOutputFreq = 4000;
    @sysvar::VTS::DigTrq2::PWMOutputFreq = 4000;

}

