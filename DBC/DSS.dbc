VERSION ""

NS_ :

BS_:

BU_: TSTR EPAS
VAL_TABLE_ BCM_Key_Sta_Table 3 "Start" 2 "On" 1 "Acc" 0 "Lock" ;
VAL_TABLE_ LV_CAN_N_ERR_Table 1 "Fail" 0 "OK" ;
VAL_TABLE_ Steering_Torque_V_Table 1 "Failed" 0 "Not Failed" ;
VAL_TABLE_ EpasFailed_Table 1 "Failed" 0 "Not Failed" ;
VAL_TABLE_ SAS_Init_Table 1 "Initialization Finished" 0 "Initialization Not Finished" ;
VAL_TABLE_ SAS_OK_Table 1 "Valid" 0 "Invalid" ;
VAL_TABLE_ SAS_CAL_Table 1 "Calibrated" 0 "Not Calibrated" ;

BO_ 1765 XcpSlave: 8 EPAS
 SG_ XcpSlave : 7|64@0+ (1,0) [0|1.8446744074E+019] "cnt"  TSTR

BO_ 1685 XcpMaster: 8 TSTR
 SG_ XcpMaster : 7|64@0+ (1,0) [0|1.8446744074E+019] "cnt"  EPAS

BO_ 1056 BCM1: 8 Vector__XXX
 SG_ BCM_Key_Sta : 7|2@0+ (1,0) [0|3] "enum"  EPAS

BO_ 922 EPAS1: 2 EPAS
 SG_ SAS_Angle : 7|16@0+ (0.1,-900) [-900|900] "deg"  TSTR

BA_DEF_ BO_  "GenMsgILSupport" ENUM  "No","Yes";
BA_DEF_ BO_  "App-Botschaft" ENUM  "No","Yes";
BA_DEF_  "VersionNumber" INT 0 1000000000;
BA_DEF_  "VersionDay" INT 0 31;
BA_DEF_  "VersionMonth" INT 0 12;
BA_DEF_  "VersionYear" INT 0 99;
BA_DEF_  "Manufacturer" STRING ;
BA_DEF_ EV_  "GenEnvControlType" ENUM  "NoControl","SliderHoriz","SliderVert","PushButton","Edit","BitmapSwitch";
BA_DEF_ SG_  "GenSigEnvVarType" ENUM  "int","float","undef";
BA_DEF_ SG_  "GenSigSendType" ENUM  "spontaneous";
BA_DEF_ BO_  "GenMsgSendType" ENUM  "cyclic","spontaneous","cyclicIfActive","spontaneousWithDelay","cyclicAndSpontaneous","cyclicAndSpontaneousWithDelay","spontaneousWithRepetition","cyclicIfActiveAndSpontaneousWD";
BA_DEF_ BO_  "GenMsgCycleTime" INT 2 50000;
BA_DEF_  "GenEnvVarPrefix" STRING ;
BA_DEF_  "GenEnvVarEndingSnd" STRING ;
BA_DEF_  "GenEnvVarEndingDsp" STRING ;
BA_DEF_  "GenNWMTalkNM" STRING ;
BA_DEF_  "GenNWMGotoMode_BusSleep" STRING ;
BA_DEF_  "GenNWMGotoMode_Awake" STRING ;
BA_DEF_  "GenNWMApCanWakeUp" STRING ;
BA_DEF_  "GenNWMApCanSleep" STRING ;
BA_DEF_  "GenNWMApCanOn" STRING ;
BA_DEF_  "GenNWMApCanOff" STRING ;
BA_DEF_  "GenNWMApCanNormal" STRING ;
BA_DEF_  "GenNWMApBusSleep" STRING ;
BA_DEF_ SG_  "GenSigStartValue" INT 0 1000000000;
BA_DEF_  "BusType" STRING ;
BA_DEF_DEF_  "GenMsgILSupport" "No";
BA_DEF_DEF_  "App-Botschaft" "No";
BA_DEF_DEF_  "VersionNumber" 0;
BA_DEF_DEF_  "VersionDay" 1;
BA_DEF_DEF_  "VersionMonth" 1;
BA_DEF_DEF_  "VersionYear" 0;
BA_DEF_DEF_  "Manufacturer" "";
BA_DEF_DEF_  "GenEnvControlType" "NoControl";
BA_DEF_DEF_  "GenSigEnvVarType" "undef";
BA_DEF_DEF_  "GenSigSendType" "spontaneous";
BA_DEF_DEF_  "GenMsgSendType" "spontaneous";
BA_DEF_DEF_  "GenMsgCycleTime" 10;
BA_DEF_DEF_  "GenEnvVarPrefix" "Env";
BA_DEF_DEF_  "GenEnvVarEndingSnd" "_";
BA_DEF_DEF_  "GenEnvVarEndingDsp" "Dsp_";
BA_DEF_DEF_  "GenNWMTalkNM" "TalkNM()";
BA_DEF_DEF_  "GenNWMGotoMode_BusSleep" "GotoMode_BusSleep()";
BA_DEF_DEF_  "GenNWMGotoMode_Awake" "GotoMode_Awake()";
BA_DEF_DEF_  "GenNWMApCanWakeUp" "apCanWakeUp()";
BA_DEF_DEF_  "GenNWMApCanSleep" "apCanSleep()";
BA_DEF_DEF_  "GenNWMApCanOn" "apCanOn()";
BA_DEF_DEF_  "GenNWMApCanOff" "apCanOff()";
BA_DEF_DEF_  "GenNWMApCanNormal" "apCanNormal()";
BA_DEF_DEF_  "GenNWMApBusSleep" "apBusSleep()";
BA_DEF_DEF_  "GenSigStartValue" 0;
BA_DEF_DEF_  "BusType" "CAN";
BA_ "Manufacturer" "Haitec";
BA_ "VersionYear" 13;
BA_ "VersionMonth" 6;
BA_ "VersionDay" 26;
BA_ "VersionNumber" 1;
BA_ "App-Botschaft" BO_ 1765 1;
BA_ "App-Botschaft" BO_ 1685 1;
BA_ "GenMsgILSupport" BO_ 1056 1;
BA_ "GenMsgCycleTime" BO_ 1056 200;
BA_ "GenMsgSendType" BO_ 1056 4;
BA_ "GenMsgILSupport" BO_ 922 1;
BA_ "GenMsgSendType" BO_ 922 0;
BA_ "GenSigStartValue" SG_ 922 SAS_Angle 9001;
VAL_ 1056 BCM_Key_Sta 3 "Start" 2 "On" 1 "Acc" 0 "Lock" ;
