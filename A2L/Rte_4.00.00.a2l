ASAP2_VERSION 1 60
/begin PROJECT Rte_4.00.00 ""
/begin MODULE CPP ""
/begin MOD_COMMON "" BYTE_ORDER MSB_FIRST ALIGNMENT_BYTE 1 ALIGNMENT_WORD 1 ALIGNMENT_LONG 1 ALIGNMENT_INT64 1 ALIGNMENT_FLOAT32_IEEE 1 ALIGNMENT_FLOAT64_IEEE 1 /end MOD_COMMON
/begin COMPU_VTAB_RANGE RTE_CM_BOOLEAN "" 2 0 0 "false" 1 255 "true" DEFAULT_VALUE "" /end COMPU_VTAB_RANGE
/begin COMPU_VTAB RTE_CM_ENUM_FETFAULTTYPE_ENUM "" TAB_VERB 3 0 "NOFAULT" 1 "LOWER" 2 "UPPER" DEFAULT_VALUE "" /end COMPU_VTAB
/begin COMPU_VTAB RTE_CM_ENUM_FETPHASETYPE_ENUM "" TAB_VERB 4 0 "NOPHASE" 1 "PHASEA" 2 "PHASEB" 3 "PHASEC" DEFAULT_VALUE "" /end COMPU_VTAB
/begin COMPU_VTAB RTE_CM_ENUM_StaMd_Mode "" TAB_VERB 5 0 "RTE_MODE_StaMd_Mode_DISABLE" 1 "RTE_MODE_StaMd_Mode_OFF" 2 "RTE_MODE_StaMd_Mode_OPERATE" 3 "RTE_MODE_StaMd_Mode_WARMINIT" 4 "RTE_TRANSITION_StaMd_Mode" DEFAULT_VALUE "" /end COMPU_VTAB
/begin COMPU_METHOD RTE_CM_BOOLEAN "" TAB_VERB "%3.1" "" COMPU_TAB_REF RTE_CM_BOOLEAN /end COMPU_METHOD
/begin COMPU_METHOD RTE_CM_ENUM_FETFAULTTYPE_ENUM "" TAB_VERB "%.1" "" COMPU_TAB_REF RTE_CM_ENUM_FETFAULTTYPE_ENUM /end COMPU_METHOD
/begin COMPU_METHOD RTE_CM_ENUM_FETPHASETYPE_ENUM "" TAB_VERB "%.1" "" COMPU_TAB_REF RTE_CM_ENUM_FETPHASETYPE_ENUM /end COMPU_METHOD
/begin COMPU_METHOD RTE_CM_ENUM_StaMd_Mode "" TAB_VERB "%.1" "" COMPU_TAB_REF RTE_CM_ENUM_StaMd_Mode /end COMPU_METHOD
/begin MEASUREMENT AbsHwPos_SrlComHwPos_HwDeg_M_f32 "" FLOAT32_IEEE NO_COMPU_METHOD 0 0 0 255 ECU_ADDRESS 0x8019414 FORMAT "%.15" /end MEASUREMENT
/begin MEASUREMENT BSM1CRCFltAcc_Cnt_M_u16 "" UWORD NO_COMPU_METHOD 0 0 0 255 ECU_ADDRESS 0x80149E4 FORMAT "%.15" /end MEASUREMENT
/begin MEASUREMENT BSM1MsgCounterFltAcc_Cnt_M_u16 "" UWORD NO_COMPU_METHOD 0 0 0 255 ECU_ADDRESS 0x80149E6 FORMAT "%.15" /end MEASUREMENT
/begin MEASUREMENT CRCB1_Cnt_M_u8 "" UBYTE NO_COMPU_METHOD 0 0 0 255 ECU_ADDRESS 0x80149F1 FORMAT "%.15" /end MEASUREMENT
/begin MEASUREMENT CityModeSts_Cnt_M_lgc "" UBYTE NO_COMPU_METHOD 0 0 0 255 ECU_ADDRESS 0x8014A05 FORMAT "%.15" /end MEASUREMENT
/begin MEASUREMENT CmdIgnFailStsInternal_Cnt_M_u8 "" UBYTE NO_COMPU_METHOD 0 0 0 255 ECU_ADDRESS 0x80149F0 FORMAT "%.15" /end MEASUREMENT
/begin MEASUREMENT CmdIgnFailSts_Cnt_M_u8 "" UBYTE NO_COMPU_METHOD 0 0 0 255 ECU_ADDRESS 0x80149EF FORMAT "%.15" /end MEASUREMENT
/begin MEASUREMENT CmdIgnSts_Cnt_M_u8 "" UBYTE NO_COMPU_METHOD 0 0 0 255 ECU_ADDRESS 0x80149ED FORMAT "%.15" /end MEASUREMENT
/begin MEASUREMENT ESLampFailSts_Cnt_M_u8 "" UBYTE NO_COMPU_METHOD 0 0 0 255 ECU_ADDRESS 0x80149F5 FORMAT "%.15" /end MEASUREMENT
/begin MEASUREMENT EngStartStopSts_Cnt_M_u8 "" UBYTE NO_COMPU_METHOD 0 0 0 255 ECU_ADDRESS 0x80149F3 FORMAT "%.15" /end MEASUREMENT
/begin MEASUREMENT EngSts_Cnt_M_u8 "" UBYTE NO_COMPU_METHOD 0 0 0 255 ECU_ADDRESS 0x80149F4 FORMAT "%.15" /end MEASUREMENT
/begin MEASUREMENT MsgCntB1Prev_Cnt_M_u8 "" UBYTE NO_COMPU_METHOD 0 0 0 255 ECU_ADDRESS 0x80149F7 FORMAT "%.15" /end MEASUREMENT
/begin MEASUREMENT MsgCntB1_Cnt_M_u8 "" UBYTE NO_COMPU_METHOD 0 0 0 255 ECU_ADDRESS 0x80149F6 FORMAT "%.15" /end MEASUREMENT
/begin MEASUREMENT OpModeFailSts_Cnt_M_u8 "" UBYTE NO_COMPU_METHOD 0 0 0 255 ECU_ADDRESS 0x80149FC FORMAT "%.15" /end MEASUREMENT
/begin MEASUREMENT OpModeSts_Cnt_M_u8 "" UBYTE NO_COMPU_METHOD 0 0 0 255 ECU_ADDRESS 0x80149FB FORMAT "%.15" /end MEASUREMENT
/begin MEASUREMENT Rte_CtrlTemp_AmbTemp_DegC_f32 "MICROSAR RTE" FLOAT32_IEEE NO_COMPU_METHOD 0 0 1.175494351e-038 3.402823466e+038 ECU_ADDRESS 0x8014974 FORMAT "%.15" /end MEASUREMENT
/begin MEASUREMENT Rte_CtrldDisShtdn_SysC_CRFMtrTrqCmd_MtrNm_f32 "MICROSAR RTE" FLOAT32_IEEE NO_COMPU_METHOD 0 0 1.175494351e-038 3.402823466e+038 ECU_ADDRESS 0x8018720 FORMAT "%.15" /end MEASUREMENT
/begin MEASUREMENT Rte_CtrldDisShtdn_SysC_MRFMtrTrqCmd_MtrNm_f32 "MICROSAR RTE" FLOAT32_IEEE NO_COMPU_METHOD 0 0 1.175494351e-038 3.402823466e+038 ECU_ADDRESS 0x8018724 FORMAT "%.15" /end MEASUREMENT
/begin MEASUREMENT Rte_CurrCmd_IvtrLoaMtgtnEn_Cnt_lgc "MICROSAR RTE" UBYTE RTE_CM_BOOLEAN 0 0 0 255 ECU_ADDRESS 0x801888E /end MEASUREMENT
/begin MEASUREMENT Rte_CurrCmd_MotCurrLoaMtgtnEn_Cnt_lgc "MICROSAR RTE" UBYTE RTE_CM_BOOLEAN 0 0 0 255 ECU_ADDRESS 0x801888F /end MEASUREMENT
/begin MEASUREMENT Rte_CurrCmd_MtrCurrDaxRef_Amp_f32 "MICROSAR RTE" FLOAT32_IEEE NO_COMPU_METHOD 0 0 1.175494351e-038 3.402823466e+038 ECU_ADDRESS 0x801872C FORMAT "%.15" /end MEASUREMENT
/begin MEASUREMENT Rte_CurrCmd_MtrCurrQaxRef_Amp_f32 "MICROSAR RTE" FLOAT32_IEEE NO_COMPU_METHOD 0 0 1.175494351e-038 3.402823466e+038 ECU_ADDRESS 0x8018730 FORMAT "%.15" /end MEASUREMENT
/begin MEASUREMENT Rte_CurrParamComp_EOLNomMtrParam.NomKe_VpRadpS_f32 "MICROSAR RTE" FLOAT32_IEEE NO_COMPU_METHOD 0 0 1.175494351e-038 3.402823466e+038 READ_WRITE ECU_ADDRESS 0x80084B0 FORMAT "%.15" /end MEASUREMENT
/begin MEASUREMENT Rte_CurrParamComp_EOLNomMtrParam.NomRmtr_Ohm_f32 "MICROSAR RTE" FLOAT32_IEEE NO_COMPU_METHOD 0 0 1.175494351e-038 3.402823466e+038 READ_WRITE ECU_ADDRESS 0x80084B4 FORMAT "%.15" /end MEASUREMENT
/begin MEASUREMENT Rte_CurrParamComp_EstKe_VpRadpS_f32 "MICROSAR RTE" FLOAT32_IEEE NO_COMPU_METHOD 0 0 1.175494351e-038 3.402823466e+038 ECU_ADDRESS 0x8018734 FORMAT "%.15" /end MEASUREMENT
/begin MEASUREMENT Rte_CurrParamComp_EstLd_Henry_f32 "MICROSAR RTE" FLOAT32_IEEE NO_COMPU_METHOD 0 0 1.175494351e-038 3.402823466e+038 ECU_ADDRESS 0x8018738 FORMAT "%.15" /end MEASUREMENT
/begin MEASUREMENT Rte_CurrParamComp_EstLq_Henry_f32 "MICROSAR RTE" FLOAT32_IEEE NO_COMPU_METHOD 0 0 1.175494351e-038 3.402823466e+038 ECU_ADDRESS 0x801873C FORMAT "%.15" /end MEASUREMENT
/begin MEASUREMENT Rte_CurrParamComp_EstR_Ohm_f32 "MICROSAR RTE" FLOAT32_IEEE NO_COMPU_METHOD 0 0 1.175494351e-038 3.402823466e+038 ECU_ADDRESS 0x8018740 FORMAT "%.15" /end MEASUREMENT
/begin MEASUREMENT Rte_DampingFirewall_VehicleLonAccel_KphpS_f32 "MICROSAR RTE" FLOAT32_IEEE NO_COMPU_METHOD 0 0 1.175494351e-038 3.402823466e+038 ECU_ADDRESS 0x8018898 FORMAT "%.15" /end MEASUREMENT
/begin MEASUREMENT Rte_DampingFirewall_WIRCmdAmpBlnd_MtrNm_f32 "MICROSAR RTE" FLOAT32_IEEE NO_COMPU_METHOD 0 0 1.175494351e-038 3.402823466e+038 ECU_ADDRESS 0x801889C FORMAT "%.15" /end MEASUREMENT
/begin MEASUREMENT Rte_Damping_CustomDamp_MtrNm_f32 "MICROSAR RTE" FLOAT32_IEEE NO_COMPU_METHOD 0 0 1.175494351e-038 3.402823466e+038 ECU_ADDRESS 0x8018890 FORMAT "%.15" /end MEASUREMENT
/begin MEASUREMENT Rte_Damping_DampingCmd_MtrNm_f32 "MICROSAR RTE" FLOAT32_IEEE NO_COMPU_METHOD 0 0 1.175494351e-038 3.402823466e+038 ECU_ADDRESS 0x8018744 FORMAT "%.15" /end MEASUREMENT
/begin MEASUREMENT Rte_Damping_DampingDDFactor_Uls_f32 "MICROSAR RTE" FLOAT32_IEEE NO_COMPU_METHOD 0 0 1.175494351e-038 3.402823466e+038 ECU_ADDRESS 0x8018894 FORMAT "%.15" /end MEASUREMENT
/begin MEASUREMENT Rte_DiagMgr10_DiagRampRate_XpmS_f32 "MICROSAR RTE" FLOAT32_IEEE NO_COMPU_METHOD 0 0 1.175494351e-038 3.402823466e+038 ECU_ADDRESS 0x801874C FORMAT "%.15" /end MEASUREMENT
/begin MEASUREMENT Rte_DiagMgr10_DiagRampValue_Uls_f32 "MICROSAR RTE" FLOAT32_IEEE NO_COMPU_METHOD 0 0 1.175494351e-038 3.402823466e+038 ECU_ADDRESS 0x8018750 FORMAT "%.15" /end MEASUREMENT
/begin MEASUREMENT Rte_DiagMgr10_DiagRmpToZeroActive_Cnt_lgc "MICROSAR RTE" UBYTE RTE_CM_BOOLEAN 0 0 0 255 ECU_ADDRESS 0x8018754 /end MEASUREMENT
/begin MEASUREMENT Rte_DiagMgr10_DiagStsDefTemp_Cnt_lgc "MICROSAR RTE" UBYTE RTE_CM_BOOLEAN 0 0 0 255 ECU_ADDRESS 0x8018756 /end MEASUREMENT
/begin MEASUREMENT Rte_DiagMgr10_DiagStsDefVehSpd_Cnt_lgc "MICROSAR RTE" UBYTE RTE_CM_BOOLEAN 0 0 0 255 ECU_ADDRESS 0x8018757 /end MEASUREMENT
/begin MEASUREMENT Rte_DiagMgr10_DiagStsNonRecRmpToZeroFltPres_Cnt_lgc "MICROSAR RTE" UBYTE RTE_CM_BOOLEAN 0 0 0 255 ECU_ADDRESS 0x8018759 /end MEASUREMENT
/begin MEASUREMENT Rte_DiagMgr10_DiagStsRecRmpToZeroFltPres_Cnt_lgc "MICROSAR RTE" UBYTE RTE_CM_BOOLEAN 0 0 0 255 ECU_ADDRESS 0x801875A /end MEASUREMENT
/begin MEASUREMENT Rte_DiagMgr10_DiagStsScomHWANotValid_Cnt_lgc "MICROSAR RTE" UBYTE RTE_CM_BOOLEAN 0 0 0 255 ECU_ADDRESS 0x801875B /end MEASUREMENT
/begin MEASUREMENT Rte_DiagMgr10_DiagStsWIRDisable_Cnt_lgc "MICROSAR RTE" UBYTE RTE_CM_BOOLEAN 0 0 0 255 ECU_ADDRESS 0x801875C /end MEASUREMENT
/begin MEASUREMENT Rte_DiagSvc_AppSwFingerPrintData "MICROSAR RTE" UBYTE NO_COMPU_METHOD 0 0 0 255 READ_WRITE ECU_ADDRESS 0x800700C FORMAT "%.15" MATRIX_DIM 14 1 1 LAYOUT ROW_DIR /end MEASUREMENT
/begin MEASUREMENT Rte_DiagSvc_BootSwFingerPrintData "MICROSAR RTE" UBYTE NO_COMPU_METHOD 0 0 0 255 READ_WRITE ECU_ADDRESS 0x800701C FORMAT "%.15" MATRIX_DIM 14 1 1 LAYOUT ROW_DIR /end MEASUREMENT
/begin MEASUREMENT Rte_DiagSvc_CalSwFingerPrintData "MICROSAR RTE" UBYTE NO_COMPU_METHOD 0 0 0 255 READ_WRITE ECU_ADDRESS 0x800702C FORMAT "%.15" MATRIX_DIM 14 1 1 LAYOUT ROW_DIR /end MEASUREMENT
/begin MEASUREMENT Rte_DiagSvc_ECULifeTimeMinsData "MICROSAR RTE" ULONG NO_COMPU_METHOD 0 0 0 4294967295 READ_WRITE ECU_ADDRESS 0x8006FFC FORMAT "%.15" /end MEASUREMENT
/begin MEASUREMENT Rte_DiagSvc_ECUSerialNumberData "MICROSAR RTE" UBYTE NO_COMPU_METHOD 0 0 0 255 READ_WRITE ECU_ADDRESS 0x800703C FORMAT "%.15" MATRIX_DIM 16 1 1 LAYOUT ROW_DIR /end MEASUREMENT
/begin MEASUREMENT Rte_DiagSvc_ECUSparePartNoData "MICROSAR RTE" UBYTE NO_COMPU_METHOD 0 0 0 255 READ_WRITE ECU_ADDRESS 0x800704C FORMAT "%.15" MATRIX_DIM 11 1 1 LAYOUT ROW_DIR /end MEASUREMENT
/begin MEASUREMENT Rte_DiagSvc_EOLConfigurationData "MICROSAR RTE" UBYTE NO_COMPU_METHOD 0 0 0 255 READ_WRITE ECU_ADDRESS 0x8007058 FORMAT "%.15" MATRIX_DIM 9 1 1 LAYOUT ROW_DIR /end MEASUREMENT
/begin MEASUREMENT Rte_DiagSvc_EraseRoutineStatusData "MICROSAR RTE" UBYTE NO_COMPU_METHOD 0 0 0 255 READ_WRITE ECU_ADDRESS 0x8007064 FORMAT "%.15" /end MEASUREMENT
/begin MEASUREMENT Rte_DiagSvc_FirstDTCDetectMinsData "MICROSAR RTE" ULONG NO_COMPU_METHOD 0 0 0 4294967295 READ_WRITE ECU_ADDRESS 0x8007000 FORMAT "%.15" /end MEASUREMENT
/begin MEASUREMENT Rte_DiagSvc_FirstDTCDetectSecsData "MICROSAR RTE" UWORD NO_COMPU_METHOD 0 0 0 65535 READ_WRITE ECU_ADDRESS 0x8007004 FORMAT "%.15" /end MEASUREMENT
/begin MEASUREMENT Rte_DiagSvc_IgnitionPreStart_Cnt_lgc "MICROSAR RTE" UBYTE RTE_CM_BOOLEAN 0 0 0 255 ECU_ADDRESS 0x80148F5 /end MEASUREMENT
/begin MEASUREMENT Rte_DiagSvc_ProgrammingAttemptCounterData "MICROSAR RTE" UBYTE NO_COMPU_METHOD 0 0 0 255 READ_WRITE ECU_ADDRESS 0x8007068 FORMAT "%.15" MATRIX_DIM 8 1 1 LAYOUT ROW_DIR /end MEASUREMENT
/begin MEASUREMENT Rte_DiagSvc_ProgrammingStatusData "MICROSAR RTE" UBYTE NO_COMPU_METHOD 0 0 0 255 READ_WRITE ECU_ADDRESS 0x8007070 FORMAT "%.15" /end MEASUREMENT
/begin MEASUREMENT Rte_DiagSvc_ProxiConfigurationData "MICROSAR RTE" UBYTE NO_COMPU_METHOD 0 0 0 255 READ_WRITE ECU_ADDRESS 0x8007074 FORMAT "%.15" MATRIX_DIM 255 1 1 LAYOUT ROW_DIR /end MEASUREMENT
/begin MEASUREMENT Rte_DiagSvc_ProxiCounterData "MICROSAR RTE" UBYTE NO_COMPU_METHOD 0 0 0 255 READ_WRITE ECU_ADDRESS 0x8007174 FORMAT "%.15" /end MEASUREMENT
/begin MEASUREMENT Rte_DiagSvc_TuningSetSelectData "MICROSAR RTE" UWORD NO_COMPU_METHOD 0 0 0 65535 READ_WRITE ECU_ADDRESS 0x800700A FORMAT "%.15" /end MEASUREMENT
/begin MEASUREMENT Rte_DiagSvc_VINCurrentData "MICROSAR RTE" UBYTE NO_COMPU_METHOD 0 0 0 255 READ_WRITE ECU_ADDRESS 0x8007178 FORMAT "%.15" MATRIX_DIM 17 1 1 LAYOUT ROW_DIR /end MEASUREMENT
/begin MEASUREMENT Rte_DiagSvc_VINOriginalData "MICROSAR RTE" UBYTE NO_COMPU_METHOD 0 0 0 255 READ_WRITE ECU_ADDRESS 0x800718C FORMAT "%.15" MATRIX_DIM 17 1 1 LAYOUT ROW_DIR /end MEASUREMENT
/begin MEASUREMENT Rte_DigHwTrqSENT_DigTrqTrim.k_EOLHwTrqTrimPerformed_Cnt_Lgc "MICROSAR RTE" UBYTE RTE_CM_BOOLEAN 0 0 0 255 READ_WRITE ECU_ADDRESS 0x80084BC /end MEASUREMENT
/begin MEASUREMENT Rte_DigHwTrqSENT_DigTrqTrim.k_EOLHwTrqTrim_HwNm_f32 "MICROSAR RTE" FLOAT32_IEEE NO_COMPU_METHOD 0 0 1.175494351e-038 3.402823466e+038 READ_WRITE ECU_ADDRESS 0x80084B8 FORMAT "%.15" /end MEASUREMENT
/begin MEASUREMENT Rte_DigHwTrqSENT_HwTorque_HwNm_f32 "MICROSAR RTE" FLOAT32_IEEE NO_COMPU_METHOD 0 0 1.175494351e-038 3.402823466e+038 ECU_ADDRESS 0x8018760 FORMAT "%.15" /end MEASUREMENT
/begin MEASUREMENT Rte_DigHwTrqSENT_SrlComHwTrqValid_Cnt_lgc "MICROSAR RTE" UBYTE RTE_CM_BOOLEAN 0 0 0 255 ECU_ADDRESS 0x8018768 /end MEASUREMENT
/begin MEASUREMENT Rte_DigHwTrqSENT_SrlComHwTrq_HwNm_f32 "MICROSAR RTE" FLOAT32_IEEE NO_COMPU_METHOD 0 0 1.175494351e-038 3.402823466e+038 ECU_ADDRESS 0x8018764 FORMAT "%.15" /end MEASUREMENT
/begin MEASUREMENT Rte_DigHwTrqSENT_SysCHwTorque_HwNm_f32 "MICROSAR RTE" FLOAT32_IEEE NO_COMPU_METHOD 0 0 1.175494351e-038 3.402823466e+038 ECU_ADDRESS 0x801876C FORMAT "%.15" /end MEASUREMENT
/begin MEASUREMENT Rte_DigMSB_AlignedCumMechMtrPosMRF_Deg_f32 "MICROSAR RTE" FLOAT32_IEEE NO_COMPU_METHOD 0 0 1.175494351e-038 3.402823466e+038 ECU_ADDRESS 0x8018774 FORMAT "%.15" /end MEASUREMENT
/begin MEASUREMENT Rte_DigMSB_CumMechMtrPosMRF_Deg_f32 "MICROSAR RTE" FLOAT32_IEEE NO_COMPU_METHOD 0 0 1.175494351e-038 3.402823466e+038 ECU_ADDRESS 0x8018780 FORMAT "%.15" /end MEASUREMENT
/begin MEASUREMENT Rte_DigMSB_CumMechMtrPosStatus_Cnt_u08 "MICROSAR RTE" UBYTE NO_COMPU_METHOD 0 0 0 255 ECU_ADDRESS 0x8018784 FORMAT "%.15" /end MEASUREMENT
/begin MEASUREMENT Rte_DigMSB_DigMSBEOLData.CRC_Cnt_u16 "MICROSAR RTE" UWORD NO_COMPU_METHOD 0 0 0 65535 READ_WRITE ECU_ADDRESS 0x80094C4 FORMAT "%.15" /end MEASUREMENT
/begin MEASUREMENT Rte_DigMSB_DigMSBEOLData.MtrPos1HarCompTbl_Rev_s2p13 "MICROSAR RTE" SWORD NO_COMPU_METHOD 0 0 -32768 32767 READ_WRITE ECU_ADDRESS 0x80084C4 FORMAT "%.15" MATRIX_DIM 1024 1 1 LAYOUT ROW_DIR /end MEASUREMENT
/begin MEASUREMENT Rte_DigMSB_DigMSBEOLData.MtrPos2HarCompTbl_Rev_s2p13 "MICROSAR RTE" SWORD NO_COMPU_METHOD 0 0 -32768 32767 READ_WRITE ECU_ADDRESS 0x8008CC4 FORMAT "%.15" MATRIX_DIM 1024 1 1 LAYOUT ROW_DIR /end MEASUREMENT
/begin MEASUREMENT Rte_DigMSB_DigMSBEOLData.MtrPosBEMFRedundant_Rev_u0p16 "MICROSAR RTE" UWORD NO_COMPU_METHOD 0 0 0 65535 READ_WRITE ECU_ADDRESS 0x80084C2 FORMAT "%.15" /end MEASUREMENT
/begin MEASUREMENT Rte_DigMSB_DigMSBEOLData.MtrPosBEMF_Rev_u0p16 "MICROSAR RTE" UWORD NO_COMPU_METHOD 0 0 0 65535 READ_WRITE ECU_ADDRESS 0x80084C0 FORMAT "%.15" /end MEASUREMENT
/begin MEASUREMENT Rte_DigMSB_MechMtrPos2_Rev_u0p16 "MICROSAR RTE" UWORD NO_COMPU_METHOD 0 0 0 65535 ECU_ADDRESS 0x8018786 FORMAT "%.15" /end MEASUREMENT
/begin MEASUREMENT Rte_DigMSB_SysCCumMechMtrPosMRF_Deg_f32 "MICROSAR RTE" FLOAT32_IEEE NO_COMPU_METHOD 0 0 1.175494351e-038 3.402823466e+038 ECU_ADDRESS 0x8018788 FORMAT "%.15" /end MEASUREMENT
/begin MEASUREMENT Rte_DigPhsReasDiag_PDActivateTest_Cnt_lgc "MICROSAR RTE" UBYTE RTE_CM_BOOLEAN 0 0 0 255 ECU_ADDRESS 0x80188A0 /end MEASUREMENT
/begin MEASUREMENT Rte_EOTActuatorMng_AssistEOTDamping_MtrNm_f32 "MICROSAR RTE" FLOAT32_IEEE NO_COMPU_METHOD 0 0 1.175494351e-038 3.402823466e+038 ECU_ADDRESS 0x801878C FORMAT "%.15" /end MEASUREMENT
/begin MEASUREMENT Rte_EOTActuatorMng_AssistEOTGain_Uls_f32 "MICROSAR RTE" FLOAT32_IEEE NO_COMPU_METHOD 0 0 1.175494351e-038 3.402823466e+038 ECU_ADDRESS 0x8018790 FORMAT "%.15" /end MEASUREMENT
/begin MEASUREMENT Rte_EOTActuatorMng_AssistEOTLimit_MtrNm_f32 "MICROSAR RTE" FLOAT32_IEEE NO_COMPU_METHOD 0 0 1.175494351e-038 3.402823466e+038 ECU_ADDRESS 0x8018794 FORMAT "%.15" /end MEASUREMENT
/begin MEASUREMENT Rte_ElePwr_ElectricPower_Watt_f32 "MICROSAR RTE" FLOAT32_IEEE NO_COMPU_METHOD 0 0 1.175494351e-038 3.402823466e+038 ECU_ADDRESS 0x80148F8 FORMAT "%.15" /end MEASUREMENT
/begin MEASUREMENT Rte_ElePwr_SupplyCurrent_Amp_f32 "MICROSAR RTE" FLOAT32_IEEE NO_COMPU_METHOD 0 0 1.175494351e-038 3.402823466e+038 ECU_ADDRESS 0x80148FC FORMAT "%.15" /end MEASUREMENT
/begin MEASUREMENT Rte_FrqDepDmpnInrtCmp_FrqDepDmpnInrtCmp_MtrNm_f32 "MICROSAR RTE" FLOAT32_IEEE NO_COMPU_METHOD 0 0 1.175494351e-038 3.402823466e+038 ECU_ADDRESS 0x801879C FORMAT "%.15" /end MEASUREMENT
/begin MEASUREMENT Rte_FrqDepDmpnInrtCmp_VehicleLonAccel_KphpS_f32 "MICROSAR RTE" FLOAT32_IEEE NO_COMPU_METHOD 0 0 1.175494351e-038 3.402823466e+038 ECU_ADDRESS 0x80188A4 FORMAT "%.15" /end MEASUREMENT
/begin MEASUREMENT Rte_FrqDepDmpnInrtCmp_WIRCmdAmpBlnd_MtrNm_f32 "MICROSAR RTE" FLOAT32_IEEE NO_COMPU_METHOD 0 0 1.175494351e-038 3.402823466e+038 ECU_ADDRESS 0x80188A8 FORMAT "%.15" /end MEASUREMENT
/begin MEASUREMENT Rte_HiLoadStall_AssistStallLimit_MtrNm_f32 "MICROSAR RTE" FLOAT32_IEEE NO_COMPU_METHOD 0 0 1.175494351e-038 3.402823466e+038 ECU_ADDRESS 0x8014900 FORMAT "%.15" /end MEASUREMENT
/begin MEASUREMENT Rte_HighFreqAssist_WIRCmdAmpBlnd_MtrNm_f32 "MICROSAR RTE" FLOAT32_IEEE NO_COMPU_METHOD 0 0 1.175494351e-038 3.402823466e+038 ECU_ADDRESS 0x80188AC FORMAT "%.15" /end MEASUREMENT
/begin MEASUREMENT Rte_HwPwUp_MtrDrvrInitStart_Cnt_lgc "MICROSAR RTE" UBYTE RTE_CM_BOOLEAN 0 0 0 255 ECU_ADDRESS 0x80187A4 /end MEASUREMENT
/begin MEASUREMENT Rte_HwPwUp_TMFTestStart_Cnt_lgc "MICROSAR RTE" UBYTE RTE_CM_BOOLEAN 0 0 0 255 ECU_ADDRESS 0x80187A7 /end MEASUREMENT
/begin MEASUREMENT Rte_HystComp_WIRCmdAmpBlnd_MtrNm_f32 "MICROSAR RTE" FLOAT32_IEEE NO_COMPU_METHOD 0 0 1.175494351e-038 3.402823466e+038 ECU_ADDRESS 0x80188B0 FORMAT "%.15" /end MEASUREMENT
/begin MEASUREMENT Rte_IoHwAbstractionUsr_TemperatureADC_Volt_f32 "This signal is intended to communicate any type voltage signal measured by the ecu.  This signal has a lower limit of 0 which reequires users of the signal to provide divide by 0 protection if it is used as a denominator in a calculation.  See Vecu port p" FLOAT32_IEEE NO_COMPU_METHOD 0 0 1.175494351e-038 3.402823466e+038 ECU_ADDRESS 0x80187B8 FORMAT "%.15" /end MEASUREMENT
/begin MEASUREMENT Rte_LmtCod_CCLTrqRamp_Uls_f32 "MICROSAR RTE" FLOAT32_IEEE NO_COMPU_METHOD 0 0 1.175494351e-038 3.402823466e+038 ECU_ADDRESS 0x80188B4 FORMAT "%.15" /end MEASUREMENT
/begin MEASUREMENT Rte_LrnEOT_CCWFound_Cnt_lgc "MICROSAR RTE" UBYTE RTE_CM_BOOLEAN 0 0 0 255 ECU_ADDRESS 0x8014904 /end MEASUREMENT
/begin MEASUREMENT Rte_LrnEOT_CCWPosition_HwDeg_f32 "MICROSAR RTE" FLOAT32_IEEE NO_COMPU_METHOD 0 0 1.175494351e-038 3.402823466e+038 ECU_ADDRESS 0x8014908 FORMAT "%.15" /end MEASUREMENT
/begin MEASUREMENT Rte_LrnEOT_CWFound_Cnt_lgc "MICROSAR RTE" UBYTE RTE_CM_BOOLEAN 0 0 0 255 ECU_ADDRESS 0x801490C /end MEASUREMENT
/begin MEASUREMENT Rte_LrnEOT_CWPosition_HwDeg_f32 "MICROSAR RTE" FLOAT32_IEEE NO_COMPU_METHOD 0 0 1.175494351e-038 3.402823466e+038 ECU_ADDRESS 0x8014910 FORMAT "%.15" /end MEASUREMENT
/begin MEASUREMENT Rte_LrnEOT_LearnedEOT.CCWEOTFound_Cnt_lgc "MICROSAR RTE" UBYTE RTE_CM_BOOLEAN 0 0 0 255 READ_WRITE ECU_ADDRESS 0x8007275 /end MEASUREMENT
/begin MEASUREMENT Rte_LrnEOT_LearnedEOT.CCWEOTPosition_HwDeg_f32 "MICROSAR RTE" FLOAT32_IEEE NO_COMPU_METHOD 0 0 1.175494351e-038 3.402823466e+038 READ_WRITE ECU_ADDRESS 0x8007270 FORMAT "%.15" /end MEASUREMENT
/begin MEASUREMENT Rte_LrnEOT_LearnedEOT.CWEOTFound_Cnt_lgc "MICROSAR RTE" UBYTE RTE_CM_BOOLEAN 0 0 0 255 READ_WRITE ECU_ADDRESS 0x8007274 /end MEASUREMENT
/begin MEASUREMENT Rte_LrnEOT_LearnedEOT.CWEOTPosition_HwDeg_f32 "MICROSAR RTE" FLOAT32_IEEE NO_COMPU_METHOD 0 0 1.175494351e-038 3.402823466e+038 READ_WRITE ECU_ADDRESS 0x800726C FORMAT "%.15" /end MEASUREMENT
/begin MEASUREMENT Rte_ModeMachine_StaMd8_SystemState8_Mode "MICROSAR RTE" UBYTE RTE_CM_ENUM_StaMd_Mode 0 0 0 255 ECU_ADDRESS 0x801A0B9 /end MEASUREMENT
/begin MEASUREMENT Rte_MtrDrvDiag_FETFaultPhase_Cnt_enum "MICROSAR RTE" UBYTE RTE_CM_ENUM_FETPHASETYPE_ENUM 0 0 0 255 ECU_ADDRESS 0x80187D4 /end MEASUREMENT
/begin MEASUREMENT Rte_MtrDrvDiag_FETFaultType_Cnt_enum "MICROSAR RTE" UBYTE RTE_CM_ENUM_FETFAULTTYPE_ENUM 0 0 0 255 ECU_ADDRESS 0x80187D5 /end MEASUREMENT
/begin MEASUREMENT Rte_MtrDrvDiag_GateDriveResetActive_Cnt_lgc "MICROSAR RTE" UBYTE RTE_CM_BOOLEAN 0 0 0 255 ECU_ADDRESS 0x80187D6 /end MEASUREMENT
/begin MEASUREMENT Rte_MtrDrvDiag_MtrDrvrInitComplete_Cnt_lgc "MICROSAR RTE" UBYTE RTE_CM_BOOLEAN 0 0 0 255 ECU_ADDRESS 0x80187D7 /end MEASUREMENT
/begin MEASUREMENT Rte_MtrTempEst_AmbTemp_DegC_f32 "MICROSAR RTE" FLOAT32_IEEE NO_COMPU_METHOD 0 0 1.175494351e-038 3.402823466e+038 ECU_ADDRESS 0x8014978 FORMAT "%.15" /end MEASUREMENT
/begin MEASUREMENT Rte_MtrTempEst_CuTempEst_DegC_f32 "MICROSAR RTE" FLOAT32_IEEE NO_COMPU_METHOD 0 0 1.175494351e-038 3.402823466e+038 ECU_ADDRESS 0x8014918 FORMAT "%.15" /end MEASUREMENT
/begin MEASUREMENT Rte_MtrTempEst_EngTemp_DegC_f32 "MICROSAR RTE" FLOAT32_IEEE NO_COMPU_METHOD 0 0 1.175494351e-038 3.402823466e+038 ECU_ADDRESS 0x801497C FORMAT "%.15" /end MEASUREMENT
/begin MEASUREMENT Rte_MtrTempEst_MagTempEst_DegC_f32 "MICROSAR RTE" FLOAT32_IEEE NO_COMPU_METHOD 0 0 1.175494351e-038 3.402823466e+038 ECU_ADDRESS 0x801491C FORMAT "%.15" /end MEASUREMENT
/begin MEASUREMENT Rte_MtrTempEst_ScomAMDefeat_Cnt_lgc "MICROSAR RTE" UBYTE RTE_CM_BOOLEAN 0 0 0 255 ECU_ADDRESS 0x8014980 /end MEASUREMENT
/begin MEASUREMENT Rte_MtrTempEst_ScomTempDataRcvd_Cnt_lgc "MICROSAR RTE" UBYTE RTE_CM_BOOLEAN 0 0 0 255 ECU_ADDRESS 0x8014981 /end MEASUREMENT
/begin MEASUREMENT Rte_MtrTempEst_SiTempEst_DegC_f32 "MICROSAR RTE" FLOAT32_IEEE NO_COMPU_METHOD 0 0 1.175494351e-038 3.402823466e+038 ECU_ADDRESS 0x8014920 FORMAT "%.15" /end MEASUREMENT
/begin MEASUREMENT Rte_MtrVel2_SysCDiagHwVel_HwRadpS_f32 "MICROSAR RTE" FLOAT32_IEEE NO_COMPU_METHOD 0 0 1.175494351e-038 3.402823466e+038 ECU_ADDRESS 0x801A0A8 FORMAT "%.15" /end MEASUREMENT
/begin MEASUREMENT Rte_MtrVel2_SysCDiagMtrVelMRF_MtrRadpS_f32 "MICROSAR RTE" FLOAT32_IEEE NO_COMPU_METHOD 0 0 1.175494351e-038 3.402823466e+038 ECU_ADDRESS 0x801A0AC FORMAT "%.15" /end MEASUREMENT
/begin MEASUREMENT Rte_MtrVel_HwVelValid_Cnt_lgc "MICROSAR RTE" UBYTE RTE_CM_BOOLEAN 0 0 0 255 ECU_ADDRESS 0x80187DC /end MEASUREMENT
/begin MEASUREMENT Rte_MtrVel_SysCHandwheelVel_HwRadpS_f32 "MICROSAR RTE" FLOAT32_IEEE NO_COMPU_METHOD 0 0 1.175494351e-038 3.402823466e+038 ECU_ADDRESS 0x80187E8 FORMAT "%.15" /end MEASUREMENT
/begin MEASUREMENT Rte_MtrVel_SysCMotorVelMRF_MtrRadpS_f32 "MICROSAR RTE" FLOAT32_IEEE NO_COMPU_METHOD 0 0 1.175494351e-038 3.402823466e+038 ECU_ADDRESS 0x80187EC FORMAT "%.15" /end MEASUREMENT
/begin MEASUREMENT Rte_Nhet1_DigHwTrqT1_HwNm_f32 "MICROSAR RTE" FLOAT32_IEEE NO_COMPU_METHOD 0 0 1.175494351e-038 3.402823466e+038 ECU_ADDRESS 0x80187F0 FORMAT "%.15" /end MEASUREMENT
/begin MEASUREMENT Rte_Nhet1_DigHwTrqT2_HwNm_f32 "MICROSAR RTE" FLOAT32_IEEE NO_COMPU_METHOD 0 0 1.175494351e-038 3.402823466e+038 ECU_ADDRESS 0x80187F4 FORMAT "%.15" /end MEASUREMENT
/begin MEASUREMENT Rte_PICurrCntrl_DervLambdaAlphaDiag_Volt_f32 "This signal is intended to communicate any type voltage signal measured by the ecu.  This signal has a lower limit of 0 which reequires users of the signal to provide divide by 0 protection if it is used as a denominator in a calculation.  See Vecu port p" FLOAT32_IEEE NO_COMPU_METHOD 0 0 1.175494351e-038 3.402823466e+038 ECU_ADDRESS 0x80187F8 FORMAT "%.15" /end MEASUREMENT
/begin MEASUREMENT Rte_PICurrCntrl_DervLambdaBetaDiag_Volt_f32 "This signal is intended to communicate any type voltage signal measured by the ecu.  This signal has a lower limit of 0 which reequires users of the signal to provide divide by 0 protection if it is used as a denominator in a calculation.  See Vecu port p" FLOAT32_IEEE NO_COMPU_METHOD 0 0 1.175494351e-038 3.402823466e+038 ECU_ADDRESS 0x80187FC FORMAT "%.15" /end MEASUREMENT
/begin MEASUREMENT Rte_PeakCurrEst_EstPkCurr_AmpSq_f32 "MICROSAR RTE" FLOAT32_IEEE NO_COMPU_METHOD 0 0 1.175494351e-038 3.402823466e+038 ECU_ADDRESS 0x8018800 FORMAT "%.15" /end MEASUREMENT
/begin MEASUREMENT Rte_PeakCurrEst_FiltEstPkCurr_AmpSq_f32 "MICROSAR RTE" FLOAT32_IEEE NO_COMPU_METHOD 0 0 1.175494351e-038 3.402823466e+038 ECU_ADDRESS 0x8018804 FORMAT "%.15" /end MEASUREMENT
/begin MEASUREMENT Rte_PeakCurrEst_IvtrLoaMtgtnEn_Cnt_lgc "MICROSAR RTE" UBYTE RTE_CM_BOOLEAN 0 0 0 255 ECU_ADDRESS 0x80188B8 /end MEASUREMENT
/begin MEASUREMENT Rte_PeakCurrEst_MotCurrLoaMtgtnEn_Cnt_lgc "MICROSAR RTE" UBYTE RTE_CM_BOOLEAN 0 0 0 255 ECU_ADDRESS 0x80188B9 /end MEASUREMENT
/begin MEASUREMENT Rte_Polarity_HwPosPolarity_Cnt_s08 "MICROSAR RTE" SBYTE NO_COMPU_METHOD 0 0 -128 127 ECU_ADDRESS 0x8018809 FORMAT "%.15" /end MEASUREMENT
/begin MEASUREMENT Rte_Polarity_HwTrqPolarity_Cnt_s08 "MICROSAR RTE" SBYTE NO_COMPU_METHOD 0 0 -128 127 ECU_ADDRESS 0x801880A FORMAT "%.15" /end MEASUREMENT
/begin MEASUREMENT Rte_Polarity_MtrVelPolarity_Cnt_s08 "MICROSAR RTE" SBYTE NO_COMPU_METHOD 0 0 -128 127 ECU_ADDRESS 0x801880D FORMAT "%.15" /end MEASUREMENT
/begin MEASUREMENT Rte_Polarity_Polarity_Cnt_Str.Polarity_Cnt_b08 "MICROSAR RTE" UBYTE NO_COMPU_METHOD 0 0 0 255 READ_WRITE ECU_ADDRESS 0x80094C6 FORMAT "%.15" /end MEASUREMENT
/begin MEASUREMENT Rte_Polarity_Polarity_Cnt_Str.R_Polarity_Cnt_b08 "MICROSAR RTE" UBYTE NO_COMPU_METHOD 0 0 0 255 READ_WRITE ECU_ADDRESS 0x80094C7 FORMAT "%.15" /end MEASUREMENT
/begin MEASUREMENT Rte_Polarity_SysC_MtrElecMechPolarity_Cnt_s32 "MICROSAR RTE" SLONG NO_COMPU_METHOD 0 0 -2147483648 2147483647 ECU_ADDRESS 0x8018810 FORMAT "%.15" /end MEASUREMENT
/begin MEASUREMENT Rte_PwrLmtFuncCr_MRFMtrTrqCmd_MtrNm_f32 "MICROSAR RTE" FLOAT32_IEEE NO_COMPU_METHOD 0 0 1.175494351e-038 3.402823466e+038 ECU_ADDRESS 0x8018818 FORMAT "%.15" /end MEASUREMENT
/begin MEASUREMENT Rte_PwrLmtFuncCr_PosServEnable_Cnt_lgc "MICROSAR RTE" UBYTE RTE_CM_BOOLEAN 0 0 0 255 ECU_ADDRESS 0x80188BA /end MEASUREMENT
/begin MEASUREMENT Rte_PwrLmtFuncCr_ThresholdExceeded_Cnt_lgc "MICROSAR RTE" UBYTE RTE_CM_BOOLEAN 0 0 0 255 ECU_ADDRESS 0x801881C /end MEASUREMENT
/begin MEASUREMENT Rte_QuadDet_InstMtrDir_Cnt_s08 "MICROSAR RTE" SBYTE NO_COMPU_METHOD 0 0 -128 127 ECU_ADDRESS 0x801881D FORMAT "%.15" /end MEASUREMENT
/begin MEASUREMENT Rte_QuadDet_MtrQuad_Cnt_u08 "MICROSAR RTE" UBYTE NO_COMPU_METHOD 0 0 0 255 ECU_ADDRESS 0x801881E FORMAT "%.15" /end MEASUREMENT
/begin MEASUREMENT Rte_Return_PAReturnSclFct_Uls_f32 "MICROSAR RTE" FLOAT32_IEEE NO_COMPU_METHOD 0 0 1.175494351e-038 3.402823466e+038 ECU_ADDRESS 0x80188BC FORMAT "%.15" /end MEASUREMENT
/begin MEASUREMENT Rte_Return_ReturnCmd_MtrNm_f32 "MICROSAR RTE" FLOAT32_IEEE NO_COMPU_METHOD 0 0 1.175494351e-038 3.402823466e+038 ECU_ADDRESS 0x8018820 FORMAT "%.15" /end MEASUREMENT
/begin MEASUREMENT Rte_Return_ReturnDDFactor_Uls_f32 "MICROSAR RTE" FLOAT32_IEEE NO_COMPU_METHOD 0 0 1.175494351e-038 3.402823466e+038 ECU_ADDRESS 0x80188C0 FORMAT "%.15" /end MEASUREMENT
/begin MEASUREMENT Rte_Return_ReturnOffset_HwDeg_f32 "MICROSAR RTE" FLOAT32_IEEE NO_COMPU_METHOD 0 0 1.175494351e-038 3.402823466e+038 ECU_ADDRESS 0x80188C4 FORMAT "%.15" /end MEASUREMENT
/begin MEASUREMENT Rte_Sa_DigColPs_DigColPsEOL.ColTrim_Deg_f32 "MICROSAR RTE" FLOAT32_IEEE NO_COMPU_METHOD 0 0 1.175494351e-038 3.402823466e+038 READ_WRITE ECU_ADDRESS 0x80094C8 FORMAT "%.15" /end MEASUREMENT
/begin MEASUREMENT Rte_Sa_DigColPs_DigColPsEOL.R_ColTrim_Cnt_u32 "MICROSAR RTE" ULONG NO_COMPU_METHOD 0 0 0 4294967295 READ_WRITE ECU_ADDRESS 0x80094CC FORMAT "%.15" /end MEASUREMENT
/begin MEASUREMENT Rte_Sa_DigColPs_DigColPsEOL.R_SpurTrim_Cnt_u32 "MICROSAR RTE" ULONG NO_COMPU_METHOD 0 0 0 4294967295 READ_WRITE ECU_ADDRESS 0x80094D4 FORMAT "%.15" /end MEASUREMENT
/begin MEASUREMENT Rte_Sa_DigColPs_DigColPsEOL.R_TrimCom_Cnt_u16 "MICROSAR RTE" UWORD NO_COMPU_METHOD 0 0 0 65535 READ_WRITE ECU_ADDRESS 0x80094DA FORMAT "%.15" /end MEASUREMENT
/begin MEASUREMENT Rte_Sa_DigColPs_DigColPsEOL.SpurTrim_Deg_f32 "MICROSAR RTE" FLOAT32_IEEE NO_COMPU_METHOD 0 0 1.175494351e-038 3.402823466e+038 READ_WRITE ECU_ADDRESS 0x80094D0 FORMAT "%.15" /end MEASUREMENT
/begin MEASUREMENT Rte_Sa_DigColPs_DigColPsEOL.TrimComp_Cnt_u16 "MICROSAR RTE" UWORD NO_COMPU_METHOD 0 0 0 65535 READ_WRITE ECU_ADDRESS 0x80094D8 FORMAT "%.15" /end MEASUREMENT
/begin MEASUREMENT Rte_Sa_DigColPs_TrimComp_Cnt_lgc "MICROSAR RTE" UBYTE RTE_CM_BOOLEAN 0 0 0 255 ECU_ADDRESS 0x801882D /end MEASUREMENT
/begin MEASUREMENT Rte_SignlCondn_SrlCom_VehicleLonAccel_KphpS_f32 "MICROSAR RTE" FLOAT32_IEEE NO_COMPU_METHOD 0 0 1.175494351e-038 3.402823466e+038 ECU_ADDRESS 0x80188C8 FORMAT "%.15" /end MEASUREMENT
/begin MEASUREMENT Rte_SignlCondn_Vehicle_LonAccel_KphpS_f32 "MICROSAR RTE" FLOAT32_IEEE NO_COMPU_METHOD 0 0 1.175494351e-038 3.402823466e+038 ECU_ADDRESS 0x8018834 FORMAT "%.15" /end MEASUREMENT
/begin MEASUREMENT Rte_SrlComInput_DesiredTunPers_Cnt_u16 "MICROSAR RTE" UWORD NO_COMPU_METHOD 0 0 0 65535 ECU_ADDRESS 0x8014928 FORMAT "%.15" /end MEASUREMENT
/begin MEASUREMENT Rte_SrlComInput_SrlComVehSpd_Kph_f32 "MICROSAR RTE" FLOAT32_IEEE NO_COMPU_METHOD 0 0 1.175494351e-038 3.402823466e+038 ECU_ADDRESS 0x8014930 FORMAT "%.15" /end MEASUREMENT
/begin MEASUREMENT Rte_StOpCtrl_OutputRampMult_Uls_f32 "MICROSAR RTE" FLOAT32_IEEE NO_COMPU_METHOD 0 0 1.175494351e-038 3.402823466e+038 ECU_ADDRESS 0x8018838 FORMAT "%.15" /end MEASUREMENT
/begin MEASUREMENT Rte_StOpCtrl_RampDwnStatusComplete_Cnt_lgc "MICROSAR RTE" UBYTE RTE_CM_BOOLEAN 0 0 0 255 ECU_ADDRESS 0x801883C /end MEASUREMENT
/begin MEASUREMENT Rte_StaMd_InitiatePwrDnFastWrite_Cnt_lgc "MICROSAR RTE" UBYTE RTE_CM_BOOLEAN 0 0 0 255 ECU_ADDRESS 0x801883D /end MEASUREMENT
/begin MEASUREMENT Rte_StaMd_InitiatePwrDnNormalWrite_Cnt_lgc "MICROSAR RTE" UBYTE RTE_CM_BOOLEAN 0 0 0 255 ECU_ADDRESS 0x801883E /end MEASUREMENT
/begin MEASUREMENT Rte_StaMd_PwrDnFastWriteComplete_Cnt_lgc "MICROSAR RTE" UBYTE RTE_CM_BOOLEAN 0 0 0 255 ECU_ADDRESS 0x801883F /end MEASUREMENT
/begin MEASUREMENT Rte_StabilityComp2_AssistDDFactor_Uls_f32 "MICROSAR RTE" FLOAT32_IEEE NO_COMPU_METHOD 0 0 1.175494351e-038 3.402823466e+038 ECU_ADDRESS 0x801A0B4 FORMAT "%.15" /end MEASUREMENT
/begin MEASUREMENT Rte_StabilityComp2_SysAssistCmd_MtrNm_f32 "MICROSAR RTE" FLOAT32_IEEE NO_COMPU_METHOD 0 0 1.175494351e-038 3.402823466e+038 ECU_ADDRESS 0x801A0B0 FORMAT "%.15" /end MEASUREMENT
/begin MEASUREMENT Rte_StabilityComp_AssistDDFactor_Uls_f32 "MICROSAR RTE" FLOAT32_IEEE NO_COMPU_METHOD 0 0 1.175494351e-038 3.402823466e+038 ECU_ADDRESS 0x80188CC FORMAT "%.15" /end MEASUREMENT
/begin MEASUREMENT Rte_Sweep2_OutputMtrTrq_MtrNm_f32 "MICROSAR RTE" FLOAT32_IEEE NO_COMPU_METHOD 0 0 1.175494351e-038 3.402823466e+038 ECU_ADDRESS 0x8018848 FORMAT "%.15" /end MEASUREMENT
/begin MEASUREMENT Rte_ThrmlDutyCycle_IgnTimeOff_Cnt_u32 "MICROSAR RTE" ULONG NO_COMPU_METHOD 0 0 0 4294967295 ECU_ADDRESS 0x8014984 FORMAT "%.15" /end MEASUREMENT
/begin MEASUREMENT Rte_ThrmlDutyCycle_ThermalLimit_MtrNm_f32 "MICROSAR RTE" FLOAT32_IEEE NO_COMPU_METHOD 0 0 1.175494351e-038 3.402823466e+038 ECU_ADDRESS 0x8014948 FORMAT "%.15" /end MEASUREMENT
/begin MEASUREMENT Rte_ThrmlDutyCycle_ThrmlDutyCycle_FltStVal.Filt3Val_Cnt_u8 "MICROSAR RTE" UBYTE NO_COMPU_METHOD 0 0 0 255 READ_WRITE ECU_ADDRESS 0x8007278 FORMAT "%.15" /end MEASUREMENT
/begin MEASUREMENT Rte_ThrmlDutyCycle_ThrmlDutyCycle_FltStVal.Filt4Val_Cnt_u8 "MICROSAR RTE" UBYTE NO_COMPU_METHOD 0 0 0 255 READ_WRITE ECU_ADDRESS 0x8007279 FORMAT "%.15" /end MEASUREMENT
/begin MEASUREMENT Rte_ThrmlDutyCycle_ThrmlDutyCycle_FltStVal.Filt5Val_Cnt_u8 "MICROSAR RTE" UBYTE NO_COMPU_METHOD 0 0 0 255 READ_WRITE ECU_ADDRESS 0x800727A FORMAT "%.15" /end MEASUREMENT
/begin MEASUREMENT Rte_ThrmlDutyCycle_ThrmlDutyCycle_FltStVal.Filt6Val_Cnt_u8 "MICROSAR RTE" UBYTE NO_COMPU_METHOD 0 0 0 255 READ_WRITE ECU_ADDRESS 0x800727B FORMAT "%.15" /end MEASUREMENT
/begin MEASUREMENT Rte_ThrmlDutyCycle_VehTimeValid_Cnt_lgc "MICROSAR RTE" UBYTE RTE_CM_BOOLEAN 0 0 0 255 ECU_ADDRESS 0x8014988 /end MEASUREMENT
/begin MEASUREMENT Rte_TmprlMon_TMFTestComplete_Cnt_lgc "MICROSAR RTE" UBYTE RTE_CM_BOOLEAN 0 0 0 255 ECU_ADDRESS 0x801884C /end MEASUREMENT
/begin MEASUREMENT Rte_TrqCanc_CogTrqCal "MICROSAR RTE" UWORD NO_COMPU_METHOD 0 0 0 65535 READ_WRITE ECU_ADDRESS 0x800800E FORMAT "%.15" MATRIX_DIM 512 1 1 LAYOUT ROW_DIR /end MEASUREMENT
/begin MEASUREMENT Rte_TrqCanc_CogTrqRplComp "MICROSAR RTE" UWORD NO_COMPU_METHOD 0 0 0 65535 READ_WRITE ECU_ADDRESS 0x800840E FORMAT "%.15" MATRIX_DIM 9 1 1 LAYOUT ROW_DIR /end MEASUREMENT
/begin MEASUREMENT Rte_TrqCmdScl_MRFMtrTrqCmdScl_MtrNm_f32 "MICROSAR RTE" FLOAT32_IEEE NO_COMPU_METHOD 0 0 1.175494351e-038 3.402823466e+038 ECU_ADDRESS 0x8018850 FORMAT "%.15" /end MEASUREMENT
/begin MEASUREMENT Rte_TrqCmdScl_TorqueCmdSF_Uls_f32 "MICROSAR RTE" FLOAT32_IEEE NO_COMPU_METHOD 0 0 1.175494351e-038 3.402823466e+038 READ_WRITE ECU_ADDRESS 0x8008008 FORMAT "%.15" /end MEASUREMENT
/begin MEASUREMENT Rte_VehDyn_MotPosReset.NVMStoredLastPosValid_Cnt_lgc "MICROSAR RTE" UBYTE RTE_CM_BOOLEAN 0 0 0 255 READ_WRITE ECU_ADDRESS 0x80094E0 /end MEASUREMENT
/begin MEASUREMENT Rte_VehDyn_MotPosReset.NVMStoredLastPos_HwDeg_f32 "MICROSAR RTE" FLOAT32_IEEE NO_COMPU_METHOD 0 0 1.175494351e-038 3.402823466e+038 READ_WRITE ECU_ADDRESS 0x80094DC FORMAT "%.15" /end MEASUREMENT
/begin MEASUREMENT Rte_VehPwrMd_ATermActive_Cnt_lgc "MICROSAR RTE" UBYTE RTE_CM_BOOLEAN 0 0 0 255 ECU_ADDRESS 0x801494C /end MEASUREMENT
/begin MEASUREMENT Rte_VehPwrMd_CTermActive_Cnt_lgc "MICROSAR RTE" UBYTE RTE_CM_BOOLEAN 0 0 0 255 ECU_ADDRESS 0x801494D /end MEASUREMENT
/begin MEASUREMENT Rte_VehPwrMd_OperRampRate_XpmS_f32 "MICROSAR RTE" FLOAT32_IEEE NO_COMPU_METHOD 0 0 1.175494351e-038 3.402823466e+038 ECU_ADDRESS 0x8014950 FORMAT "%.15" /end MEASUREMENT
/begin MEASUREMENT Rte_VehPwrMd_OperRampValue_Uls_f32 "MICROSAR RTE" FLOAT32_IEEE NO_COMPU_METHOD 0 0 1.175494351e-038 3.402823466e+038 ECU_ADDRESS 0x8014954 FORMAT "%.15" /end MEASUREMENT
/begin MEASUREMENT Rte_VehSpdLmt_AstVehSpdLimit_MtrNm_f32 "MICROSAR RTE" FLOAT32_IEEE NO_COMPU_METHOD 0 0 1.175494351e-038 3.402823466e+038 ECU_ADDRESS 0x801495C FORMAT "%.15" /end MEASUREMENT
/begin MEASUREMENT SrlComVehSpd_Kph_M_f32 "" FLOAT32_IEEE NO_COMPU_METHOD 0 0 0 255 ECU_ADDRESS 0x80149DC FORMAT "%.15" /end MEASUREMENT
/begin MEASUREMENT StartStopSts_Cnt_M_u8 "" UBYTE NO_COMPU_METHOD 0 0 0 255 ECU_ADDRESS 0x80149FE FORMAT "%.15" /end MEASUREMENT
/begin MEASUREMENT VehSpeedFailSts_Cnt_M_lgc "" UBYTE NO_COMPU_METHOD 0 0 0 255 ECU_ADDRESS 0x8014A10 FORMAT "%.15" /end MEASUREMENT
/begin MEASUREMENT k_CustDIDCals_Cnt_u08.CalibrationSwIdentification_DIDF182_ASCII_u08 "" UBYTE NO_COMPU_METHOD 0 0 0 255 ECU_ADDRESS 0x80027 FORMAT "%.15" /end MEASUREMENT
/begin MEASUREMENT k_CustDIDCals_Cnt_u08.CalibrationSwIdentification_DIDF182_ASCII_u08._10_ "" UBYTE NO_COMPU_METHOD 0 0 0 255 ECU_ADDRESS 0x80031 FORMAT "%.15" /end MEASUREMENT
/begin MEASUREMENT k_CustDIDCals_Cnt_u08.CalibrationSwIdentification_DIDF182_ASCII_u08._11_ "" UBYTE NO_COMPU_METHOD 0 0 0 255 ECU_ADDRESS 0x80032 FORMAT "%.15" /end MEASUREMENT
/begin MEASUREMENT k_CustDIDCals_Cnt_u08.CalibrationSwIdentification_DIDF182_ASCII_u08._12_ "" UBYTE NO_COMPU_METHOD 0 0 0 255 ECU_ADDRESS 0x80033 FORMAT "%.15" /end MEASUREMENT
/begin MEASUREMENT k_CustDIDCals_Cnt_u08.CalibrationSwIdentification_DIDF182_ASCII_u08._13_ "" UBYTE NO_COMPU_METHOD 0 0 0 255 ECU_ADDRESS 0x80034 FORMAT "%.15" /end MEASUREMENT
/begin MEASUREMENT k_CustDIDCals_Cnt_u08.CalibrationSwIdentification_DIDF182_ASCII_u08._1_ "" UBYTE NO_COMPU_METHOD 0 0 0 255 ECU_ADDRESS 0x80028 FORMAT "%.15" /end MEASUREMENT
/begin MEASUREMENT k_CustDIDCals_Cnt_u08.CalibrationSwIdentification_DIDF182_ASCII_u08._2_ "" UBYTE NO_COMPU_METHOD 0 0 0 255 ECU_ADDRESS 0x80029 FORMAT "%.15" /end MEASUREMENT
/begin MEASUREMENT k_CustDIDCals_Cnt_u08.CalibrationSwIdentification_DIDF182_ASCII_u08._3_ "" UBYTE NO_COMPU_METHOD 0 0 0 255 ECU_ADDRESS 0x8002A FORMAT "%.15" /end MEASUREMENT
/begin MEASUREMENT k_CustDIDCals_Cnt_u08.CalibrationSwIdentification_DIDF182_ASCII_u08._4_ "" UBYTE NO_COMPU_METHOD 0 0 0 255 ECU_ADDRESS 0x8002B FORMAT "%.15" /end MEASUREMENT
/begin MEASUREMENT k_CustDIDCals_Cnt_u08.CalibrationSwIdentification_DIDF182_ASCII_u08._5_ "" UBYTE NO_COMPU_METHOD 0 0 0 255 ECU_ADDRESS 0x8002C FORMAT "%.15" /end MEASUREMENT
/begin MEASUREMENT k_CustDIDCals_Cnt_u08.CalibrationSwIdentification_DIDF182_ASCII_u08._6_ "" UBYTE NO_COMPU_METHOD 0 0 0 255 ECU_ADDRESS 0x8002D FORMAT "%.15" /end MEASUREMENT
/begin MEASUREMENT k_CustDIDCals_Cnt_u08.CalibrationSwIdentification_DIDF182_ASCII_u08._7_ "" UBYTE NO_COMPU_METHOD 0 0 0 255 ECU_ADDRESS 0x8002E FORMAT "%.15" /end MEASUREMENT
/begin MEASUREMENT k_CustDIDCals_Cnt_u08.CalibrationSwIdentification_DIDF182_ASCII_u08._8_ "" UBYTE NO_COMPU_METHOD 0 0 0 255 ECU_ADDRESS 0x8002F FORMAT "%.15" /end MEASUREMENT
/begin MEASUREMENT k_CustDIDCals_Cnt_u08.CalibrationSwIdentification_DIDF182_ASCII_u08._9_ "" UBYTE NO_COMPU_METHOD 0 0 0 255 ECU_ADDRESS 0x80030 FORMAT "%.15" /end MEASUREMENT
/begin MEASUREMENT k_CustDIDCals_Cnt_u08.DiagnosticIdentification_DIDF100_ASCII_u08._0_ "" UBYTE NO_COMPU_METHOD 0 0 0 255 ECU_ADDRESS 0x80020 FORMAT "%.15" /end MEASUREMENT
/begin MEASUREMENT k_CustDIDCals_Cnt_u08.DiagnosticIdentification_DIDF100_ASCII_u08._1 "" UBYTE NO_COMPU_METHOD 0 0 0 255 ECU_ADDRESS 0x80021 FORMAT "%.15" SYMBOL_LINK "k_CustDIDCals_Cnt_u08.DiagnosticIdentification_DIDF100_ASCII_u08._1_" 0 /end MEASUREMENT
/begin MEASUREMENT k_CustDIDCals_Cnt_u08.DiagnosticIdentification_DIDF100_ASCII_u08._2 "" UBYTE NO_COMPU_METHOD 0 0 0 255 ECU_ADDRESS 0x80022 FORMAT "%.15" SYMBOL_LINK "k_CustDIDCals_Cnt_u08.DiagnosticIdentification_DIDF100_ASCII_u08._2_" 0 /end MEASUREMENT
/begin MEASUREMENT k_CustDIDCals_Cnt_u08.DiagnosticIdentification_DIDF100_ASCII_u08._3 "" UBYTE NO_COMPU_METHOD 0 0 0 255 ECU_ADDRESS 0x80023 FORMAT "%.15" SYMBOL_LINK "k_CustDIDCals_Cnt_u08.DiagnosticIdentification_DIDF100_ASCII_u08._3_" 0 /end MEASUREMENT
/begin MEASUREMENT k_CustDIDCals_Cnt_u08.DiagnosticIdentification_DIDF100_ASCII_u08._4 "" UBYTE NO_COMPU_METHOD 0 0 0 255 ECU_ADDRESS 0x80024 FORMAT "%.15" SYMBOL_LINK "k_CustDIDCals_Cnt_u08.DiagnosticIdentification_DIDF100_ASCII_u08._4_" 0 /end MEASUREMENT
/begin MEASUREMENT k_CustDIDCals_Cnt_u08.DiagnosticIdentification_DIDF100_ASCII_u08._5 "" UBYTE NO_COMPU_METHOD 0 0 0 255 ECU_ADDRESS 0x80025 FORMAT "%.15" SYMBOL_LINK "k_CustDIDCals_Cnt_u08.DiagnosticIdentification_DIDF100_ASCII_u08._5_" 0 /end MEASUREMENT
/begin MEASUREMENT k_CustDIDCals_Cnt_u08.DiagnosticIdentification_DIDF100_ASCII_u08._6 "" UBYTE NO_COMPU_METHOD 0 0 0 255 ECU_ADDRESS 0x80026 FORMAT "%.15" SYMBOL_LINK "k_CustDIDCals_Cnt_u08.DiagnosticIdentification_DIDF100_ASCII_u08._6_" 0 /end MEASUREMENT
/begin MEASUREMENT k_CustDIDCals_Cnt_u08.SupplierManfECUHwPartNo_DIDF191_ASCII_u08._0 "" UBYTE NO_COMPU_METHOD 0 0 0 255 ECU_ADDRESS 0x80056 FORMAT "%.15" SYMBOL_LINK "k_CustDIDCals_Cnt_u08.VehicleManfECUHwNo_DIDF191_ASCII_u08._0_" 0 /end MEASUREMENT
/begin MEASUREMENT k_CustDIDCals_Cnt_u08.SupplierManfECUHwPartNo_DIDF191_ASCII_u08._1 "" UBYTE NO_COMPU_METHOD 0 0 0 255 ECU_ADDRESS 0x80057 FORMAT "%.15" SYMBOL_LINK "k_CustDIDCals_Cnt_u08.VehicleManfECUHwNo_DIDF191_ASCII_u08._1_" 0 /end MEASUREMENT
/begin MEASUREMENT k_CustDIDCals_Cnt_u08.SupplierManfECUHwPartNo_DIDF191_ASCII_u08._10 "" UBYTE NO_COMPU_METHOD 0 0 0 255 ECU_ADDRESS 0x80060 FORMAT "%.15" SYMBOL_LINK "k_CustDIDCals_Cnt_u08.VehicleManfECUHwNo_DIDF191_ASCII_u08._10_" 0 /end MEASUREMENT
/begin MEASUREMENT k_CustDIDCals_Cnt_u08.SupplierManfECUHwPartNo_DIDF191_ASCII_u08._2 "" UBYTE NO_COMPU_METHOD 0 0 0 255 ECU_ADDRESS 0x80058 FORMAT "%.15" SYMBOL_LINK "k_CustDIDCals_Cnt_u08.VehicleManfECUHwNo_DIDF191_ASCII_u08._2_" 0 /end MEASUREMENT
/begin MEASUREMENT k_CustDIDCals_Cnt_u08.SupplierManfECUHwPartNo_DIDF191_ASCII_u08._3 "" UBYTE NO_COMPU_METHOD 0 0 0 255 ECU_ADDRESS 0x80059 FORMAT "%.15" SYMBOL_LINK "k_CustDIDCals_Cnt_u08.VehicleManfECUHwNo_DIDF191_ASCII_u08._3_" 0 /end MEASUREMENT
/begin MEASUREMENT k_CustDIDCals_Cnt_u08.SupplierManfECUHwPartNo_DIDF191_ASCII_u08._4 "" UBYTE NO_COMPU_METHOD 0 0 0 255 ECU_ADDRESS 0x8005A FORMAT "%.15" SYMBOL_LINK "k_CustDIDCals_Cnt_u08.VehicleManfECUHwNo_DIDF191_ASCII_u08._4_" 0 /end MEASUREMENT
/begin MEASUREMENT k_CustDIDCals_Cnt_u08.SupplierManfECUHwPartNo_DIDF191_ASCII_u08._5 "" UBYTE NO_COMPU_METHOD 0 0 0 255 ECU_ADDRESS 0x8005B FORMAT "%.15" SYMBOL_LINK "k_CustDIDCals_Cnt_u08.VehicleManfECUHwNo_DIDF191_ASCII_u08._5_" 0 /end MEASUREMENT
/begin MEASUREMENT k_CustDIDCals_Cnt_u08.SupplierManfECUHwPartNo_DIDF191_ASCII_u08._6 "" UBYTE NO_COMPU_METHOD 0 0 0 255 ECU_ADDRESS 0x8005C FORMAT "%.15" SYMBOL_LINK "k_CustDIDCals_Cnt_u08.VehicleManfECUHwNo_DIDF191_ASCII_u08._6_" 0 /end MEASUREMENT
/begin MEASUREMENT k_CustDIDCals_Cnt_u08.SupplierManfECUHwPartNo_DIDF191_ASCII_u08._7 "" UBYTE NO_COMPU_METHOD 0 0 0 255 ECU_ADDRESS 0x8005D FORMAT "%.15" SYMBOL_LINK "k_CustDIDCals_Cnt_u08.VehicleManfECUHwNo_DIDF191_ASCII_u08._7_" 0 /end MEASUREMENT
/begin MEASUREMENT k_CustDIDCals_Cnt_u08.SupplierManfECUHwPartNo_DIDF191_ASCII_u08._8 "" UBYTE NO_COMPU_METHOD 0 0 0 255 ECU_ADDRESS 0x8005E FORMAT "%.15" SYMBOL_LINK "k_CustDIDCals_Cnt_u08.VehicleManfECUHwNo_DIDF191_ASCII_u08._8_" 0 /end MEASUREMENT
/begin MEASUREMENT k_CustDIDCals_Cnt_u08.SupplierManfECUHwPartNo_DIDF191_ASCII_u08._9 "" UBYTE NO_COMPU_METHOD 0 0 0 255 ECU_ADDRESS 0x8005F FORMAT "%.15" SYMBOL_LINK "k_CustDIDCals_Cnt_u08.VehicleManfECUHwNo_DIDF191_ASCII_u08._9_" 0 /end MEASUREMENT
/begin MEASUREMENT k_CustDIDCals_Cnt_u08.SupplierManfECUHwPartNo_DIDF192_ASCII_u08._0 "" UBYTE NO_COMPU_METHOD 0 0 0 255 ECU_ADDRESS 0x80061 FORMAT "%.15" SYMBOL_LINK "k_CustDIDCals_Cnt_u08.SupplierManfECUHwPartNo_DIDF192_ASCII_u08._0_" 0 /end MEASUREMENT
/begin MEASUREMENT k_CustDIDCals_Cnt_u08.SupplierManfECUHwPartNo_DIDF192_ASCII_u08._1 "" UBYTE NO_COMPU_METHOD 0 0 0 255 ECU_ADDRESS 0x80062 FORMAT "%.15" SYMBOL_LINK "k_CustDIDCals_Cnt_u08.SupplierManfECUHwPartNo_DIDF192_ASCII_u08._1_" 0 /end MEASUREMENT
/begin MEASUREMENT k_CustDIDCals_Cnt_u08.SupplierManfECUHwPartNo_DIDF192_ASCII_u08._10 "" UBYTE NO_COMPU_METHOD 0 0 0 255 ECU_ADDRESS 0x8006B FORMAT "%.15" SYMBOL_LINK "k_CustDIDCals_Cnt_u08.SupplierManfECUHwPartNo_DIDF192_ASCII_u08._10_" 0 /end MEASUREMENT
/begin MEASUREMENT k_CustDIDCals_Cnt_u08.SupplierManfECUHwPartNo_DIDF192_ASCII_u08._2 "" UBYTE NO_COMPU_METHOD 0 0 0 255 ECU_ADDRESS 0x80063 FORMAT "%.15" SYMBOL_LINK "k_CustDIDCals_Cnt_u08.SupplierManfECUHwPartNo_DIDF192_ASCII_u08._2_" 0 /end MEASUREMENT
/begin MEASUREMENT k_CustDIDCals_Cnt_u08.SupplierManfECUHwPartNo_DIDF192_ASCII_u08._3 "" UBYTE NO_COMPU_METHOD 0 0 0 255 ECU_ADDRESS 0x80064 FORMAT "%.15" SYMBOL_LINK "k_CustDIDCals_Cnt_u08.SupplierManfECUHwPartNo_DIDF192_ASCII_u08._3_" 0 /end MEASUREMENT
/begin MEASUREMENT k_CustDIDCals_Cnt_u08.SupplierManfECUHwPartNo_DIDF192_ASCII_u08._4 "" UBYTE NO_COMPU_METHOD 0 0 0 255 ECU_ADDRESS 0x80065 FORMAT "%.15" SYMBOL_LINK "k_CustDIDCals_Cnt_u08.SupplierManfECUHwPartNo_DIDF192_ASCII_u08._4_" 0 /end MEASUREMENT
/begin MEASUREMENT k_CustDIDCals_Cnt_u08.SupplierManfECUHwPartNo_DIDF192_ASCII_u08._5 "" UBYTE NO_COMPU_METHOD 0 0 0 255 ECU_ADDRESS 0x80066 FORMAT "%.15" SYMBOL_LINK "k_CustDIDCals_Cnt_u08.SupplierManfECUHwPartNo_DIDF192_ASCII_u08._5_" 0 /end MEASUREMENT
/begin MEASUREMENT k_CustDIDCals_Cnt_u08.SupplierManfECUHwPartNo_DIDF192_ASCII_u08._6 "" UBYTE NO_COMPU_METHOD 0 0 0 255 ECU_ADDRESS 0x80067 FORMAT "%.15" SYMBOL_LINK "k_CustDIDCals_Cnt_u08.SupplierManfECUHwPartNo_DIDF192_ASCII_u08._6_" 0 /end MEASUREMENT
/begin MEASUREMENT k_CustDIDCals_Cnt_u08.SupplierManfECUHwPartNo_DIDF192_ASCII_u08._7 "" UBYTE NO_COMPU_METHOD 0 0 0 255 ECU_ADDRESS 0x80068 FORMAT "%.15" SYMBOL_LINK "k_CustDIDCals_Cnt_u08.SupplierManfECUHwPartNo_DIDF192_ASCII_u08._7_" 0 /end MEASUREMENT
/begin MEASUREMENT k_CustDIDCals_Cnt_u08.SupplierManfECUHwPartNo_DIDF192_ASCII_u08._8 "" UBYTE NO_COMPU_METHOD 0 0 0 255 ECU_ADDRESS 0x80069 FORMAT "%.15" SYMBOL_LINK "k_CustDIDCals_Cnt_u08.SupplierManfECUHwPartNo_DIDF192_ASCII_u08._8_" 0 /end MEASUREMENT
/begin MEASUREMENT k_CustDIDCals_Cnt_u08.SupplierManfECUHwPartNo_DIDF192_ASCII_u08._9 "" UBYTE NO_COMPU_METHOD 0 0 0 255 ECU_ADDRESS 0x8006A FORMAT "%.15" SYMBOL_LINK "k_CustDIDCals_Cnt_u08.SupplierManfECUHwPartNo_DIDF192_ASCII_u08._9_" 0 /end MEASUREMENT
/begin MEASUREMENT k_CustDIDCals_Cnt_u08.SupplierManfECUHwVerNo_DIDF193_ASCII_u08 "" UBYTE NO_COMPU_METHOD 0 0 0 255 ECU_ADDRESS 0x8006C FORMAT "%.15" /end MEASUREMENT
/begin MEASUREMENT k_CustDIDCals_Cnt_u08.VehicleManfECUSwNo_DIDF188_ASCII_u08._0_ "" UBYTE NO_COMPU_METHOD 0 0 0 255 ECU_ADDRESS 0x8004B FORMAT "%.15" /end MEASUREMENT
/begin MEASUREMENT k_CustDIDCals_Cnt_u08.VehicleManfECUSwNo_DIDF188_ASCII_u08._10_ "" UBYTE NO_COMPU_METHOD 0 0 0 255 ECU_ADDRESS 0x80055 FORMAT "%.15" /end MEASUREMENT
/begin MEASUREMENT k_CustDIDCals_Cnt_u08.VehicleManfECUSwNo_DIDF188_ASCII_u08._1_ "" UBYTE NO_COMPU_METHOD 0 0 0 255 ECU_ADDRESS 0x8004C FORMAT "%.15" /end MEASUREMENT
/begin MEASUREMENT k_CustDIDCals_Cnt_u08.VehicleManfECUSwNo_DIDF188_ASCII_u08._2_ "" UBYTE NO_COMPU_METHOD 0 0 0 255 ECU_ADDRESS 0x8004D FORMAT "%.15" /end MEASUREMENT
/begin MEASUREMENT k_CustDIDCals_Cnt_u08.VehicleManfECUSwNo_DIDF188_ASCII_u08._3_ "" UBYTE NO_COMPU_METHOD 0 0 0 255 ECU_ADDRESS 0x8004E FORMAT "%.15" /end MEASUREMENT
/begin MEASUREMENT k_CustDIDCals_Cnt_u08.VehicleManfECUSwNo_DIDF188_ASCII_u08._4_ "" UBYTE NO_COMPU_METHOD 0 0 0 255 ECU_ADDRESS 0x8004F FORMAT "%.15" /end MEASUREMENT
/begin MEASUREMENT k_CustDIDCals_Cnt_u08.VehicleManfECUSwNo_DIDF188_ASCII_u08._5_ "" UBYTE NO_COMPU_METHOD 0 0 0 255 ECU_ADDRESS 0x80050 FORMAT "%.15" /end MEASUREMENT
/begin MEASUREMENT k_CustDIDCals_Cnt_u08.VehicleManfECUSwNo_DIDF188_ASCII_u08._6_ "" UBYTE NO_COMPU_METHOD 0 0 0 255 ECU_ADDRESS 0x80051 FORMAT "%.15" /end MEASUREMENT
/begin MEASUREMENT k_CustDIDCals_Cnt_u08.VehicleManfECUSwNo_DIDF188_ASCII_u08._7_ "" UBYTE NO_COMPU_METHOD 0 0 0 255 ECU_ADDRESS 0x80052 FORMAT "%.15" /end MEASUREMENT
/begin MEASUREMENT k_CustDIDCals_Cnt_u08.VehicleManfECUSwNo_DIDF188_ASCII_u08._8_ "" UBYTE NO_COMPU_METHOD 0 0 0 255 ECU_ADDRESS 0x80053 FORMAT "%.15" /end MEASUREMENT
/begin MEASUREMENT k_CustDIDCals_Cnt_u08.VehicleManfECUSwNo_DIDF188_ASCII_u08._9_ "" UBYTE NO_COMPU_METHOD 0 0 0 255 ECU_ADDRESS 0x80054 FORMAT "%.15" /end MEASUREMENT
/begin GROUP CtrldDisShtdn.SumLimTrqCmd.MtrNm_f32 "MICROSAR RTE" /begin REF_MEASUREMENT Rte_Sweep2_OutputMtrTrq_MtrNm_f32 /end REF_MEASUREMENT /end GROUP
/begin GROUP CtrldDisShtdn.SysC_CRFMtrTrqCmd.MtrNm_f32 "MICROSAR RTE" /begin REF_MEASUREMENT Rte_CtrldDisShtdn_SysC_CRFMtrTrqCmd_MtrNm_f32 /end REF_MEASUREMENT /end GROUP
/begin GROUP CtrldDisShtdn.SysC_MRFMtrTrqCmd.MtrNm_f32 "MICROSAR RTE" /begin REF_MEASUREMENT Rte_CtrldDisShtdn_SysC_MRFMtrTrqCmd_MtrNm_f32 /end REF_MEASUREMENT /end GROUP
/begin GROUP CtrlTemp "MICROSAR RTE" /begin SUB_GROUP CtrlTemp.ReceiverPorts CtrlTemp.SenderPorts /end SUB_GROUP /end GROUP
/begin GROUP CtrlTemp.AmbTemp.DegC_f32 "MICROSAR RTE" /begin REF_MEASUREMENT Rte_CtrlTemp_AmbTemp_DegC_f32 /end REF_MEASUREMENT /end GROUP
/begin GROUP CtrlTemp.DiagStsTempRdPrf.Cnt_lgc "MICROSAR RTE" /begin REF_MEASUREMENT Rte_DiagMgr10_DiagStsDefTemp_Cnt_lgc /end REF_MEASUREMENT /end GROUP
/begin GROUP CtrlTemp.ReceiverPorts "MICROSAR RTE"
 /begin SUB_GROUP CtrlTemp.AmbTemp.DegC_f32 CtrlTemp.DiagStsTempRdPrf.Cnt_lgc CtrlTemp.TemperatureADC.Volt_f32 /end SUB_GROUP
/end GROUP
/begin GROUP CtrlTemp.SenderPorts "MICROSAR RTE" /begin SUB_GROUP CtrlTemp.FiltMeasTemp.DegC_f32 /end SUB_GROUP /end GROUP
/begin GROUP CtrlTemp.TemperatureADC.Volt_f32 "MICROSAR RTE" /begin REF_MEASUREMENT Rte_IoHwAbstractionUsr_TemperatureADC_Volt_f32 /end REF_MEASUREMENT /end GROUP
/begin GROUP CurrCmd "MICROSAR RTE" /begin SUB_GROUP CurrCmd.ReceiverPorts CurrCmd.SenderPorts /end SUB_GROUP /end GROUP
/begin GROUP CurrCmd.EstKe.VpRadpS_f32 "MICROSAR RTE" /begin REF_MEASUREMENT Rte_CurrParamComp_EstKe_VpRadpS_f32 /end REF_MEASUREMENT /end GROUP
/begin GROUP CurrCmd.EstLd.Henry_f32 "MICROSAR RTE" /begin REF_MEASUREMENT Rte_CurrParamComp_EstLd_Henry_f32 /end REF_MEASUREMENT /end GROUP
/begin GROUP CurrCmd.EstLq.Henry_f32 "MICROSAR RTE" /begin REF_MEASUREMENT Rte_CurrParamComp_EstLq_Henry_f32 /end REF_MEASUREMENT /end GROUP
/begin GROUP CurrCmd.EstR.Ohm_f32 "MICROSAR RTE" /begin REF_MEASUREMENT Rte_CurrParamComp_EstR_Ohm_f32 /end REF_MEASUREMENT /end GROUP
/begin GROUP CurrCmd.IvtrLoaMtgtnEn.Cnt_lgc "MICROSAR RTE" /begin REF_MEASUREMENT Rte_CurrCmd_IvtrLoaMtgtnEn_Cnt_lgc /end REF_MEASUREMENT /end GROUP
/begin GROUP CurrCmd.MotCurrLoaMtgtnEn.Cnt_lgc "MICROSAR RTE" /begin REF_MEASUREMENT Rte_CurrCmd_MotCurrLoaMtgtnEn_Cnt_lgc /end REF_MEASUREMENT /end GROUP
/begin GROUP CurrCmd.MRFTrqCmdScl.MtrNm_f32 "MICROSAR RTE" /begin REF_MEASUREMENT Rte_TrqCmdScl_MRFMtrTrqCmdScl_MtrNm_f32 /end REF_MEASUREMENT /end GROUP
/begin GROUP CurrCmd.MtrCurrDaxRef.Amp_f32 "MICROSAR RTE" /begin REF_MEASUREMENT Rte_CurrCmd_MtrCurrDaxRef_Amp_f32 /end REF_MEASUREMENT /end GROUP
/begin GROUP CurrCmd.MtrCurrQaxRef.Amp_f32 "MICROSAR RTE" /begin REF_MEASUREMENT Rte_CurrCmd_MtrCurrQaxRef_Amp_f32 /end REF_MEASUREMENT /end GROUP
/begin GROUP CurrCmd.MtrQuad.Cnt_u08 "MICROSAR RTE" /begin REF_MEASUREMENT Rte_QuadDet_MtrQuad_Cnt_u08 /end REF_MEASUREMENT /end GROUP
/begin GROUP CurrCmd.ReceiverPorts "MICROSAR RTE"
 /begin SUB_GROUP CurrCmd.CurrentGainSvc.Cnt_lgc CurrCmd.EstKe.VpRadpS_f32 CurrCmd.EstLd.Henry_f32 CurrCmd.EstLq.Henry_f32 CurrCmd.EstR.Ohm_f32 CurrCmd.IvtrLoaMtgtnEn.Cnt_lgc CurrCmd.MotCurrLoaMtgtnEn.Cnt_lgc CurrCmd.MRFMtrVel.MtrRadpS_f32 CurrCmd.MRFTrqCmdScl.MtrNm_f32 CurrCmd.MtrQuad.Cnt_u08 CurrCmd.Vecu.Volt_f32 CurrCmd.VehSpd.Kph_f32 /end SUB_GROUP
/end GROUP
/begin GROUP CurrCmd.SenderPorts "MICROSAR RTE"
 /begin SUB_GROUP CurrCmd.MtrCurrAngle.Rev_f32 CurrCmd.MtrCurrDaxRef.Amp_f32 CurrCmd.MtrCurrQaxRef.Amp_f32 /end SUB_GROUP
/end GROUP
/begin GROUP CurrParamComp "MICROSAR RTE"
 /begin SUB_GROUP CurrParamComp.PerInstanceMemories CurrParamComp.ReceiverPorts CurrParamComp.SenderPorts /end SUB_GROUP
/end GROUP
/begin GROUP CurrParamComp.CuTempEst.DegC_f32 "MICROSAR RTE" /begin REF_MEASUREMENT Rte_MtrTempEst_CuTempEst_DegC_f32 /end REF_MEASUREMENT /end GROUP
/begin GROUP CurrParamComp.EOLNomMtrParam "MICROSAR RTE"
 /begin REF_MEASUREMENT Rte_CurrParamComp_EOLNomMtrParam.NomKe_VpRadpS_f32 Rte_CurrParamComp_EOLNomMtrParam.NomRmtr_Ohm_f32 /end REF_MEASUREMENT
/end GROUP
/begin GROUP CurrParamComp.EstKe.VpRadpS_f32 "MICROSAR RTE" /begin REF_MEASUREMENT Rte_CurrParamComp_EstKe_VpRadpS_f32 /end REF_MEASUREMENT /end GROUP
/begin GROUP CurrParamComp.EstLd.Henry_f32 "MICROSAR RTE" /begin REF_MEASUREMENT Rte_CurrParamComp_EstLd_Henry_f32 /end REF_MEASUREMENT /end GROUP
/begin GROUP CurrParamComp.EstLq.Henry_f32 "MICROSAR RTE" /begin REF_MEASUREMENT Rte_CurrParamComp_EstLq_Henry_f32 /end REF_MEASUREMENT /end GROUP
/begin GROUP CurrParamComp.EstR.Ohm_f32 "MICROSAR RTE" /begin REF_MEASUREMENT Rte_CurrParamComp_EstR_Ohm_f32 /end REF_MEASUREMENT /end GROUP
/begin GROUP CurrParamComp.MagTempEst.DegC_f32 "MICROSAR RTE" /begin REF_MEASUREMENT Rte_MtrTempEst_MagTempEst_DegC_f32 /end REF_MEASUREMENT /end GROUP
/begin GROUP CurrParamComp.MtrCurrDaxRef.Amp_f32 "MICROSAR RTE" /begin REF_MEASUREMENT Rte_CurrCmd_MtrCurrDaxRef_Amp_f32 /end REF_MEASUREMENT /end GROUP
/begin GROUP CurrParamComp.MtrCurrQaxRef.Amp_f32 "MICROSAR RTE" /begin REF_MEASUREMENT Rte_CurrCmd_MtrCurrQaxRef_Amp_f32 /end REF_MEASUREMENT /end GROUP
/begin GROUP CurrParamComp.PerInstanceMemories "MICROSAR RTE" /begin SUB_GROUP CurrParamComp.EOLNomMtrParam /end SUB_GROUP /end GROUP
/begin GROUP CurrParamComp.ReceiverPorts "MICROSAR RTE"
 /begin SUB_GROUP CurrParamComp.CuTempEst.DegC_f32 CurrParamComp.MagTempEst.DegC_f32 CurrParamComp.MtrCurrDaxRef.Amp_f32 CurrParamComp.MtrCurrQaxRef.Amp_f32 CurrParamComp.SiTempEst.DegC_f32 /end SUB_GROUP
/end GROUP
/begin GROUP CurrParamComp.SenderPorts "MICROSAR RTE"
 /begin SUB_GROUP CurrParamComp.EstKe.VpRadpS_f32 CurrParamComp.EstLd.Henry_f32 CurrParamComp.EstLq.Henry_f32 CurrParamComp.EstR.Ohm_f32 /end SUB_GROUP
/end GROUP
/begin GROUP CurrParamComp.SiTempEst.DegC_f32 "MICROSAR RTE" /begin REF_MEASUREMENT Rte_MtrTempEst_SiTempEst_DegC_f32 /end REF_MEASUREMENT /end GROUP
/begin GROUP Damping "MICROSAR RTE" /begin SUB_GROUP Damping.ReceiverPorts Damping.SenderPorts /end SUB_GROUP /end GROUP
/begin GROUP Damping.CustomDamp.MtrNm_f32 "MICROSAR RTE" /begin REF_MEASUREMENT Rte_Damping_CustomDamp_MtrNm_f32 /end REF_MEASUREMENT /end GROUP
/begin GROUP Damping.DampingCmd.MtrNm_f32 "MICROSAR RTE" /begin REF_MEASUREMENT Rte_Damping_DampingCmd_MtrNm_f32 /end REF_MEASUREMENT /end GROUP
/begin GROUP Damping.DampingDDFactor.Uls_f32 "MICROSAR RTE" /begin REF_MEASUREMENT Rte_Damping_DampingDDFactor_Uls_f32 /end REF_MEASUREMENT /end GROUP
/begin GROUP Damping.ReceiverPorts "MICROSAR RTE"
 /begin SUB_GROUP Damping.AssistCmd.MtrNm_f32 Damping.AssistMechTempEst.DegC_f32 Damping.CustomDamp.MtrNm_f32 Damping.DampingDDFactor.Uls_f32 Damping.DefeatDampingSvc.Cnt_lgc Damping.HwTorque.HwNm_f32 Damping.MotorVelCRF.MtrRadpS_f32 Damping.VehicleSpeed.Kph_f32 /end SUB_GROUP
/end GROUP
/begin GROUP Damping.SenderPorts "MICROSAR RTE" /begin SUB_GROUP Damping.DampingCmd.MtrNm_f32 /end SUB_GROUP /end GROUP
/begin GROUP DampingFirewall "MICROSAR RTE"
 /begin SUB_GROUP DampingFirewall.ModeRequirePorts DampingFirewall.ReceiverPorts DampingFirewall.SenderPorts /end SUB_GROUP
/end GROUP
/begin GROUP DampingFirewall.DampingCmd.MtrNm_f32 "MICROSAR RTE" /begin REF_MEASUREMENT Rte_Damping_DampingCmd_MtrNm_f32 /end REF_MEASUREMENT /end GROUP
/begin GROUP DampingFirewall.InertiaComp.MtrNm_f32 "MICROSAR RTE" /begin REF_MEASUREMENT Rte_FrqDepDmpnInrtCmp_FrqDepDmpnInrtCmp_MtrNm_f32 /end REF_MEASUREMENT /end GROUP
/begin GROUP DampingFirewall.ModeRequirePorts "MICROSAR RTE" /begin SUB_GROUP DampingFirewall.SystemState.Mode /end SUB_GROUP /end GROUP
/begin GROUP DampingFirewall.ReceiverPorts "MICROSAR RTE"
 /begin SUB_GROUP DampingFirewall.AsstFirewallActive.Uls_f32 DampingFirewall.BaseAssistCmd.MtrNm_f32 DampingFirewall.DampingCmd.MtrNm_f32 DampingFirewall.Defeat_Damping_Svc.Cnt_lgc DampingFirewall.FreqDepDmpSrlComSvcDft.Cnt_lgc DampingFirewall.HwTorque.HwNm_f32 DampingFirewall.InertiaComp.MtrNm_f32 DampingFirewall.MEC_Counter.Cnt_enum DampingFirewall.MtrVelCRF.MtrRadpS_f32 DampingFirewall.VehicleLonAccel.KphpS_f32 DampingFirewall.VehicleSpeed.Kph_f32 DampingFirewall.WIRCmdAmpBlnd.MtrNm_f32 /end SUB_GROUP
/end GROUP
/begin GROUP DampingFirewall.SenderPorts "MICROSAR RTE" /begin SUB_GROUP DampingFirewall.CombinedDamping.MtrNm_f32 /end SUB_GROUP /end GROUP
/begin GROUP DampingFirewall.VehicleLonAccel.KphpS_f32 "MICROSAR RTE" /begin REF_MEASUREMENT Rte_DampingFirewall_VehicleLonAccel_KphpS_f32 /end REF_MEASUREMENT /end GROUP
/begin GROUP DampingFirewall.WIRCmdAmpBlnd.MtrNm_f32 "MICROSAR RTE" /begin REF_MEASUREMENT Rte_DampingFirewall_WIRCmdAmpBlnd_MtrNm_f32 /end REF_MEASUREMENT /end GROUP
/begin GROUP DiagMgr10 "MICROSAR RTE"
 /begin SUB_GROUP DiagMgr10.ModeRequirePorts DiagMgr10.ReceiverPorts DiagMgr10.SenderPorts /end SUB_GROUP
/end GROUP
/begin GROUP DiagMgr10.DiagRampRate.XpmS_f32 "MICROSAR RTE" /begin REF_MEASUREMENT Rte_DiagMgr10_DiagRampRate_XpmS_f32 /end REF_MEASUREMENT /end GROUP
/begin GROUP DiagMgr10.DiagRampValue.Uls_f32 "MICROSAR RTE" /begin REF_MEASUREMENT Rte_DiagMgr10_DiagRampValue_Uls_f32 /end REF_MEASUREMENT /end GROUP
/begin GROUP DiagMgr10.DiagRmpToZeroActive.Cnt_lgc "MICROSAR RTE" /begin REF_MEASUREMENT Rte_DiagMgr10_DiagRmpToZeroActive_Cnt_lgc /end REF_MEASUREMENT /end GROUP
/begin GROUP DiagMgr10.DiagStsDefTemp.Cnt_lgc "MICROSAR RTE" /begin REF_MEASUREMENT Rte_DiagMgr10_DiagStsDefTemp_Cnt_lgc /end REF_MEASUREMENT /end GROUP
/begin GROUP DiagMgr10.DiagStsDefVehSpd.Cnt_lgc "MICROSAR RTE" /begin REF_MEASUREMENT Rte_DiagMgr10_DiagStsDefVehSpd_Cnt_lgc /end REF_MEASUREMENT /end GROUP
/begin GROUP DiagMgr10.DiagStsNonRecRmpToZeroFltPres.Cnt_lgc "MICROSAR RTE" /begin REF_MEASUREMENT Rte_DiagMgr10_DiagStsNonRecRmpToZeroFltPres_Cnt_lgc /end REF_MEASUREMENT /end GROUP
/begin GROUP DiagMgr10.DiagStsRecRmpToZeroFltPres.Cnt_lgc "MICROSAR RTE" /begin REF_MEASUREMENT Rte_DiagMgr10_DiagStsRecRmpToZeroFltPres_Cnt_lgc /end REF_MEASUREMENT /end GROUP
/begin GROUP DiagMgr10.DiagStsScomHWANotValid.Cnt_lgc "MICROSAR RTE" /begin REF_MEASUREMENT Rte_DiagMgr10_DiagStsScomHWANotValid_Cnt_lgc /end REF_MEASUREMENT /end GROUP
/begin GROUP DiagMgr10.DiagStsWIRDisable.Cnt_lgc "MICROSAR RTE" /begin REF_MEASUREMENT Rte_DiagMgr10_DiagStsWIRDisable_Cnt_lgc /end REF_MEASUREMENT /end GROUP
/begin GROUP DiagMgr10.ModeRequirePorts "MICROSAR RTE" /begin SUB_GROUP DiagMgr10.SystemState.Mode /end SUB_GROUP /end GROUP
/begin GROUP DiagMgr10.ReceiverPorts "MICROSAR RTE"
 /begin SUB_GROUP DiagMgr10.HwTrq.HwNm_f32 DiagMgr10.IgnCnt.Cnt_u16 DiagMgr10.MEC.Cnt_enum DiagMgr10.MfgDiagInhibit.Cnt_lgc DiagMgr10.MtrTrq.MtrNm_f32 DiagMgr10.VehSpd.Kph_f32 /end SUB_GROUP
/end GROUP
/begin GROUP DiagMgr10.SenderPorts "MICROSAR RTE"
 /begin SUB_GROUP DiagMgr10.DiagRampRate.XpmS_f32 DiagMgr10.DiagRampValue.Uls_f32 DiagMgr10.DiagRmpToZeroActive.Cnt_lgc DiagMgr10.DiagStsCtrldDisRmpPres.Cnt_lgc DiagMgr10.DiagStsDefTemp.Cnt_lgc DiagMgr10.DiagStsDefVehSpd.Cnt_lgc DiagMgr10.DiagStsHWASbSystmFltPres.Cnt_lgc DiagMgr10.DiagStsNonRecRmpToZeroFltPres.Cnt_lgc DiagMgr10.DiagStsRecRmpToZeroFltPres.Cnt_lgc DiagMgr10.DiagStsScomHWANotValid.Cnt_lgc DiagMgr10.DiagStsWIRDisable.Cnt_lgc /end SUB_GROUP
/end GROUP
/begin GROUP DiagMgr8 "MICROSAR RTE" /begin SUB_GROUP DiagMgr8.ModeRequirePorts DiagMgr8.ReceiverPorts /end SUB_GROUP /end GROUP
/begin GROUP DiagMgr8.ModeRequirePorts "MICROSAR RTE" /begin SUB_GROUP DiagMgr8.SystemState.Mode /end SUB_GROUP /end GROUP
/begin GROUP DiagMgr8.ReceiverPorts "MICROSAR RTE"
 /begin SUB_GROUP DiagMgr8.HwTrq.HwNm_f32 DiagMgr8.IgnCnt.Cnt_u16 DiagMgr8.MEC.Cnt_enum DiagMgr8.MfgDiagInhibit.Cnt_lgc DiagMgr8.MtrTrq.MtrNm_f32 DiagMgr8.VehSpd.Kph_f32 /end SUB_GROUP
/end GROUP
/begin GROUP DiagMgr8.SystemState.Mode "MICROSAR RTE" /begin REF_MEASUREMENT Rte_ModeMachine_StaMd8_SystemState8_Mode /end REF_MEASUREMENT /end GROUP
/begin GROUP DiagMgr9 "MICROSAR RTE" /begin SUB_GROUP DiagMgr9.ModeRequirePorts DiagMgr9.ReceiverPorts /end SUB_GROUP /end GROUP
/begin GROUP DiagMgr9.ModeRequirePorts "MICROSAR RTE" /begin SUB_GROUP DiagMgr9.SystemState.Mode /end SUB_GROUP /end GROUP
/begin GROUP DiagMgr9.ReceiverPorts "MICROSAR RTE"
 /begin SUB_GROUP DiagMgr9.HwTrq.HwNm_f32 DiagMgr9.IgnCnt.Cnt_u16 DiagMgr9.MEC.Cnt_enum DiagMgr9.MfgDiagInhibit.Cnt_lgc DiagMgr9.MtrTrq.MtrNm_f32 DiagMgr9.VehSpd.Kph_f32 /end SUB_GROUP
/end GROUP
/begin GROUP DiagSvc "MICROSAR RTE"
 /begin SUB_GROUP DiagSvc.ModeRequirePorts DiagSvc.PerInstanceMemories DiagSvc.ReceiverPorts DiagSvc.SenderPorts /end SUB_GROUP
/end GROUP
/begin GROUP DiagSvc.AppSwFingerPrintData "MICROSAR RTE" /begin REF_MEASUREMENT Rte_DiagSvc_AppSwFingerPrintData /end REF_MEASUREMENT /end GROUP
/begin GROUP DiagSvc.BootSwFingerPrintData "MICROSAR RTE" /begin REF_MEASUREMENT Rte_DiagSvc_BootSwFingerPrintData /end REF_MEASUREMENT /end GROUP
/begin GROUP DiagSvc.CalSwFingerPrintData "MICROSAR RTE" /begin REF_MEASUREMENT Rte_DiagSvc_CalSwFingerPrintData /end REF_MEASUREMENT /end GROUP
/begin GROUP DiagSvc.ECULifeTimeMinsData "MICROSAR RTE" /begin REF_MEASUREMENT Rte_DiagSvc_ECULifeTimeMinsData /end REF_MEASUREMENT /end GROUP
/begin GROUP DiagSvc.ECUSerialNumberData "MICROSAR RTE" /begin REF_MEASUREMENT Rte_DiagSvc_ECUSerialNumberData /end REF_MEASUREMENT /end GROUP
/begin GROUP DiagSvc.ECUSparePartNoData "MICROSAR RTE" /begin REF_MEASUREMENT Rte_DiagSvc_ECUSparePartNoData /end REF_MEASUREMENT /end GROUP
/begin GROUP DiagSvc.EOLConfigurationData "MICROSAR RTE" /begin REF_MEASUREMENT Rte_DiagSvc_EOLConfigurationData /end REF_MEASUREMENT /end GROUP
/begin GROUP DiagSvc.EraseRoutineStatusData "MICROSAR RTE" /begin REF_MEASUREMENT Rte_DiagSvc_EraseRoutineStatusData /end REF_MEASUREMENT /end GROUP
/begin GROUP DiagSvc.FirstDTCDetectMinsData "MICROSAR RTE" /begin REF_MEASUREMENT Rte_DiagSvc_FirstDTCDetectMinsData /end REF_MEASUREMENT /end GROUP
/begin GROUP DiagSvc.FirstDTCDetectSecsData "MICROSAR RTE" /begin REF_MEASUREMENT Rte_DiagSvc_FirstDTCDetectSecsData /end REF_MEASUREMENT /end GROUP
/begin GROUP DiagSvc.IgnitionPreStart.Cnt_lgc "MICROSAR RTE" /begin REF_MEASUREMENT Rte_DiagSvc_IgnitionPreStart_Cnt_lgc /end REF_MEASUREMENT /end GROUP
/begin GROUP DiagSvc.ModeRequirePorts "MICROSAR RTE" /begin SUB_GROUP DiagSvc.SystemState.Mode /end SUB_GROUP /end GROUP
/begin GROUP DiagSvc.PerInstanceMemories "MICROSAR RTE"
 /begin SUB_GROUP DiagSvc.AppSwFingerPrintData DiagSvc.BootSwFingerPrintData DiagSvc.CalSwFingerPrintData DiagSvc.ECULifeTimeMinsData DiagSvc.ECUSerialNumberData DiagSvc.ECUSparePartNoData DiagSvc.EOLConfigurationData DiagSvc.EraseRoutineStatusData DiagSvc.FirstDTCDetectMinsData DiagSvc.FirstDTCDetectSecsData DiagSvc.ProgrammingAttemptCounterData DiagSvc.ProgrammingStatusData DiagSvc.ProxiConfigurationData DiagSvc.ProxiCounterData DiagSvc.TuningSetSelectData DiagSvc.VINCurrentData DiagSvc.VINOriginalData /end SUB_GROUP
/end GROUP
/begin GROUP DiagSvc.ProgrammingAttemptCounterData "MICROSAR RTE" /begin REF_MEASUREMENT Rte_DiagSvc_ProgrammingAttemptCounterData /end REF_MEASUREMENT /end GROUP
/begin GROUP DiagSvc.ProgrammingStatusData "MICROSAR RTE" /begin REF_MEASUREMENT Rte_DiagSvc_ProgrammingStatusData /end REF_MEASUREMENT /end GROUP
/begin GROUP DiagSvc.ProxiConfigurationData "MICROSAR RTE" /begin REF_MEASUREMENT Rte_DiagSvc_ProxiConfigurationData /end REF_MEASUREMENT /end GROUP
/begin GROUP DiagSvc.ProxiCounterData "MICROSAR RTE" /begin REF_MEASUREMENT Rte_DiagSvc_ProxiCounterData /end REF_MEASUREMENT /end GROUP
/begin GROUP DiagSvc.ReceiverPorts "MICROSAR RTE"
 /begin SUB_GROUP DiagSvc.HwPos.HwDeg_f32 DiagSvc.HwTrq.HwNm_f32 DiagSvc.MEC.Cnt_enum DiagSvc.Temperature_DegC_f32.DegC_f32 DiagSvc.Vecu_Volt_f32.Volt_f32 DiagSvc.VehSpd.Kph_f32 /end SUB_GROUP
/end GROUP
/begin GROUP DiagSvc.SenderPorts "MICROSAR RTE"
 /begin SUB_GROUP DiagSvc.DesiredTunSet.Cnt_u16 DiagSvc.IgnitionPreStart.Cnt_lgc /end SUB_GROUP
/end GROUP
/begin GROUP DiagSvc.TuningSetSelectData "MICROSAR RTE" /begin REF_MEASUREMENT Rte_DiagSvc_TuningSetSelectData /end REF_MEASUREMENT /end GROUP
/begin GROUP DiagSvc.VINCurrentData "MICROSAR RTE" /begin REF_MEASUREMENT Rte_DiagSvc_VINCurrentData /end REF_MEASUREMENT /end GROUP
/begin GROUP DiagSvc.VINOriginalData "MICROSAR RTE" /begin REF_MEASUREMENT Rte_DiagSvc_VINOriginalData /end REF_MEASUREMENT /end GROUP
/begin GROUP DigHwTrqSENT "MICROSAR RTE"
 /begin SUB_GROUP DigHwTrqSENT.PerInstanceMemories DigHwTrqSENT.ReceiverPorts DigHwTrqSENT.SenderPorts /end SUB_GROUP
/end GROUP
/begin GROUP DigHwTrqSENT.DigTrqTrim "MICROSAR RTE"
 /begin REF_MEASUREMENT Rte_DigHwTrqSENT_DigTrqTrim.k_EOLHwTrqTrimPerformed_Cnt_Lgc Rte_DigHwTrqSENT_DigTrqTrim.k_EOLHwTrqTrim_HwNm_f32 /end REF_MEASUREMENT
/end GROUP
/begin GROUP DigHwTrqSENT.HwTorque.HwNm_f32 "MICROSAR RTE" /begin REF_MEASUREMENT Rte_DigHwTrqSENT_HwTorque_HwNm_f32 /end REF_MEASUREMENT /end GROUP
/begin GROUP DigHwTrqSENT.PerInstanceMemories "MICROSAR RTE" /begin SUB_GROUP DigHwTrqSENT.DigTrqTrim /end SUB_GROUP /end GROUP
/begin GROUP DigHwTrqSENT.ReceiverPorts "MICROSAR RTE"
 /begin SUB_GROUP DigHwTrqSENT.MECCounter.Cnt_enum DigHwTrqSENT.T1.HwNm_f32 DigHwTrqSENT.T2.HwNm_f32 /end SUB_GROUP
/end GROUP
/begin GROUP DigHwTrqSENT.SenderPorts "MICROSAR RTE"
 /begin SUB_GROUP DigHwTrqSENT.HwTorque.HwNm_f32 DigHwTrqSENT.SrlComHwTrq.HwNm_f32 DigHwTrqSENT.SrlComHwTrqValid.Cnt_lgc DigHwTrqSENT.SysCHwTorque.HwNm_f32 /end SUB_GROUP
/end GROUP
/begin GROUP DigHwTrqSENT.SrlComHwTrq.HwNm_f32 "MICROSAR RTE" /begin REF_MEASUREMENT Rte_DigHwTrqSENT_SrlComHwTrq_HwNm_f32 /end REF_MEASUREMENT /end GROUP
/begin GROUP DigHwTrqSENT.SrlComHwTrqValid.Cnt_lgc "MICROSAR RTE" /begin REF_MEASUREMENT Rte_DigHwTrqSENT_SrlComHwTrqValid_Cnt_lgc /end REF_MEASUREMENT /end GROUP
/begin GROUP DigHwTrqSENT.SysCHwTorque.HwNm_f32 "MICROSAR RTE" /begin REF_MEASUREMENT Rte_DigHwTrqSENT_SysCHwTorque_HwNm_f32 /end REF_MEASUREMENT /end GROUP
/begin GROUP DigHwTrqSENT.T1.HwNm_f32 "MICROSAR RTE" /begin REF_MEASUREMENT Rte_Nhet1_DigHwTrqT1_HwNm_f32 /end REF_MEASUREMENT /end GROUP
/begin GROUP DigHwTrqSENT.T2.HwNm_f32 "MICROSAR RTE" /begin REF_MEASUREMENT Rte_Nhet1_DigHwTrqT2_HwNm_f32 /end REF_MEASUREMENT /end GROUP
/begin GROUP DigMSB "MICROSAR RTE"
 /begin SUB_GROUP DigMSB.PerInstanceMemories DigMSB.ReceiverPorts DigMSB.SenderPorts /end SUB_GROUP
/end GROUP
/begin GROUP DigMSB.AlignedCumMechMtrPosMRF.Deg_f32 "MICROSAR RTE" /begin REF_MEASUREMENT Rte_DigMSB_AlignedCumMechMtrPosMRF_Deg_f32 /end REF_MEASUREMENT /end GROUP
/begin GROUP DigMSB.CumMechMtrPosMRF.Deg_f32 "MICROSAR RTE" /begin REF_MEASUREMENT Rte_DigMSB_CumMechMtrPosMRF_Deg_f32 /end REF_MEASUREMENT /end GROUP
/begin GROUP DigMSB.CumMechMtrPosStatus.Cnt_u08 "MICROSAR RTE" /begin REF_MEASUREMENT Rte_DigMSB_CumMechMtrPosStatus_Cnt_u08 /end REF_MEASUREMENT /end GROUP
/begin GROUP DigMSB.DigMSBEOLData "MICROSAR RTE"
 /begin REF_MEASUREMENT Rte_DigMSB_DigMSBEOLData.CRC_Cnt_u16 Rte_DigMSB_DigMSBEOLData.MtrPos1HarCompTbl_Rev_s2p13 Rte_DigMSB_DigMSBEOLData.MtrPos2HarCompTbl_Rev_s2p13 Rte_DigMSB_DigMSBEOLData.MtrPosBEMFRedundant_Rev_u0p16 Rte_DigMSB_DigMSBEOLData.MtrPosBEMF_Rev_u0p16 /end REF_MEASUREMENT
/end GROUP
/begin GROUP DigMSB.MechMtrPos2.Rev_u0p16 "MICROSAR RTE" /begin REF_MEASUREMENT Rte_DigMSB_MechMtrPos2_Rev_u0p16 /end REF_MEASUREMENT /end GROUP
/begin GROUP DigMSB.PerInstanceMemories "MICROSAR RTE" /begin SUB_GROUP DigMSB.DigMSBEOLData /end SUB_GROUP /end GROUP
/begin GROUP DigMSB.ReceiverPorts "MICROSAR RTE"
 /begin SUB_GROUP DigMSB.AssistAssemblyPolarity.Cnt_s08 DigMSB.CorrectedElecMtrPos.Rev_u0p16 DigMSB.CumMechMtrPos.Rev_f32 DigMSB.Die1RxError.Cnt_u16 DigMSB.Die1RxMtrPos.Cnt_u16 DigMSB.Die1RxRevCtr.Cnt_u16 DigMSB.Die1UnderVoltgFltAccum.Cnt_u16 DigMSB.Die2RxError.Cnt_u16 DigMSB.Die2RxMtrPos.Cnt_u16 DigMSB.Die2RxRevCtr.Cnt_u16 DigMSB.MtrPosPolarity.Cnt_s08 DigMSB.RxMtrPosParityAccum.Cnt_u16 DigMSB.UncorrMechMtrPos1.Rev_u0p16 /end SUB_GROUP
/end GROUP
/begin GROUP DigMSB.SenderPorts "MICROSAR RTE"
 /begin SUB_GROUP DigMSB.AlignedCumMechMtrPosCRF.Deg_f32 DigMSB.AlignedCumMechMtrPosMRF.Deg_f32 DigMSB.AlignedCumMechMtrPosStatus.Cnt_u08 DigMSB.CumMechMtrPosCRF.Deg_f32 DigMSB.CumMechMtrPosMRF.Deg_f32 DigMSB.CumMechMtrPosStatus.Cnt_u08 DigMSB.MechMtrPos2.Rev_u0p16 DigMSB.SysCCumMechMtrPosMRF.Deg_f32 /end SUB_GROUP
/end GROUP
/begin GROUP DigMSB.SysCCumMechMtrPosMRF.Deg_f32 "MICROSAR RTE" /begin REF_MEASUREMENT Rte_DigMSB_SysCCumMechMtrPosMRF_Deg_f32 /end REF_MEASUREMENT /end GROUP
/begin GROUP DigPhsReasDiag "MICROSAR RTE"
 /begin SUB_GROUP DigPhsReasDiag.ModeRequirePorts DigPhsReasDiag.ReceiverPorts /end SUB_GROUP
/end GROUP
/begin GROUP DigPhsReasDiag.GateDriveResetActive.Cnt_lgc "MICROSAR RTE" /begin REF_MEASUREMENT Rte_MtrDrvDiag_GateDriveResetActive_Cnt_lgc /end REF_MEASUREMENT /end GROUP
/begin GROUP DigPhsReasDiag.ModeRequirePorts "MICROSAR RTE" /begin SUB_GROUP DigPhsReasDiag.SystemState.Mode /end SUB_GROUP /end GROUP
/begin GROUP DigPhsReasDiag.PDActivateTest.Cnt_lgc "MICROSAR RTE" /begin REF_MEASUREMENT Rte_DigPhsReasDiag_PDActivateTest_Cnt_lgc /end REF_MEASUREMENT /end GROUP
/begin GROUP DigPhsReasDiag.ReceiverPorts "MICROSAR RTE"
 /begin SUB_GROUP DigPhsReasDiag.ExpectedOnTimeA.Cnt_u32 DigPhsReasDiag.ExpectedOnTimeB.Cnt_u32 DigPhsReasDiag.ExpectedOnTimeC.Cnt_u32 DigPhsReasDiag.GateDriveResetActive.Cnt_lgc DigPhsReasDiag.LRPRCorrectedMtrPosCaptured.Rev_f32 DigPhsReasDiag.LRPRModulationIndexCaptured.Uls_f32 DigPhsReasDiag.LRPRPhaseadvanceCaptured.Cnt_s16 DigPhsReasDiag.MeasuredOnTimeA.Cnt_u32 DigPhsReasDiag.MeasuredOnTimeB.Cnt_u32 DigPhsReasDiag.MeasuredOnTimeC.Cnt_u32 DigPhsReasDiag.MotorVelMRFUnfiltered.MtrRadpS_f32 DigPhsReasDiag.MtrElecMechPolarity.Cnt_s08 DigPhsReasDiag.PDActivateTest.Cnt_lgc /end SUB_GROUP
/end GROUP
/begin GROUP DSR "Comment"
 /begin REF_MEASUREMENT k_CustDIDCals_Cnt_u08.CalibrationSwIdentification_DIDF182_ASCII_u08 k_CustDIDCals_Cnt_u08.CalibrationSwIdentification_DIDF182_ASCII_u08._10_ k_CustDIDCals_Cnt_u08.CalibrationSwIdentification_DIDF182_ASCII_u08._11_ k_CustDIDCals_Cnt_u08.CalibrationSwIdentification_DIDF182_ASCII_u08._12_ k_CustDIDCals_Cnt_u08.CalibrationSwIdentification_DIDF182_ASCII_u08._13_ k_CustDIDCals_Cnt_u08.CalibrationSwIdentification_DIDF182_ASCII_u08._1_ k_CustDIDCals_Cnt_u08.CalibrationSwIdentification_DIDF182_ASCII_u08._2_ k_CustDIDCals_Cnt_u08.CalibrationSwIdentification_DIDF182_ASCII_u08._3_ k_CustDIDCals_Cnt_u08.CalibrationSwIdentification_DIDF182_ASCII_u08._4_ k_CustDIDCals_Cnt_u08.CalibrationSwIdentification_DIDF182_ASCII_u08._5_ k_CustDIDCals_Cnt_u08.CalibrationSwIdentification_DIDF182_ASCII_u08._6_ k_CustDIDCals_Cnt_u08.CalibrationSwIdentification_DIDF182_ASCII_u08._7_ k_CustDIDCals_Cnt_u08.CalibrationSwIdentification_DIDF182_ASCII_u08._8_ k_CustDIDCals_Cnt_u08.CalibrationSwIdentification_DIDF182_ASCII_u08._9_ k_CustDIDCals_Cnt_u08.DiagnosticIdentification_DIDF100_ASCII_u08._0_ k_CustDIDCals_Cnt_u08.DiagnosticIdentification_DIDF100_ASCII_u08._1 k_CustDIDCals_Cnt_u08.DiagnosticIdentification_DIDF100_ASCII_u08._2 k_CustDIDCals_Cnt_u08.DiagnosticIdentification_DIDF100_ASCII_u08._3 k_CustDIDCals_Cnt_u08.DiagnosticIdentification_DIDF100_ASCII_u08._4 k_CustDIDCals_Cnt_u08.DiagnosticIdentification_DIDF100_ASCII_u08._5 k_CustDIDCals_Cnt_u08.DiagnosticIdentification_DIDF100_ASCII_u08._6 k_CustDIDCals_Cnt_u08.SupplierManfECUHwPartNo_DIDF191_ASCII_u08._0 k_CustDIDCals_Cnt_u08.SupplierManfECUHwPartNo_DIDF191_ASCII_u08._1 k_CustDIDCals_Cnt_u08.SupplierManfECUHwPartNo_DIDF191_ASCII_u08._10 k_CustDIDCals_Cnt_u08.SupplierManfECUHwPartNo_DIDF191_ASCII_u08._2 k_CustDIDCals_Cnt_u08.SupplierManfECUHwPartNo_DIDF191_ASCII_u08._3 k_CustDIDCals_Cnt_u08.SupplierManfECUHwPartNo_DIDF191_ASCII_u08._4 k_CustDIDCals_Cnt_u08.SupplierManfECUHwPartNo_DIDF191_ASCII_u08._5 k_CustDIDCals_Cnt_u08.SupplierManfECUHwPartNo_DIDF191_ASCII_u08._6 k_CustDIDCals_Cnt_u08.SupplierManfECUHwPartNo_DIDF191_ASCII_u08._7 k_CustDIDCals_Cnt_u08.SupplierManfECUHwPartNo_DIDF191_ASCII_u08._8 k_CustDIDCals_Cnt_u08.SupplierManfECUHwPartNo_DIDF191_ASCII_u08._9 k_CustDIDCals_Cnt_u08.SupplierManfECUHwPartNo_DIDF192_ASCII_u08._0 k_CustDIDCals_Cnt_u08.SupplierManfECUHwPartNo_DIDF192_ASCII_u08._1 k_CustDIDCals_Cnt_u08.SupplierManfECUHwPartNo_DIDF192_ASCII_u08._10 k_CustDIDCals_Cnt_u08.SupplierManfECUHwPartNo_DIDF192_ASCII_u08._2 k_CustDIDCals_Cnt_u08.SupplierManfECUHwPartNo_DIDF192_ASCII_u08._3 k_CustDIDCals_Cnt_u08.SupplierManfECUHwPartNo_DIDF192_ASCII_u08._4 k_CustDIDCals_Cnt_u08.SupplierManfECUHwPartNo_DIDF192_ASCII_u08._5 k_CustDIDCals_Cnt_u08.SupplierManfECUHwPartNo_DIDF192_ASCII_u08._6 k_CustDIDCals_Cnt_u08.SupplierManfECUHwPartNo_DIDF192_ASCII_u08._7 k_CustDIDCals_Cnt_u08.SupplierManfECUHwPartNo_DIDF192_ASCII_u08._8 k_CustDIDCals_Cnt_u08.SupplierManfECUHwPartNo_DIDF192_ASCII_u08._9 k_CustDIDCals_Cnt_u08.SupplierManfECUHwVerNo_DIDF193_ASCII_u08 k_CustDIDCals_Cnt_u08.VehicleManfECUSwNo_DIDF188_ASCII_u08._0_ k_CustDIDCals_Cnt_u08.VehicleManfECUSwNo_DIDF188_ASCII_u08._10_ k_CustDIDCals_Cnt_u08.VehicleManfECUSwNo_DIDF188_ASCII_u08._1_ k_CustDIDCals_Cnt_u08.VehicleManfECUSwNo_DIDF188_ASCII_u08._2_ k_CustDIDCals_Cnt_u08.VehicleManfECUSwNo_DIDF188_ASCII_u08._3_ k_CustDIDCals_Cnt_u08.VehicleManfECUSwNo_DIDF188_ASCII_u08._4_ k_CustDIDCals_Cnt_u08.VehicleManfECUSwNo_DIDF188_ASCII_u08._5_ k_CustDIDCals_Cnt_u08.VehicleManfECUSwNo_DIDF188_ASCII_u08._6_ k_CustDIDCals_Cnt_u08.VehicleManfECUSwNo_DIDF188_ASCII_u08._7_ k_CustDIDCals_Cnt_u08.VehicleManfECUSwNo_DIDF188_ASCII_u08._8_ k_CustDIDCals_Cnt_u08.VehicleManfECUSwNo_DIDF188_ASCII_u08._9_ /end REF_MEASUREMENT
/end GROUP
/begin GROUP ElePwr "MICROSAR RTE" /begin SUB_GROUP ElePwr.ReceiverPorts ElePwr.SenderPorts /end SUB_GROUP /end GROUP
/begin GROUP ElePwr.ElectricPower.Watt_f32 "MICROSAR RTE" /begin REF_MEASUREMENT Rte_ElePwr_ElectricPower_Watt_f32 /end REF_MEASUREMENT /end GROUP
/begin GROUP ElePwr.ReceiverPorts "MICROSAR RTE"
 /begin SUB_GROUP ElePwr.MtrCurrDax.Amp_f32 ElePwr.MtrCurrQax.Amp_f32 ElePwr.MtrVoltDax.Volt_f32 ElePwr.MtrVoltQax.Volt_f32 ElePwr.Vecu.Volt_f32 /end SUB_GROUP
/end GROUP
/begin GROUP ElePwr.SenderPorts "MICROSAR RTE" /begin SUB_GROUP ElePwr.ElectricPower.Watt_f32 ElePwr.SupplyCurrent.Amp_f32 /end SUB_GROUP /end GROUP
/begin GROUP ElePwr.SupplyCurrent.Amp_f32 "MICROSAR RTE" /begin REF_MEASUREMENT Rte_ElePwr_SupplyCurrent_Amp_f32 /end REF_MEASUREMENT /end GROUP
/begin GROUP EOTActuatorMng "MICROSAR RTE" /begin SUB_GROUP EOTActuatorMng.ReceiverPorts EOTActuatorMng.SenderPorts /end SUB_GROUP /end GROUP
/begin GROUP EOTActuatorMng.AssistEOTDamping.MtrNm_f32 "MICROSAR RTE" /begin REF_MEASUREMENT Rte_EOTActuatorMng_AssistEOTDamping_MtrNm_f32 /end REF_MEASUREMENT /end GROUP
/begin GROUP EOTActuatorMng.AssistEOTGain.Uls_f32 "MICROSAR RTE" /begin REF_MEASUREMENT Rte_EOTActuatorMng_AssistEOTGain_Uls_f32 /end REF_MEASUREMENT /end GROUP
/begin GROUP EOTActuatorMng.AssistEOTLimit.MtrNm_f32 "MICROSAR RTE" /begin REF_MEASUREMENT Rte_EOTActuatorMng_AssistEOTLimit_MtrNm_f32 /end REF_MEASUREMENT /end GROUP
/begin GROUP EOTActuatorMng.CcwEOT.HwDeg_f32 "MICROSAR RTE" /begin REF_MEASUREMENT Rte_LrnEOT_CCWPosition_HwDeg_f32 /end REF_MEASUREMENT /end GROUP
/begin GROUP EOTActuatorMng.CcwFound.Cnt_lgc "MICROSAR RTE" /begin REF_MEASUREMENT Rte_LrnEOT_CCWFound_Cnt_lgc /end REF_MEASUREMENT /end GROUP
/begin GROUP EOTActuatorMng.CwEOT.HwDeg_f32 "MICROSAR RTE" /begin REF_MEASUREMENT Rte_LrnEOT_CWPosition_HwDeg_f32 /end REF_MEASUREMENT /end GROUP
/begin GROUP EOTActuatorMng.CwFound.Cnt_lgc "MICROSAR RTE" /begin REF_MEASUREMENT Rte_LrnEOT_CWFound_Cnt_lgc /end REF_MEASUREMENT /end GROUP
/begin GROUP EOTActuatorMng.ReceiverPorts "MICROSAR RTE"
 /begin SUB_GROUP EOTActuatorMng.CcwEOT.HwDeg_f32 EOTActuatorMng.CcwFound.Cnt_lgc EOTActuatorMng.CwEOT.HwDeg_f32 EOTActuatorMng.CwFound.Cnt_lgc EOTActuatorMng.EOTDisable.Cnt_lgc EOTActuatorMng.HandWheelAuth.Uls_f32 EOTActuatorMng.HandWheelPos.HwDeg_f32 EOTActuatorMng.HwTorque.HwNm_f32 EOTActuatorMng.MotorVel.MtrRadpS_f32 EOTActuatorMng.OutputRampMultLtd.Uls_f32 EOTActuatorMng.PreLimitTorque.MtrNm_f32 EOTActuatorMng.VehicleSpeed.Kph_f32 /end SUB_GROUP
/end GROUP
/begin GROUP EOTActuatorMng.SenderPorts "MICROSAR RTE"
 /begin SUB_GROUP EOTActuatorMng.AssistEOTDamping.MtrNm_f32 EOTActuatorMng.AssistEOTGain.Uls_f32 EOTActuatorMng.AssistEOTLimit.MtrNm_f32 /end SUB_GROUP
/end GROUP
/begin GROUP ePWM2 "MICROSAR RTE" /begin SUB_GROUP ePWM2.ModeRequirePorts ePWM2.ReceiverPorts /end SUB_GROUP /end GROUP
/begin GROUP ePWM2.DiagStsNonRecRmpToZeroFltPres.Cnt_lgc "MICROSAR RTE" /begin REF_MEASUREMENT Rte_DiagMgr10_DiagStsNonRecRmpToZeroFltPres_Cnt_lgc /end REF_MEASUREMENT /end GROUP
/begin GROUP ePWM2.ModeRequirePorts "MICROSAR RTE" /begin SUB_GROUP ePWM2.SystemState.Mode /end SUB_GROUP /end GROUP
/begin GROUP ePWM2.RampDwnStatusComplete.Cnt_lgc "MICROSAR RTE" /begin REF_MEASUREMENT Rte_StOpCtrl_RampDwnStatusComplete_Cnt_lgc /end REF_MEASUREMENT /end GROUP
/begin GROUP ePWM2.ReceiverPorts "MICROSAR RTE"
 /begin SUB_GROUP ePWM2.CRFCntDisMtrTrqCmd.MtrNm_f32 ePWM2.DiagStsF2Active.Cnt_lgc ePWM2.DiagStsNonRecRmpToZeroFltPres.Cnt_lgc ePWM2.RampDwnStatusComplete.Cnt_lgc /end SUB_GROUP
/end GROUP
/begin GROUP EtDmpFw "MICROSAR RTE" /begin SUB_GROUP EtDmpFw.ReceiverPorts EtDmpFw.SenderPorts /end SUB_GROUP /end GROUP
/begin GROUP EtDmpFw.AssistEOTDamping.MtrNm_f32 "MICROSAR RTE" /begin REF_MEASUREMENT Rte_EOTActuatorMng_AssistEOTDamping_MtrNm_f32 /end REF_MEASUREMENT /end GROUP
/begin GROUP EtDmpFw.ReceiverPorts "MICROSAR RTE"
 /begin SUB_GROUP EtDmpFw.AssistEOTDamping.MtrNm_f32 EtDmpFw.CRFMtrVel.MtrRadpS_f32 EtDmpFw.EOTDisable.Cnt_lgc EtDmpFw.HandwheelAuthority.Uls_f32 EtDmpFw.HandwheelPosition.HwDeg_f32 EtDmpFw.MEC_Counter.Cnt_enum EtDmpFw.Vehicle_Speed.Kph_f32 /end SUB_GROUP
/end GROUP
/begin GROUP EtDmpFw.SenderPorts "MICROSAR RTE" /begin SUB_GROUP EtDmpFw.EOTDampingLtd.MtrNm_f32 /end SUB_GROUP /end GROUP
/begin GROUP FltInjection "MICROSAR RTE" /begin SUB_GROUP FltInjection.ReceiverPorts /end SUB_GROUP /end GROUP
/begin GROUP FltInjection.ReceiverPorts "MICROSAR RTE" /begin SUB_GROUP FltInjection.MotorVelCRF.MtrRadpS_f32 /end SUB_GROUP /end GROUP
/begin GROUP FrqDepDmpnInrtCmp "MICROSAR RTE"
 /begin SUB_GROUP FrqDepDmpnInrtCmp.ModeRequirePorts FrqDepDmpnInrtCmp.ReceiverPorts FrqDepDmpnInrtCmp.SenderPorts /end SUB_GROUP
/end GROUP
/begin GROUP FrqDepDmpnInrtCmp.FrqDepDmpnInrtCmp.MtrNm_f32 "MICROSAR RTE" /begin REF_MEASUREMENT Rte_FrqDepDmpnInrtCmp_FrqDepDmpnInrtCmp_MtrNm_f32 /end REF_MEASUREMENT /end GROUP
/begin GROUP FrqDepDmpnInrtCmp.ModeRequirePorts "MICROSAR RTE" /begin SUB_GROUP FrqDepDmpnInrtCmp.SystemState.Mode /end SUB_GROUP /end GROUP
/begin GROUP FrqDepDmpnInrtCmp.ReceiverPorts "MICROSAR RTE"
 /begin SUB_GROUP FrqDepDmpnInrtCmp.BaseAssistCmd.MtrNm_f32 FrqDepDmpnInrtCmp.CRFMotorVel.MtrRadpS_f32 FrqDepDmpnInrtCmp.FreqDepDmpSrlComSvcDft.Cnt_lgc FrqDepDmpnInrtCmp.HwTorque.HwNm_f32 FrqDepDmpnInrtCmp.VehicleLonAccel.KphpS_f32 FrqDepDmpnInrtCmp.VehicleSpeed.Kph_f32 FrqDepDmpnInrtCmp.WIRCmdAmpBlnd.MtrNm_f32 /end SUB_GROUP
/end GROUP
/begin GROUP FrqDepDmpnInrtCmp.SenderPorts "MICROSAR RTE" /begin SUB_GROUP FrqDepDmpnInrtCmp.FrqDepDmpnInrtCmp.MtrNm_f32 /end SUB_GROUP /end GROUP
/begin GROUP FrqDepDmpnInrtCmp.VehicleLonAccel.KphpS_f32 "MICROSAR RTE" /begin REF_MEASUREMENT Rte_FrqDepDmpnInrtCmp_VehicleLonAccel_KphpS_f32 /end REF_MEASUREMENT /end GROUP
/begin GROUP FrqDepDmpnInrtCmp.WIRCmdAmpBlnd.MtrNm_f32 "MICROSAR RTE" /begin REF_MEASUREMENT Rte_FrqDepDmpnInrtCmp_WIRCmdAmpBlnd_MtrNm_f32 /end REF_MEASUREMENT /end GROUP
/begin GROUP Gsod "MICROSAR RTE" /begin SUB_GROUP Gsod.ModeRequirePorts Gsod.ReceiverPorts /end SUB_GROUP /end GROUP
/begin GROUP Gsod.Ana_Hw_Torque.HwNm_f32 "MICROSAR RTE" /begin REF_MEASUREMENT Rte_DigHwTrqSENT_HwTorque_HwNm_f32 /end REF_MEASUREMENT /end GROUP
/begin GROUP Gsod.Cum_Mtr_Pos_CRF.Deg_f32 "MICROSAR RTE" /begin REF_MEASUREMENT Rte_DigMSB_CumMechMtrPosMRF_Deg_f32 /end REF_MEASUREMENT /end GROUP
/begin GROUP Gsod.ModeRequirePorts "MICROSAR RTE" /begin SUB_GROUP Gsod.SystemState.Mode /end SUB_GROUP /end GROUP
/begin GROUP Gsod.ReceiverPorts "MICROSAR RTE"
 /begin SUB_GROUP Gsod.Ana_Hw_Torque.HwNm_f32 Gsod.Corrected_MtrPos.Rev_f32 Gsod.Cum_Mtr_Pos_CRF.Deg_f32 Gsod.MtrElecMech_Polarity.Cnt_s08 Gsod.SysC_Ana_Hw_Torque.HwNm_f32 Gsod.SysC_Corrected_MtrPos.Rev_f32 Gsod.SysC_Cum_Mtr_Pos_CRF.Deg_f32 Gsod.SysC_MtrElecMech_Polarity.Cnt_s32 Gsod.SysC_Torque_Cmd_CRF.MtrNm_f32 Gsod.SysC_Torque_Cmd_MRF.MtrNm_f32 Gsod.SysC_Vecu.Volt_f32 Gsod.Torque_Cmd_CRF.MtrNm_f32 Gsod.Torque_Cmd_MRF.MtrNm_f32 Gsod.Vecu.Volt_f32 /end SUB_GROUP
/end GROUP
/begin GROUP Gsod.SysC_Ana_Hw_Torque.HwNm_f32 "MICROSAR RTE" /begin REF_MEASUREMENT Rte_DigHwTrqSENT_SysCHwTorque_HwNm_f32 /end REF_MEASUREMENT /end GROUP
/begin GROUP Gsod.SysC_Cum_Mtr_Pos_CRF.Deg_f32 "MICROSAR RTE" /begin REF_MEASUREMENT Rte_DigMSB_SysCCumMechMtrPosMRF_Deg_f32 /end REF_MEASUREMENT /end GROUP
/begin GROUP Gsod.SysC_MtrElecMech_Polarity.Cnt_s32 "MICROSAR RTE" /begin REF_MEASUREMENT Rte_Polarity_SysC_MtrElecMechPolarity_Cnt_s32 /end REF_MEASUREMENT /end GROUP
/begin GROUP Gsod.SysC_Torque_Cmd_CRF.MtrNm_f32 "MICROSAR RTE" /begin REF_MEASUREMENT Rte_CtrldDisShtdn_SysC_CRFMtrTrqCmd_MtrNm_f32 /end REF_MEASUREMENT /end GROUP
/begin GROUP Gsod.SysC_Torque_Cmd_MRF.MtrNm_f32 "MICROSAR RTE" /begin REF_MEASUREMENT Rte_CtrldDisShtdn_SysC_MRFMtrTrqCmd_MtrNm_f32 /end REF_MEASUREMENT /end GROUP
/begin GROUP HighFreqAssist "MICROSAR RTE" /begin SUB_GROUP HighFreqAssist.ReceiverPorts HighFreqAssist.SenderPorts /end SUB_GROUP /end GROUP
/begin GROUP HighFreqAssist.ReceiverPorts "MICROSAR RTE"
 /begin SUB_GROUP HighFreqAssist.HwTorque.HwNm_f32 HighFreqAssist.VehicleSpeed.Kph_f32 HighFreqAssist.WIRCmdAmpBlnd.MtrNm_f32 /end SUB_GROUP
/end GROUP
/begin GROUP HighFreqAssist.SenderPorts "MICROSAR RTE" /begin SUB_GROUP HighFreqAssist.HighFreqAssist.MtrNm_f32 /end SUB_GROUP /end GROUP
/begin GROUP HighFreqAssist.WIRCmdAmpBlnd.MtrNm_f32 "MICROSAR RTE" /begin REF_MEASUREMENT Rte_HighFreqAssist_WIRCmdAmpBlnd_MtrNm_f32 /end REF_MEASUREMENT /end GROUP
/begin GROUP HiLoadStall "MICROSAR RTE" /begin SUB_GROUP HiLoadStall.ReceiverPorts HiLoadStall.SenderPorts /end SUB_GROUP /end GROUP
/begin GROUP HiLoadStall.AssistStallLimit.MtrNm_f32 "MICROSAR RTE" /begin REF_MEASUREMENT Rte_HiLoadStall_AssistStallLimit_MtrNm_f32 /end REF_MEASUREMENT /end GROUP
/begin GROUP HiLoadStall.ReceiverPorts "MICROSAR RTE"
 /begin SUB_GROUP HiLoadStall.DftStallLimit.Cnt_lgc HiLoadStall.MtrVelCRF.MtrRadpS_f32 HiLoadStall.PreLimitForStall.MtrNm_f32 /end SUB_GROUP
/end GROUP
/begin GROUP HiLoadStall.SenderPorts "MICROSAR RTE" /begin SUB_GROUP HiLoadStall.AssistStallLimit.MtrNm_f32 /end SUB_GROUP /end GROUP
/begin GROUP HwPwUp "MICROSAR RTE"
 /begin SUB_GROUP HwPwUp.ModeRequirePorts HwPwUp.ReceiverPorts HwPwUp.SenderPorts /end SUB_GROUP
/end GROUP
/begin GROUP HwPwUp.ModeRequirePorts "MICROSAR RTE" /begin SUB_GROUP HwPwUp.SystemState.Mode /end SUB_GROUP /end GROUP
/begin GROUP HwPwUp.MtrDrvrInitComplete.Cnt_lgc "MICROSAR RTE" /begin REF_MEASUREMENT Rte_MtrDrvDiag_MtrDrvrInitComplete_Cnt_lgc /end REF_MEASUREMENT /end GROUP
/begin GROUP HwPwUp.MtrDrvrInitStart.Cnt_lgc "MICROSAR RTE" /begin REF_MEASUREMENT Rte_HwPwUp_MtrDrvrInitStart_Cnt_lgc /end REF_MEASUREMENT /end GROUP
/begin GROUP HwPwUp.ReceiverPorts "MICROSAR RTE"
 /begin SUB_GROUP HwPwUp.MtrDrvrInitComplete.Cnt_lgc HwPwUp.PwrDiscATestComplete.Cnt_lgc HwPwUp.PwrDiscBTestComplete.Cnt_lgc HwPwUp.TMFTestComplete.Cnt_lgc /end SUB_GROUP
/end GROUP
/begin GROUP HwPwUp.SenderPorts "MICROSAR RTE"
 /begin SUB_GROUP HwPwUp.MtrDrvrInitStart.Cnt_lgc HwPwUp.PwrDiscATestStart.Cnt_lgc HwPwUp.PwrDiscBTestStart.Cnt_lgc HwPwUp.TMFTestStart.Cnt_lgc /end SUB_GROUP
/end GROUP
/begin GROUP HwPwUp.TMFTestComplete.Cnt_lgc "MICROSAR RTE" /begin REF_MEASUREMENT Rte_TmprlMon_TMFTestComplete_Cnt_lgc /end REF_MEASUREMENT /end GROUP
/begin GROUP HwPwUp.TMFTestStart.Cnt_lgc "MICROSAR RTE" /begin REF_MEASUREMENT Rte_HwPwUp_TMFTestStart_Cnt_lgc /end REF_MEASUREMENT /end GROUP
/begin GROUP HystComp "MICROSAR RTE" /begin SUB_GROUP HystComp.ReceiverPorts HystComp.SenderPorts /end SUB_GROUP /end GROUP
/begin GROUP HystComp.ReceiverPorts "MICROSAR RTE"
 /begin SUB_GROUP HystComp.AssistMechTempEst.DegC_f32 HystComp.BaseAssistCmd.MtrNm_f32 HystComp.DefeatHystService.Cnt_lgc HystComp.FricOffset.HwNm_f32 HystComp.HwTorque.HwNm_f32 HystComp.VehicleSpeed.Kph_f32 HystComp.WIRCmdAmpBlnd.MtrNm_f32 /end SUB_GROUP
/end GROUP
/begin GROUP HystComp.SenderPorts "MICROSAR RTE" /begin SUB_GROUP HystComp.HysteresisComp.MtrNm_f32 /end SUB_GROUP /end GROUP
/begin GROUP HystComp.WIRCmdAmpBlnd.MtrNm_f32 "MICROSAR RTE" /begin REF_MEASUREMENT Rte_HystComp_WIRCmdAmpBlnd_MtrNm_f32 /end REF_MEASUREMENT /end GROUP
/begin GROUP IoHwAbstractionUsr "MICROSAR RTE"
 /begin SUB_GROUP IoHwAbstractionUsr.ReceiverPorts IoHwAbstractionUsr.SenderPorts /end SUB_GROUP
/end GROUP
/begin GROUP IoHwAbstractionUsr.ReceiverPorts "MICROSAR RTE" /begin SUB_GROUP IoHwAbstractionUsr.SysCVSwitchADC.Cnt_u16 /end SUB_GROUP /end GROUP
/begin GROUP IoHwAbstractionUsr.SenderPorts "MICROSAR RTE"
 /begin SUB_GROUP IoHwAbstractionUsr.Batt.Volt_f32 IoHwAbstractionUsr.BattSwitched.Volt_f32 IoHwAbstractionUsr.SysCVSwitch.Volt_f32 IoHwAbstractionUsr.TemperatureADC.Volt_f32 /end SUB_GROUP
/end GROUP
/begin GROUP IoHwAbstractionUsr.TemperatureADC.Volt_f32 "MICROSAR RTE" /begin REF_MEASUREMENT Rte_IoHwAbstractionUsr_TemperatureADC_Volt_f32 /end REF_MEASUREMENT /end GROUP
/begin GROUP LmtCod "MICROSAR RTE" /begin SUB_GROUP LmtCod.ReceiverPorts LmtCod.SenderPorts /end SUB_GROUP /end GROUP
/begin GROUP LmtCod.AssistEOTGain.Uls_f32 "MICROSAR RTE" /begin REF_MEASUREMENT Rte_EOTActuatorMng_AssistEOTGain_Uls_f32 /end REF_MEASUREMENT /end GROUP
/begin GROUP LmtCod.AssistEOTLimit.MtrNm_f32 "MICROSAR RTE" /begin REF_MEASUREMENT Rte_EOTActuatorMng_AssistEOTLimit_MtrNm_f32 /end REF_MEASUREMENT /end GROUP
/begin GROUP LmtCod.AssistStallLimit.MtrNm_f32 "MICROSAR RTE" /begin REF_MEASUREMENT Rte_HiLoadStall_AssistStallLimit_MtrNm_f32 /end REF_MEASUREMENT /end GROUP
/begin GROUP LmtCod.AssistVehSpdLimit.MtrNm_f32 "MICROSAR RTE" /begin REF_MEASUREMENT Rte_VehSpdLmt_AstVehSpdLimit_MtrNm_f32 /end REF_MEASUREMENT /end GROUP
/begin GROUP LmtCod.CCLTrqRamp.Uls_f32 "MICROSAR RTE" /begin REF_MEASUREMENT Rte_LmtCod_CCLTrqRamp_Uls_f32 /end REF_MEASUREMENT /end GROUP
/begin GROUP LmtCod.OutputRampMult.Uls_f32 "MICROSAR RTE" /begin REF_MEASUREMENT Rte_StOpCtrl_OutputRampMult_Uls_f32 /end REF_MEASUREMENT /end GROUP
/begin GROUP LmtCod.ReceiverPorts "MICROSAR RTE"
 /begin SUB_GROUP LmtCod.AssistEOTGain.Uls_f32 LmtCod.AssistEOTLimit.MtrNm_f32 LmtCod.AssistStallLimit.MtrNm_f32 LmtCod.AssistVehSpdLimit.MtrNm_f32 LmtCod.CCLTrqRamp.Uls_f32 LmtCod.OutputRampMult.Uls_f32 LmtCod.ThermalLimit.MtrNm_f32 LmtCod.VehicleSpeed.Kph_f32 /end SUB_GROUP
/end GROUP
/begin GROUP LmtCod.SenderPorts "MICROSAR RTE"
 /begin SUB_GROUP LmtCod.EOTGainLtd.Uls_f32 LmtCod.EOTLimitLtd.MtrNm_f32 LmtCod.OutputRampMultLtd.Uls_f32 LmtCod.StallLimitLtd.MtrNm_f32 LmtCod.ThermalLimitLtd.MtrNm_f32 LmtCod.VehSpdLimitLtd.MtrNm_f32 /end SUB_GROUP
/end GROUP
/begin GROUP LmtCod.ThermalLimit.MtrNm_f32 "MICROSAR RTE" /begin REF_MEASUREMENT Rte_ThrmlDutyCycle_ThermalLimit_MtrNm_f32 /end REF_MEASUREMENT /end GROUP
/begin GROUP LrnEOT "MICROSAR RTE"
 /begin SUB_GROUP LrnEOT.PerInstanceMemories LrnEOT.ReceiverPorts LrnEOT.SenderPorts /end SUB_GROUP
/end GROUP
/begin GROUP LrnEOT.CCWFound.Cnt_lgc "MICROSAR RTE" /begin REF_MEASUREMENT Rte_LrnEOT_CCWFound_Cnt_lgc /end REF_MEASUREMENT /end GROUP
/begin GROUP LrnEOT.CCWPosition.HwDeg_f32 "MICROSAR RTE" /begin REF_MEASUREMENT Rte_LrnEOT_CCWPosition_HwDeg_f32 /end REF_MEASUREMENT /end GROUP
/begin GROUP LrnEOT.CWFound.Cnt_lgc "MICROSAR RTE" /begin REF_MEASUREMENT Rte_LrnEOT_CWFound_Cnt_lgc /end REF_MEASUREMENT /end GROUP
/begin GROUP LrnEOT.CWPosition.HwDeg_f32 "MICROSAR RTE" /begin REF_MEASUREMENT Rte_LrnEOT_CWPosition_HwDeg_f32 /end REF_MEASUREMENT /end GROUP
/begin GROUP LrnEOT.LearnedEOT "MICROSAR RTE"
 /begin REF_MEASUREMENT Rte_LrnEOT_LearnedEOT.CCWEOTFound_Cnt_lgc Rte_LrnEOT_LearnedEOT.CCWEOTPosition_HwDeg_f32 Rte_LrnEOT_LearnedEOT.CWEOTFound_Cnt_lgc Rte_LrnEOT_LearnedEOT.CWEOTPosition_HwDeg_f32 /end REF_MEASUREMENT
/end GROUP
/begin GROUP LrnEOT.PerInstanceMemories "MICROSAR RTE" /begin SUB_GROUP LrnEOT.LearnedEOT /end SUB_GROUP /end GROUP
/begin GROUP LrnEOT.ReceiverPorts "MICROSAR RTE"
 /begin SUB_GROUP LrnEOT.DiagStsHwPosDis.Cnt_lgc LrnEOT.HandwheelAuthority.Uls_f32 LrnEOT.HandwheelPosition.HwDeg_f32 LrnEOT.HwTorque.HwNm_f32 LrnEOT.MtrVelCRF.MtrRadpS_f32 /end SUB_GROUP
/end GROUP
/begin GROUP LrnEOT.SenderPorts "MICROSAR RTE"
 /begin SUB_GROUP LrnEOT.CCWFound.Cnt_lgc LrnEOT.CCWPosition.HwDeg_f32 LrnEOT.CWFound.Cnt_lgc LrnEOT.CWPosition.HwDeg_f32 /end SUB_GROUP
/end GROUP
/begin GROUP MtrDrvDiag "MICROSAR RTE"
 /begin SUB_GROUP MtrDrvDiag.ModeRequirePorts MtrDrvDiag.ReceiverPorts MtrDrvDiag.SenderPorts /end SUB_GROUP
/end GROUP
/begin GROUP MtrDrvDiag.FETFaultPhase.Cnt_enum "MICROSAR RTE" /begin REF_MEASUREMENT Rte_MtrDrvDiag_FETFaultPhase_Cnt_enum /end REF_MEASUREMENT /end GROUP
/begin GROUP MtrDrvDiag.FETFaultType.Cnt_enum "MICROSAR RTE" /begin REF_MEASUREMENT Rte_MtrDrvDiag_FETFaultType_Cnt_enum /end REF_MEASUREMENT /end GROUP
/begin GROUP MtrDrvDiag.GateDriveResetActive.Cnt_lgc "MICROSAR RTE" /begin REF_MEASUREMENT Rte_MtrDrvDiag_GateDriveResetActive_Cnt_lgc /end REF_MEASUREMENT /end GROUP
/begin GROUP MtrDrvDiag.ModeRequirePorts "MICROSAR RTE" /begin SUB_GROUP MtrDrvDiag.SystemState.Mode /end SUB_GROUP /end GROUP
/begin GROUP MtrDrvDiag.MtrDrvrInitComplete.Cnt_lgc "MICROSAR RTE" /begin REF_MEASUREMENT Rte_MtrDrvDiag_MtrDrvrInitComplete_Cnt_lgc /end REF_MEASUREMENT /end GROUP
/begin GROUP MtrDrvDiag.MtrDrvrInitStart.Cnt_lgc "MICROSAR RTE" /begin REF_MEASUREMENT Rte_HwPwUp_MtrDrvrInitStart_Cnt_lgc /end REF_MEASUREMENT /end GROUP
/begin GROUP MtrDrvDiag.ReceiverPorts "MICROSAR RTE" /begin SUB_GROUP MtrDrvDiag.MtrDrvrInitStart.Cnt_lgc /end SUB_GROUP /end GROUP
/begin GROUP MtrDrvDiag.SenderPorts "MICROSAR RTE"
 /begin SUB_GROUP MtrDrvDiag.FETFaultPhase.Cnt_enum MtrDrvDiag.FETFaultType.Cnt_enum MtrDrvDiag.GateDriveResetActive.Cnt_lgc MtrDrvDiag.MtrDrvrInitComplete.Cnt_lgc /end SUB_GROUP
/end GROUP
/begin GROUP MtrTempEst "MICROSAR RTE" /begin SUB_GROUP MtrTempEst.ReceiverPorts MtrTempEst.SenderPorts /end SUB_GROUP /end GROUP
/begin GROUP MtrTempEst.AmbTemp.DegC_f32 "MICROSAR RTE" /begin REF_MEASUREMENT Rte_MtrTempEst_AmbTemp_DegC_f32 /end REF_MEASUREMENT /end GROUP
/begin GROUP MtrTempEst.CuTempEst.DegC_f32 "MICROSAR RTE" /begin REF_MEASUREMENT Rte_MtrTempEst_CuTempEst_DegC_f32 /end REF_MEASUREMENT /end GROUP
/begin GROUP MtrTempEst.EngTemp.DegC_f32 "MICROSAR RTE" /begin REF_MEASUREMENT Rte_MtrTempEst_EngTemp_DegC_f32 /end REF_MEASUREMENT /end GROUP
/begin GROUP MtrTempEst.EstPkCurr.AmpSq_f32 "MICROSAR RTE" /begin REF_MEASUREMENT Rte_PeakCurrEst_EstPkCurr_AmpSq_f32 /end REF_MEASUREMENT /end GROUP
/begin GROUP MtrTempEst.MagTempEst.DegC_f32 "MICROSAR RTE" /begin REF_MEASUREMENT Rte_MtrTempEst_MagTempEst_DegC_f32 /end REF_MEASUREMENT /end GROUP
/begin GROUP MtrTempEst.ReceiverPorts "MICROSAR RTE"
 /begin SUB_GROUP MtrTempEst.AmbTemp.DegC_f32 MtrTempEst.CtrlTempFinal.DegC_f32 MtrTempEst.EngTemp.DegC_f32 MtrTempEst.EstPkCurr.AmpSq_f32 MtrTempEst.HwVel.HwRadpS_f32 MtrTempEst.ScomAMDefeat.Cnt_lgc MtrTempEst.ScomTempDataRcvd.Cnt_lgc /end SUB_GROUP
/end GROUP
/begin GROUP MtrTempEst.ScomAMDefeat.Cnt_lgc "MICROSAR RTE" /begin REF_MEASUREMENT Rte_MtrTempEst_ScomAMDefeat_Cnt_lgc /end REF_MEASUREMENT /end GROUP
/begin GROUP MtrTempEst.ScomTempDataRcvd.Cnt_lgc "MICROSAR RTE" /begin REF_MEASUREMENT Rte_MtrTempEst_ScomTempDataRcvd_Cnt_lgc /end REF_MEASUREMENT /end GROUP
/begin GROUP MtrTempEst.SenderPorts "MICROSAR RTE"
 /begin SUB_GROUP MtrTempEst.AssistMechTempEst.DegC_f32 MtrTempEst.CuTempEst.DegC_f32 MtrTempEst.MagTempEst.DegC_f32 MtrTempEst.SiTempEst.DegC_f32 /end SUB_GROUP
/end GROUP
/begin GROUP MtrTempEst.SiTempEst.DegC_f32 "MICROSAR RTE" /begin REF_MEASUREMENT Rte_MtrTempEst_SiTempEst_DegC_f32 /end REF_MEASUREMENT /end GROUP
/begin GROUP MtrVel "MICROSAR RTE" /begin SUB_GROUP MtrVel.ReceiverPorts MtrVel.SenderPorts /end SUB_GROUP /end GROUP
/begin GROUP MtrVel.HwVelValid.Cnt_lgc "MICROSAR RTE" /begin REF_MEASUREMENT Rte_MtrVel_HwVelValid_Cnt_lgc /end REF_MEASUREMENT /end GROUP
/begin GROUP MtrVel.MechMtrPos2.Rev_u0p16 "MICROSAR RTE" /begin REF_MEASUREMENT Rte_DigMSB_MechMtrPos2_Rev_u0p16 /end REF_MEASUREMENT /end GROUP
/begin GROUP MtrVel.ReceiverPorts "MICROSAR RTE"
 /begin SUB_GROUP MtrVel.AsstAssemblyPolarity.Cnt_s08 MtrVel.MechMtrPos2.Rev_u0p16 MtrVel.MechMtrPos2Timestamp.USec_u32 MtrVel.SysCDiagHwVel.HwRadpS_f32 MtrVel.SysCDiagMtrVelMRF.MtrRadpS_f32 /end SUB_GROUP
/end GROUP
/begin GROUP MtrVel.SenderPorts "MICROSAR RTE"
 /begin SUB_GROUP MtrVel.HandwheelVel.HwRadpS_f32 MtrVel.HwVelValid.Cnt_lgc MtrVel.MotorVelCRF.MtrRadpS_f32 MtrVel.MotorVelMRF.MtrRadpS_f32 MtrVel.SysCHandwheelVel.HwRadpS_f32 MtrVel.SysCMotorVelMRF.MtrRadpS_f32 /end SUB_GROUP
/end GROUP
/begin GROUP MtrVel.SysCDiagHwVel.HwRadpS_f32 "MICROSAR RTE" /begin REF_MEASUREMENT Rte_MtrVel2_SysCDiagHwVel_HwRadpS_f32 /end REF_MEASUREMENT /end GROUP
/begin GROUP MtrVel.SysCDiagMtrVelMRF.MtrRadpS_f32 "MICROSAR RTE" /begin REF_MEASUREMENT Rte_MtrVel2_SysCDiagMtrVelMRF_MtrRadpS_f32 /end REF_MEASUREMENT /end GROUP
/begin GROUP MtrVel.SysCHandwheelVel.HwRadpS_f32 "MICROSAR RTE" /begin REF_MEASUREMENT Rte_MtrVel_SysCHandwheelVel_HwRadpS_f32 /end REF_MEASUREMENT /end GROUP
/begin GROUP MtrVel.SysCMotorVelMRF.MtrRadpS_f32 "MICROSAR RTE" /begin REF_MEASUREMENT Rte_MtrVel_SysCMotorVelMRF_MtrRadpS_f32 /end REF_MEASUREMENT /end GROUP
/begin GROUP MtrVel2 "MICROSAR RTE" /begin SUB_GROUP MtrVel2.ReceiverPorts MtrVel2.SenderPorts /end SUB_GROUP /end GROUP
/begin GROUP MtrVel2.CumMechMtrPosMRF.Deg_f32 "MICROSAR RTE" /begin REF_MEASUREMENT Rte_DigMSB_CumMechMtrPosMRF_Deg_f32 /end REF_MEASUREMENT /end GROUP
/begin GROUP MtrVel2.ReceiverPorts "MICROSAR RTE"
 /begin SUB_GROUP MtrVel2.AsstAssemblyPolarity.Cnt_s08 MtrVel2.CumMechMtrPosMRF.Deg_f32 MtrVel2.HandwheelVel.HwRadpS_f32 MtrVel2.MechMtrPos1Timestamp.USec_u32 MtrVel2.MotorVelMRF.MtrRadpS_f32 /end SUB_GROUP
/end GROUP
/begin GROUP MtrVel2.SenderPorts "MICROSAR RTE"
 /begin SUB_GROUP MtrVel2.SysCDiagHwVel.HwRadpS_f32 MtrVel2.SysCDiagMtrVelMRF.MtrRadpS_f32 /end SUB_GROUP
/end GROUP
/begin GROUP MtrVel2.SysCDiagHwVel.HwRadpS_f32 "MICROSAR RTE" /begin REF_MEASUREMENT Rte_MtrVel2_SysCDiagHwVel_HwRadpS_f32 /end REF_MEASUREMENT /end GROUP
/begin GROUP MtrVel2.SysCDiagMtrVelMRF.MtrRadpS_f32 "MICROSAR RTE" /begin REF_MEASUREMENT Rte_MtrVel2_SysCDiagMtrVelMRF_MtrRadpS_f32 /end REF_MEASUREMENT /end GROUP
/begin GROUP Nhet1 "MICROSAR RTE" /begin SUB_GROUP Nhet1.SenderPorts /end SUB_GROUP /end GROUP
/begin GROUP Nhet1.DigHwTrqT1.HwNm_f32 "MICROSAR RTE" /begin REF_MEASUREMENT Rte_Nhet1_DigHwTrqT1_HwNm_f32 /end REF_MEASUREMENT /end GROUP
/begin GROUP Nhet1.DigHwTrqT2.HwNm_f32 "MICROSAR RTE" /begin REF_MEASUREMENT Rte_Nhet1_DigHwTrqT2_HwNm_f32 /end REF_MEASUREMENT /end GROUP
/begin GROUP Nhet1.SenderPorts "MICROSAR RTE" /begin SUB_GROUP Nhet1.DigHwTrqT1.HwNm_f32 Nhet1.DigHwTrqT2.HwNm_f32 /end SUB_GROUP /end GROUP
/begin GROUP OvrVoltMon "MICROSAR RTE" /begin SUB_GROUP OvrVoltMon.ModeRequirePorts OvrVoltMon.ReceiverPorts /end SUB_GROUP /end GROUP
/begin GROUP OvrVoltMon.ModeRequirePorts "MICROSAR RTE" /begin SUB_GROUP OvrVoltMon.SystemState.Mode /end SUB_GROUP /end GROUP
/begin GROUP OvrVoltMon.ReceiverPorts "MICROSAR RTE" /begin SUB_GROUP OvrVoltMon.PwrDiscBTestStart.Cnt_lgc /end SUB_GROUP /end GROUP
/begin GROUP PeakCurrEst "MICROSAR RTE"
 /begin SUB_GROUP PeakCurrEst.ModeRequirePorts PeakCurrEst.ReceiverPorts PeakCurrEst.SenderPorts /end SUB_GROUP
/end GROUP
/begin GROUP PeakCurrEst.EstPkCurr.AmpSq_f32 "MICROSAR RTE" /begin REF_MEASUREMENT Rte_PeakCurrEst_EstPkCurr_AmpSq_f32 /end REF_MEASUREMENT /end GROUP
/begin GROUP PeakCurrEst.FiltEstPkCurr.AmpSq_f32 "MICROSAR RTE" /begin REF_MEASUREMENT Rte_PeakCurrEst_FiltEstPkCurr_AmpSq_f32 /end REF_MEASUREMENT /end GROUP
/begin GROUP PeakCurrEst.IvtrLoaMtgtnEn.Cnt_lgc "MICROSAR RTE" /begin REF_MEASUREMENT Rte_PeakCurrEst_IvtrLoaMtgtnEn_Cnt_lgc /end REF_MEASUREMENT /end GROUP
/begin GROUP PeakCurrEst.ModeRequirePorts "MICROSAR RTE" /begin SUB_GROUP PeakCurrEst.SystemState.Mode /end SUB_GROUP /end GROUP
/begin GROUP PeakCurrEst.MotCurrLoaMtgtnEn.Cnt_lgc "MICROSAR RTE" /begin REF_MEASUREMENT Rte_PeakCurrEst_MotCurrLoaMtgtnEn_Cnt_lgc /end REF_MEASUREMENT /end GROUP
/begin GROUP PeakCurrEst.MtrCurrDaxRef.Amp_f32 "MICROSAR RTE" /begin REF_MEASUREMENT Rte_CurrCmd_MtrCurrDaxRef_Amp_f32 /end REF_MEASUREMENT /end GROUP
/begin GROUP PeakCurrEst.MtrCurrQaxRef.Amp_f32 "MICROSAR RTE" /begin REF_MEASUREMENT Rte_CurrCmd_MtrCurrQaxRef_Amp_f32 /end REF_MEASUREMENT /end GROUP
/begin GROUP PeakCurrEst.ReceiverPorts "MICROSAR RTE"
 /begin SUB_GROUP PeakCurrEst.IvtrLoaMtgtnEn.Cnt_lgc PeakCurrEst.MotCurrLoaMtgtnEn.Cnt_lgc PeakCurrEst.MtrCurrDax.Amp_f32 PeakCurrEst.MtrCurrDaxRef.Amp_f32 PeakCurrEst.MtrCurrQax.Amp_f32 PeakCurrEst.MtrCurrQaxRef.Amp_f32 /end SUB_GROUP
/end GROUP
/begin GROUP PeakCurrEst.SenderPorts "MICROSAR RTE"
 /begin SUB_GROUP PeakCurrEst.EstPkCurr.AmpSq_f32 PeakCurrEst.FiltEstPkCurr.AmpSq_f32 /end SUB_GROUP
/end GROUP
/begin GROUP PICurrCntrl "MICROSAR RTE"
 /begin SUB_GROUP PICurrCntrl.ModeRequirePorts PICurrCntrl.ReceiverPorts PICurrCntrl.SenderPorts /end SUB_GROUP
/end GROUP
/begin GROUP PICurrCntrl.DervLambdaAlphaDiag.Volt_f32 "MICROSAR RTE" /begin REF_MEASUREMENT Rte_PICurrCntrl_DervLambdaAlphaDiag_Volt_f32 /end REF_MEASUREMENT /end GROUP
/begin GROUP PICurrCntrl.DervLambdaBetaDiag.Volt_f32 "MICROSAR RTE" /begin REF_MEASUREMENT Rte_PICurrCntrl_DervLambdaBetaDiag_Volt_f32 /end REF_MEASUREMENT /end GROUP
/begin GROUP PICurrCntrl.EstKe.VpRadpS_f32 "MICROSAR RTE" /begin REF_MEASUREMENT Rte_CurrParamComp_EstKe_VpRadpS_f32 /end REF_MEASUREMENT /end GROUP
/begin GROUP PICurrCntrl.EstR.Ohm_f32 "MICROSAR RTE" /begin REF_MEASUREMENT Rte_CurrParamComp_EstR_Ohm_f32 /end REF_MEASUREMENT /end GROUP
/begin GROUP PICurrCntrl.ModeRequirePorts "MICROSAR RTE" /begin SUB_GROUP PICurrCntrl.SystemState.Mode /end SUB_GROUP /end GROUP
/begin GROUP PICurrCntrl.MtrCurrDaxRef.Amp_f32 "MICROSAR RTE" /begin REF_MEASUREMENT Rte_CurrCmd_MtrCurrDaxRef_Amp_f32 /end REF_MEASUREMENT /end GROUP
/begin GROUP PICurrCntrl.ReceiverPorts "MICROSAR RTE"
 /begin SUB_GROUP PICurrCntrl.CorrMtrPosElec.Rev_f32 PICurrCntrl.EstKe.VpRadpS_f32 PICurrCntrl.EstR.Ohm_f32 PICurrCntrl.MRFMtrVel.MtrRadpS_f32 PICurrCntrl.MtrCurrDaxRef.Amp_f32 /end SUB_GROUP
/end GROUP
/begin GROUP PICurrCntrl.SenderPorts "MICROSAR RTE"
 /begin SUB_GROUP PICurrCntrl.DervLambdaAlphaDiag.Volt_f32 PICurrCntrl.DervLambdaBetaDiag.Volt_f32 /end SUB_GROUP
/end GROUP
/begin GROUP Polarity "MICROSAR RTE"
 /begin SUB_GROUP Polarity.PerInstanceMemories Polarity.ReceiverPorts Polarity.SenderPorts /end SUB_GROUP
/end GROUP
/begin GROUP Polarity.DiagHwPosPolarity.Cnt_s08 "MICROSAR RTE" /begin REF_MEASUREMENT Rte_Polarity_HwPosPolarity_Cnt_s08 /end REF_MEASUREMENT /end GROUP
/begin GROUP Polarity.DiagHwTrqPolarity.Cnt_s08 "MICROSAR RTE" /begin REF_MEASUREMENT Rte_Polarity_HwTrqPolarity_Cnt_s08 /end REF_MEASUREMENT /end GROUP
/begin GROUP Polarity.DiagMtrVelPolarity.Cnt_s08 "MICROSAR RTE" /begin REF_MEASUREMENT Rte_Polarity_MtrVelPolarity_Cnt_s08 /end REF_MEASUREMENT /end GROUP
/begin GROUP Polarity.HwPosPolarity.Cnt_s08 "MICROSAR RTE" /begin REF_MEASUREMENT Rte_Polarity_HwPosPolarity_Cnt_s08 /end REF_MEASUREMENT /end GROUP
/begin GROUP Polarity.HwTrqPolarity.Cnt_s08 "MICROSAR RTE" /begin REF_MEASUREMENT Rte_Polarity_HwTrqPolarity_Cnt_s08 /end REF_MEASUREMENT /end GROUP
/begin GROUP Polarity.MtrVelPolarity.Cnt_s08 "MICROSAR RTE" /begin REF_MEASUREMENT Rte_Polarity_MtrVelPolarity_Cnt_s08 /end REF_MEASUREMENT /end GROUP
/begin GROUP Polarity.PerInstanceMemories "MICROSAR RTE" /begin SUB_GROUP Polarity.Polarity_Cnt_Str /end SUB_GROUP /end GROUP
/begin GROUP Polarity.Polarity_Cnt_Str "MICROSAR RTE"
 /begin REF_MEASUREMENT Rte_Polarity_Polarity_Cnt_Str.Polarity_Cnt_b08 Rte_Polarity_Polarity_Cnt_Str.R_Polarity_Cnt_b08 /end REF_MEASUREMENT
/end GROUP
/begin GROUP Polarity.ReceiverPorts "MICROSAR RTE"
 /begin SUB_GROUP Polarity.DiagAssistAssyPolarity.Cnt_s08 Polarity.DiagHwPosPolarity.Cnt_s08 Polarity.DiagHwTrqPolarity.Cnt_s08 Polarity.DiagMtrElecMechPolarity.Cnt_s08 Polarity.DiagMtrPosPolarity.Cnt_s08 Polarity.DiagMtrVelPolarity.Cnt_s08 /end SUB_GROUP
/end GROUP
/begin GROUP Polarity.SenderPorts "MICROSAR RTE"
 /begin SUB_GROUP Polarity.AssistAssyPolarity.Cnt_s08 Polarity.HwPosPolarity.Cnt_s08 Polarity.HwTrqPolarity.Cnt_s08 Polarity.MtrElecMechPolarity.Cnt_s08 Polarity.MtrPosPolarity.Cnt_s08 Polarity.MtrVelPolarity.Cnt_s08 Polarity.SysC_MtrElecMechPolarity.Cnt_s32 /end SUB_GROUP
/end GROUP
/begin GROUP Polarity.SysC_MtrElecMechPolarity.Cnt_s32 "MICROSAR RTE" /begin REF_MEASUREMENT Rte_Polarity_SysC_MtrElecMechPolarity_Cnt_s32 /end REF_MEASUREMENT /end GROUP
/begin GROUP PwrLmtFuncCr "MICROSAR RTE"
 /begin SUB_GROUP PwrLmtFuncCr.ModeRequirePorts PwrLmtFuncCr.ReceiverPorts PwrLmtFuncCr.SenderPorts /end SUB_GROUP
/end GROUP
/begin GROUP PwrLmtFuncCr.EstKe.VpRadpS_f32 "MICROSAR RTE" /begin REF_MEASUREMENT Rte_CurrParamComp_EstKe_VpRadpS_f32 /end REF_MEASUREMENT /end GROUP
/begin GROUP PwrLmtFuncCr.ModeRequirePorts "MICROSAR RTE" /begin SUB_GROUP PwrLmtFuncCr.SystemState.Mode /end SUB_GROUP /end GROUP
/begin GROUP PwrLmtFuncCr.MRFMtrTrqCmd.MtrNm_f32 "MICROSAR RTE" /begin REF_MEASUREMENT Rte_PwrLmtFuncCr_MRFMtrTrqCmd_MtrNm_f32 /end REF_MEASUREMENT /end GROUP
/begin GROUP PwrLmtFuncCr.PosServEnable.Cnt_lgc "MICROSAR RTE" /begin REF_MEASUREMENT Rte_PwrLmtFuncCr_PosServEnable_Cnt_lgc /end REF_MEASUREMENT /end GROUP
/begin GROUP PwrLmtFuncCr.ReceiverPorts "MICROSAR RTE"
 /begin SUB_GROUP PwrLmtFuncCr.CntDisMtrTrqCmdMRF.MtrNm_f32 PwrLmtFuncCr.EstKe.VpRadpS_f32 PwrLmtFuncCr.MotorVelMRF.MtrRadpS_f32 PwrLmtFuncCr.PosServEnable.Cnt_lgc PwrLmtFuncCr.Vecu.Volt_f32 /end SUB_GROUP
/end GROUP
/begin GROUP PwrLmtFuncCr.SenderPorts "MICROSAR RTE"
 /begin SUB_GROUP PwrLmtFuncCr.FltTrqLmt.Uls_f32 PwrLmtFuncCr.MRFMtrTrqCmd.MtrNm_f32 PwrLmtFuncCr.ThresholdExceeded.Cnt_lgc /end SUB_GROUP
/end GROUP
/begin GROUP PwrLmtFuncCr.ThresholdExceeded.Cnt_lgc "MICROSAR RTE" /begin REF_MEASUREMENT Rte_PwrLmtFuncCr_ThresholdExceeded_Cnt_lgc /end REF_MEASUREMENT /end GROUP
/begin GROUP QuadDet "MICROSAR RTE" /begin SUB_GROUP QuadDet.ReceiverPorts QuadDet.SenderPorts /end SUB_GROUP /end GROUP
/begin GROUP QuadDet.InstMtrDir.Cnt_s08 "MICROSAR RTE" /begin REF_MEASUREMENT Rte_QuadDet_InstMtrDir_Cnt_s08 /end REF_MEASUREMENT /end GROUP
/begin GROUP QuadDet.MRFCumMtrPos.Deg_f32 "MICROSAR RTE" /begin REF_MEASUREMENT Rte_DigMSB_CumMechMtrPosMRF_Deg_f32 /end REF_MEASUREMENT /end GROUP
/begin GROUP QuadDet.MRFMtrTrqCmdScl.MtrNm_f32 "MICROSAR RTE" /begin REF_MEASUREMENT Rte_TrqCmdScl_MRFMtrTrqCmdScl_MtrNm_f32 /end REF_MEASUREMENT /end GROUP
/begin GROUP QuadDet.MtrQuad.Cnt_u08 "MICROSAR RTE" /begin REF_MEASUREMENT Rte_QuadDet_MtrQuad_Cnt_u08 /end REF_MEASUREMENT /end GROUP
/begin GROUP QuadDet.ReceiverPorts "MICROSAR RTE"
 /begin SUB_GROUP QuadDet.MRFCumMtrPos.Deg_f32 QuadDet.MRFMtrTrqCmdScl.MtrNm_f32 /end SUB_GROUP
/end GROUP
/begin GROUP QuadDet.SenderPorts "MICROSAR RTE" /begin SUB_GROUP QuadDet.InstMtrDir.Cnt_s08 QuadDet.MtrQuad.Cnt_u08 /end SUB_GROUP /end GROUP
/begin GROUP Return "MICROSAR RTE" /begin SUB_GROUP Return.ReceiverPorts Return.SenderPorts /end SUB_GROUP /end GROUP
/begin GROUP Return.PAReturnSclFct.Uls_f32 "MICROSAR RTE" /begin REF_MEASUREMENT Rte_Return_PAReturnSclFct_Uls_f32 /end REF_MEASUREMENT /end GROUP
/begin GROUP Return.ReceiverPorts "MICROSAR RTE"
 /begin SUB_GROUP Return.AssistMechTempEst.DegC_f32 Return.DefeatReturnSvc.Cnt_lgc Return.DiagStsHwPosDis.Cnt_lgc Return.HandwheelAuthority.Uls_f32 Return.HandwheelPosition.HwDeg_f32 Return.HandwheelVel.HwRadpS_f32 Return.HwTorque.HwNm_f32 Return.PAReturnSclFct.Uls_f32 Return.ReturnDDFactor.Uls_f32 Return.ReturnOffset.HwDeg_f32 Return.VehicleSpeed.Kph_f32 /end SUB_GROUP
/end GROUP
/begin GROUP Return.ReturnCmd.MtrNm_f32 "MICROSAR RTE" /begin REF_MEASUREMENT Rte_Return_ReturnCmd_MtrNm_f32 /end REF_MEASUREMENT /end GROUP
/begin GROUP Return.ReturnDDFactor.Uls_f32 "MICROSAR RTE" /begin REF_MEASUREMENT Rte_Return_ReturnDDFactor_Uls_f32 /end REF_MEASUREMENT /end GROUP
/begin GROUP Return.ReturnOffset.HwDeg_f32 "MICROSAR RTE" /begin REF_MEASUREMENT Rte_Return_ReturnOffset_HwDeg_f32 /end REF_MEASUREMENT /end GROUP
/begin GROUP Return.SenderPorts "MICROSAR RTE" /begin SUB_GROUP Return.ReturnCmd.MtrNm_f32 /end SUB_GROUP /end GROUP
/begin GROUP ReturnFirewall "MICROSAR RTE"
 /begin SUB_GROUP ReturnFirewall.ModeRequirePorts ReturnFirewall.ReceiverPorts ReturnFirewall.SenderPorts /end SUB_GROUP
/end GROUP
/begin GROUP ReturnFirewall.ModeRequirePorts "MICROSAR RTE" /begin SUB_GROUP ReturnFirewall.SystemState.Mode /end SUB_GROUP /end GROUP
/begin GROUP ReturnFirewall.ReceiverPorts "MICROSAR RTE"
 /begin SUB_GROUP ReturnFirewall.Defeat_Return_Svc.Cnt_lgc ReturnFirewall.HandwheelPosition.HwDeg_f32 ReturnFirewall.MEC_Counter.Cnt_enum ReturnFirewall.ReturnCmd.MtrNm_f32 ReturnFirewall.VehicleSpeed.Kph_f32 /end SUB_GROUP
/end GROUP
/begin GROUP ReturnFirewall.ReturnCmd.MtrNm_f32 "MICROSAR RTE" /begin REF_MEASUREMENT Rte_Return_ReturnCmd_MtrNm_f32 /end REF_MEASUREMENT /end GROUP
/begin GROUP ReturnFirewall.SenderPorts "MICROSAR RTE" /begin SUB_GROUP ReturnFirewall.LimitedReturn.MtrNm_f32 /end SUB_GROUP /end GROUP
/begin GROUP RTE "MICROSAR RTE" ROOT /begin SUB_GROUP DSR SCIR SWCs /end SUB_GROUP /end GROUP
/begin GROUP RteErrata "MICROSAR RTE" /begin SUB_GROUP RteErrata.ModeRequirePorts /end SUB_GROUP /end GROUP
/begin GROUP RteErrata.ModeRequirePorts "MICROSAR RTE" /begin SUB_GROUP RteErrata.SystemState.Mode /end SUB_GROUP /end GROUP
/begin GROUP RteErrata8 "MICROSAR RTE" /begin SUB_GROUP RteErrata8.ModeRequirePorts /end SUB_GROUP /end GROUP
/begin GROUP RteErrata8.ModeRequirePorts "MICROSAR RTE" /begin SUB_GROUP RteErrata8.SystemState.Mode /end SUB_GROUP /end GROUP
/begin GROUP RteErrata8.SystemState.Mode "MICROSAR RTE" /begin REF_MEASUREMENT Rte_ModeMachine_StaMd8_SystemState8_Mode /end REF_MEASUREMENT /end GROUP
/begin GROUP RteErrata9 "MICROSAR RTE" /begin SUB_GROUP RteErrata9.ModeRequirePorts /end SUB_GROUP /end GROUP
/begin GROUP RteErrata9.ModeRequirePorts "MICROSAR RTE" /begin SUB_GROUP RteErrata9.SystemState.Mode /end SUB_GROUP /end GROUP
/begin GROUP Sa_DigColPs "MICROSAR RTE"
 /begin SUB_GROUP Sa_DigColPs.PerInstanceMemories Sa_DigColPs.ReceiverPorts Sa_DigColPs.SenderPorts /end SUB_GROUP
/end GROUP
/begin GROUP Sa_DigColPs.DigColPsEOL "MICROSAR RTE"
 /begin REF_MEASUREMENT Rte_Sa_DigColPs_DigColPsEOL.ColTrim_Deg_f32 Rte_Sa_DigColPs_DigColPsEOL.R_ColTrim_Cnt_u32 Rte_Sa_DigColPs_DigColPsEOL.R_SpurTrim_Cnt_u32 Rte_Sa_DigColPs_DigColPsEOL.R_TrimCom_Cnt_u16 Rte_Sa_DigColPs_DigColPsEOL.SpurTrim_Deg_f32 Rte_Sa_DigColPs_DigColPsEOL.TrimComp_Cnt_u16 /end REF_MEASUREMENT
/end GROUP
/begin GROUP Sa_DigColPs.PerInstanceMemories "MICROSAR RTE" /begin SUB_GROUP Sa_DigColPs.DigColPsEOL /end SUB_GROUP /end GROUP
/begin GROUP Sa_DigColPs.ReceiverPorts "MICROSAR RTE" /begin SUB_GROUP Sa_DigColPs.MecState.Cnt_enum /end SUB_GROUP /end GROUP
/begin GROUP Sa_DigColPs.SenderPorts "MICROSAR RTE"
 /begin SUB_GROUP Sa_DigColPs.I2CHwAbsPos.HwDeg_f32 Sa_DigColPs.I2CHwAbsPosValid.Cnt_lgc Sa_DigColPs.TrimComp.Cnt_lgc /end SUB_GROUP
/end GROUP
/begin GROUP Sa_DigColPs.TrimComp.Cnt_lgc "MICROSAR RTE" /begin REF_MEASUREMENT Rte_Sa_DigColPs_TrimComp_Cnt_lgc /end REF_MEASUREMENT /end GROUP
/begin GROUP SCIR "Comment"
 /begin REF_MEASUREMENT AbsHwPos_SrlComHwPos_HwDeg_M_f32 BSM1CRCFltAcc_Cnt_M_u16 BSM1MsgCounterFltAcc_Cnt_M_u16 CRCB1_Cnt_M_u8 CityModeSts_Cnt_M_lgc CmdIgnFailStsInternal_Cnt_M_u8 CmdIgnFailSts_Cnt_M_u8 CmdIgnSts_Cnt_M_u8 ESLampFailSts_Cnt_M_u8 EngStartStopSts_Cnt_M_u8 EngSts_Cnt_M_u8 MsgCntB1Prev_Cnt_M_u8 MsgCntB1_Cnt_M_u8 OpModeFailSts_Cnt_M_u8 OpModeSts_Cnt_M_u8 Rte_DigHwTrqSENT_HwTorque_HwNm_f32 Rte_Polarity_HwPosPolarity_Cnt_s08 Rte_TrqCmdScl_MRFMtrTrqCmdScl_MtrNm_f32 Rte_VehPwrMd_ATermActive_Cnt_lgc Rte_VehPwrMd_CTermActive_Cnt_lgc SrlComVehSpd_Kph_M_f32 StartStopSts_Cnt_M_u8 VehSpeedFailSts_Cnt_M_lgc /end REF_MEASUREMENT
/end GROUP
/begin GROUP SignlCondn "MICROSAR RTE" /begin SUB_GROUP SignlCondn.ReceiverPorts SignlCondn.SenderPorts /end SUB_GROUP /end GROUP
/begin GROUP SignlCondn.ReceiverPorts "MICROSAR RTE"
 /begin SUB_GROUP SignlCondn.SrlCom_VehicleLonAccel.KphpS_f32 SignlCondn.SrlComVehSpeed.Kph_f32 /end SUB_GROUP
/end GROUP
/begin GROUP SignlCondn.SenderPorts "MICROSAR RTE"
 /begin SUB_GROUP SignlCondn.Vehicle_LonAccel.KphpS_f32 SignlCondn.VehicleSpeed.Kph_f32 /end SUB_GROUP
/end GROUP
/begin GROUP SignlCondn.SrlCom_VehicleLonAccel.KphpS_f32 "MICROSAR RTE" /begin REF_MEASUREMENT Rte_SignlCondn_SrlCom_VehicleLonAccel_KphpS_f32 /end REF_MEASUREMENT /end GROUP
/begin GROUP SignlCondn.SrlComVehSpeed.Kph_f32 "MICROSAR RTE" /begin REF_MEASUREMENT Rte_SrlComInput_SrlComVehSpd_Kph_f32 /end REF_MEASUREMENT /end GROUP
/begin GROUP SignlCondn.Vehicle_LonAccel.KphpS_f32 "MICROSAR RTE" /begin REF_MEASUREMENT Rte_SignlCondn_Vehicle_LonAccel_KphpS_f32 /end REF_MEASUREMENT /end GROUP
/begin GROUP SrlComInput "MICROSAR RTE"
 /begin SUB_GROUP SrlComInput.ModeRequirePorts SrlComInput.ReceiverPorts SrlComInput.SenderPorts /end SUB_GROUP
/end GROUP
/begin GROUP SrlComInput.DefaultVehSpd.Cnt_lgc "MICROSAR RTE" /begin REF_MEASUREMENT Rte_DiagMgr10_DiagStsDefVehSpd_Cnt_lgc /end REF_MEASUREMENT /end GROUP
/begin GROUP SrlComInput.DesiredTunPers.Cnt_u16 "MICROSAR RTE" /begin REF_MEASUREMENT Rte_SrlComInput_DesiredTunPers_Cnt_u16 /end REF_MEASUREMENT /end GROUP
/begin GROUP SrlComInput.IgnitionPreStart.Cnt_lgc "MICROSAR RTE" /begin REF_MEASUREMENT Rte_DiagSvc_IgnitionPreStart_Cnt_lgc /end REF_MEASUREMENT /end GROUP
/begin GROUP SrlComInput.ModeRequirePorts "MICROSAR RTE" /begin SUB_GROUP SrlComInput.SystemState.Mode /end SUB_GROUP /end GROUP
/begin GROUP SrlComInput.ReceiverPorts "MICROSAR RTE"
 /begin SUB_GROUP SrlComInput.Batt.Volt_f32 SrlComInput.DefaultVehSpd.Cnt_lgc SrlComInput.IgnCnt_Cnt_u16.Cnt_u16 SrlComInput.IgnitionPreStart.Cnt_lgc SrlComInput.MEC.Cnt_enum SrlComInput.RxMsgsSrlComSvcDft.Cnt_lgc /end SUB_GROUP
/end GROUP
/begin GROUP SrlComInput.SenderPorts "MICROSAR RTE"
 /begin SUB_GROUP SrlComInput.DesiredTunPers.Cnt_u16 SrlComInput.SrlComVehSpd.Kph_f32 SrlComInput.VehicleSpeedValid.Cnt_lgc /end SUB_GROUP
/end GROUP
/begin GROUP SrlComInput.SrlComVehSpd.Kph_f32 "MICROSAR RTE" /begin REF_MEASUREMENT Rte_SrlComInput_SrlComVehSpd_Kph_f32 /end REF_MEASUREMENT /end GROUP
/begin GROUP SrlComOutput "MICROSAR RTE" /begin SUB_GROUP SrlComOutput.ModeRequirePorts SrlComOutput.ReceiverPorts /end SUB_GROUP /end GROUP
/begin GROUP SrlComOutput.ModeRequirePorts "MICROSAR RTE" /begin SUB_GROUP SrlComOutput.SystemState.Mode /end SUB_GROUP /end GROUP
/begin GROUP SrlComOutput.ReceiverPorts "MICROSAR RTE"
 /begin SUB_GROUP SrlComOutput.HandwheelAuthority.Uls_f32 SrlComOutput.HandwheelPosition.HwDeg_f32 SrlComOutput.SrlComHwPosStatus.Cnt_u16 SrlComOutput.SrlComHwTrq.HwNm_f32 SrlComOutput.SrlComHwTrqValid.Cnt_lgc SrlComOutput.SupplyCurrent.Amp_f32 /end SUB_GROUP
/end GROUP
/begin GROUP SrlComOutput.SrlComHwTrq.HwNm_f32 "MICROSAR RTE" /begin REF_MEASUREMENT Rte_DigHwTrqSENT_SrlComHwTrq_HwNm_f32 /end REF_MEASUREMENT /end GROUP
/begin GROUP SrlComOutput.SrlComHwTrqValid.Cnt_lgc "MICROSAR RTE" /begin REF_MEASUREMENT Rte_DigHwTrqSENT_SrlComHwTrqValid_Cnt_lgc /end REF_MEASUREMENT /end GROUP
/begin GROUP SrlComOutput.SupplyCurrent.Amp_f32 "MICROSAR RTE" /begin REF_MEASUREMENT Rte_ElePwr_SupplyCurrent_Amp_f32 /end REF_MEASUREMENT /end GROUP
/begin GROUP StabilityComp "MICROSAR RTE" /begin SUB_GROUP StabilityComp.ReceiverPorts StabilityComp.SenderPorts /end SUB_GROUP /end GROUP
/begin GROUP StabilityComp.AssistDDFactor.Uls_f32 "MICROSAR RTE" /begin REF_MEASUREMENT Rte_StabilityComp_AssistDDFactor_Uls_f32 /end REF_MEASUREMENT /end GROUP
/begin GROUP StabilityComp.ReceiverPorts "MICROSAR RTE"
 /begin SUB_GROUP StabilityComp.AssistDDFactor.Uls_f32 StabilityComp.AsstFWActive.Uls_f32 StabilityComp.CombinedAssist.MtrNm_f32 StabilityComp.HwTorque.HwNm_f32 StabilityComp.SysAssistCmd_MtrNm.MtrNm_f32 StabilityComp.VehicleSpeed.Kph_f32 /end SUB_GROUP
/end GROUP
/begin GROUP StabilityComp.SenderPorts "MICROSAR RTE" /begin SUB_GROUP StabilityComp.AssistCmd.MtrNm_f32 /end SUB_GROUP /end GROUP
/begin GROUP StabilityComp.SysAssistCmd_MtrNm.MtrNm_f32 "MICROSAR RTE" /begin REF_MEASUREMENT Rte_StabilityComp2_SysAssistCmd_MtrNm_f32 /end REF_MEASUREMENT /end GROUP
/begin GROUP StabilityComp2 "MICROSAR RTE" /begin SUB_GROUP StabilityComp2.ReceiverPorts StabilityComp2.SenderPorts /end SUB_GROUP /end GROUP
/begin GROUP StabilityComp2.AssistDDFactor.Uls_f32 "MICROSAR RTE" /begin REF_MEASUREMENT Rte_StabilityComp2_AssistDDFactor_Uls_f32 /end REF_MEASUREMENT /end GROUP
/begin GROUP StabilityComp2.ReceiverPorts "MICROSAR RTE"
 /begin SUB_GROUP StabilityComp2.AssistDDFactor.Uls_f32 StabilityComp2.AsstFWActive.Uls_f32 StabilityComp2.CombinedAssist.MtrNm_f32 StabilityComp2.HwTorque.HwNm_f32 StabilityComp2.VehicleSpeed.Kph_f32 /end SUB_GROUP
/end GROUP
/begin GROUP StabilityComp2.SenderPorts "MICROSAR RTE" /begin SUB_GROUP StabilityComp2.SysAssistCmd.MtrNm_f32 /end SUB_GROUP /end GROUP
/begin GROUP StabilityComp2.SysAssistCmd.MtrNm_f32 "MICROSAR RTE" /begin REF_MEASUREMENT Rte_StabilityComp2_SysAssistCmd_MtrNm_f32 /end REF_MEASUREMENT /end GROUP
/begin GROUP StaMd "MICROSAR RTE"
 /begin SUB_GROUP StaMd.ModeProvidePorts StaMd.ModeRequirePorts StaMd.ReceiverPorts StaMd.SenderPorts /end SUB_GROUP
/end GROUP
/begin GROUP StaMd.ATerm.Cnt_lgc "MICROSAR RTE" /begin REF_MEASUREMENT Rte_VehPwrMd_ATermActive_Cnt_lgc /end REF_MEASUREMENT /end GROUP
/begin GROUP StaMd.CTerm.Cnt_lgc "MICROSAR RTE" /begin REF_MEASUREMENT Rte_VehPwrMd_CTermActive_Cnt_lgc /end REF_MEASUREMENT /end GROUP
/begin GROUP StaMd.FTerm.Cnt_lgc "MICROSAR RTE" /begin REF_MEASUREMENT Rte_DiagMgr10_DiagRmpToZeroActive_Cnt_lgc /end REF_MEASUREMENT /end GROUP
/begin GROUP StaMd.InitiatePwrDnFastWrite.Cnt_lgc "MICROSAR RTE" /begin REF_MEASUREMENT Rte_StaMd_InitiatePwrDnFastWrite_Cnt_lgc /end REF_MEASUREMENT /end GROUP
/begin GROUP StaMd.InitiatePwrDnNormalWrite.Cnt_lgc "MICROSAR RTE" /begin REF_MEASUREMENT Rte_StaMd_InitiatePwrDnNormalWrite_Cnt_lgc /end REF_MEASUREMENT /end GROUP
/begin GROUP StaMd.ModeProvidePorts "MICROSAR RTE" /begin SUB_GROUP StaMd.SystemState.Mode /end SUB_GROUP /end GROUP
/begin GROUP StaMd.ModeRequirePorts "MICROSAR RTE" /begin SUB_GROUP StaMd.CurrentSystemState.Mode /end SUB_GROUP /end GROUP
/begin GROUP StaMd.PwrDnFastWriteComplete.Cnt_lgc "MICROSAR RTE" /begin REF_MEASUREMENT Rte_StaMd_PwrDnFastWriteComplete_Cnt_lgc /end REF_MEASUREMENT /end GROUP
/begin GROUP StaMd.RampStatusComplete.Cnt_lgc "MICROSAR RTE" /begin REF_MEASUREMENT Rte_StOpCtrl_RampDwnStatusComplete_Cnt_lgc /end REF_MEASUREMENT /end GROUP
/begin GROUP StaMd.ReceiverPorts "MICROSAR RTE"
 /begin SUB_GROUP StaMd.ATerm.Cnt_lgc StaMd.ControlledDampStatusComplete.Cnt_lgc StaMd.CTerm.Cnt_lgc StaMd.FTerm.Cnt_lgc StaMd.RampStatusComplete.Cnt_lgc StaMd.TMFTestComplete.Cnt_lgc /end SUB_GROUP
/end GROUP
/begin GROUP StaMd.SenderPorts "MICROSAR RTE"
 /begin SUB_GROUP StaMd.InitiatePwrDnFastWrite.Cnt_lgc StaMd.InitiatePwrDnNormalWrite.Cnt_lgc StaMd.PwrDnFastWriteComplete.Cnt_lgc /end SUB_GROUP
/end GROUP
/begin GROUP StaMd.TMFTestComplete.Cnt_lgc "MICROSAR RTE" /begin REF_MEASUREMENT Rte_TmprlMon_TMFTestComplete_Cnt_lgc /end REF_MEASUREMENT /end GROUP
/begin GROUP StaMd8 "MICROSAR RTE" /begin SUB_GROUP StaMd8.ModeProvidePorts StaMd8.ReceiverPorts /end SUB_GROUP /end GROUP
/begin GROUP StaMd8.ATerm.Cnt_lgc "MICROSAR RTE" /begin REF_MEASUREMENT Rte_VehPwrMd_ATermActive_Cnt_lgc /end REF_MEASUREMENT /end GROUP
/begin GROUP StaMd8.CTerm.Cnt_lgc "MICROSAR RTE" /begin REF_MEASUREMENT Rte_VehPwrMd_CTermActive_Cnt_lgc /end REF_MEASUREMENT /end GROUP
/begin GROUP StaMd8.FTerm.Cnt_lgc "MICROSAR RTE" /begin REF_MEASUREMENT Rte_DiagMgr10_DiagRmpToZeroActive_Cnt_lgc /end REF_MEASUREMENT /end GROUP
/begin GROUP StaMd8.ModeProvidePorts "MICROSAR RTE" /begin SUB_GROUP StaMd8.SystemState8.Mode /end SUB_GROUP /end GROUP
/begin GROUP StaMd8.RampStatusComplete.Cnt_lgc "MICROSAR RTE" /begin REF_MEASUREMENT Rte_StOpCtrl_RampDwnStatusComplete_Cnt_lgc /end REF_MEASUREMENT /end GROUP
/begin GROUP StaMd8.ReceiverPorts "MICROSAR RTE"
 /begin SUB_GROUP StaMd8.ATerm.Cnt_lgc StaMd8.ControlledDampStatusComplete.Cnt_lgc StaMd8.CTerm.Cnt_lgc StaMd8.FTerm.Cnt_lgc StaMd8.RampStatusComplete.Cnt_lgc StaMd8.TMFTestComplete.Cnt_lgc /end SUB_GROUP
/end GROUP
/begin GROUP StaMd8.SystemState8.Mode "MICROSAR RTE" /begin REF_MEASUREMENT Rte_ModeMachine_StaMd8_SystemState8_Mode /end REF_MEASUREMENT /end GROUP
/begin GROUP StaMd8.TMFTestComplete.Cnt_lgc "MICROSAR RTE" /begin REF_MEASUREMENT Rte_TmprlMon_TMFTestComplete_Cnt_lgc /end REF_MEASUREMENT /end GROUP
/begin GROUP StaMd9 "MICROSAR RTE" /begin SUB_GROUP StaMd9.ModeProvidePorts /end SUB_GROUP /end GROUP
/begin GROUP StaMd9.ModeProvidePorts "MICROSAR RTE" /begin SUB_GROUP StaMd9.SystemState9.Mode /end SUB_GROUP /end GROUP
/begin GROUP StOpCtrl "MICROSAR RTE" /begin SUB_GROUP StOpCtrl.ReceiverPorts StOpCtrl.SenderPorts /end SUB_GROUP /end GROUP
/begin GROUP StOpCtrl.DiagRampRate.XpmS_f32 "MICROSAR RTE" /begin REF_MEASUREMENT Rte_DiagMgr10_DiagRampRate_XpmS_f32 /end REF_MEASUREMENT /end GROUP
/begin GROUP StOpCtrl.DiagRampValue.Uls_f32 "MICROSAR RTE" /begin REF_MEASUREMENT Rte_DiagMgr10_DiagRampValue_Uls_f32 /end REF_MEASUREMENT /end GROUP
/begin GROUP StOpCtrl.DiagStsDiagRmpActive.Cnt_lgc "MICROSAR RTE" /begin REF_MEASUREMENT Rte_DiagMgr10_DiagRmpToZeroActive_Cnt_lgc /end REF_MEASUREMENT /end GROUP
/begin GROUP StOpCtrl.OperRampRate.XpmS_f32 "MICROSAR RTE" /begin REF_MEASUREMENT Rte_VehPwrMd_OperRampRate_XpmS_f32 /end REF_MEASUREMENT /end GROUP
/begin GROUP StOpCtrl.OperRampValue.Uls_f32 "MICROSAR RTE" /begin REF_MEASUREMENT Rte_VehPwrMd_OperRampValue_Uls_f32 /end REF_MEASUREMENT /end GROUP
/begin GROUP StOpCtrl.OutputRampMult.Uls_f32 "MICROSAR RTE" /begin REF_MEASUREMENT Rte_StOpCtrl_OutputRampMult_Uls_f32 /end REF_MEASUREMENT /end GROUP
/begin GROUP StOpCtrl.RampDwnStatusComplete.Cnt_lgc "MICROSAR RTE" /begin REF_MEASUREMENT Rte_StOpCtrl_RampDwnStatusComplete_Cnt_lgc /end REF_MEASUREMENT /end GROUP
/begin GROUP StOpCtrl.ReceiverPorts "MICROSAR RTE"
 /begin SUB_GROUP StOpCtrl.DiagRampRate.XpmS_f32 StOpCtrl.DiagRampValue.Uls_f32 StOpCtrl.DiagStsDiagRmpActive.Cnt_lgc StOpCtrl.OperRampRate.XpmS_f32 StOpCtrl.OperRampValue.Uls_f32 StOpCtrl.RampSrlComSvcDft.Cnt_lgc /end SUB_GROUP
/end GROUP
/begin GROUP StOpCtrl.SenderPorts "MICROSAR RTE"
 /begin SUB_GROUP StOpCtrl.OutputRampMult.Uls_f32 StOpCtrl.RampDwnStatusComplete.Cnt_lgc /end SUB_GROUP
/end GROUP
/begin GROUP SWCs "MICROSAR RTE"
 /begin SUB_GROUP AbsHwPos ActivePull ApXcp Assist AssistFirewall AstLmt AvgFricLrn BatteryVoltage BkCpPc BVDiag CDDInterface CmMtrCurr ComplErr CtrldDisShtdn CtrlTemp CurrCmd CurrParamComp Damping DampingFirewall DiagMgr10 DiagMgr8 DiagMgr9 DiagSvc DigHwTrqSENT DigMSB DigPhsReasDiag ElePwr EOTActuatorMng ePWM2 EtDmpFw FltInjection FrqDepDmpnInrtCmp Gsod HighFreqAssist HiLoadStall HwPwUp HystComp IoHwAbstractionUsr LmtCod LrnEOT MtrDrvDiag MtrTempEst MtrVel MtrVel2 Nhet1 OvrVoltMon PeakCurrEst PICurrCntrl Polarity PwrLmtFuncCr QuadDet Return ReturnFirewall RteErrata RteErrata8 RteErrata9 Sa_DigColPs SignlCondn SrlComInput SrlComOutput StabilityComp StabilityComp2 StaMd StaMd8 StaMd9 StOpCtrl Sweep Sweep2 ThrmlDutyCycle TmprlMon TqRsDg TrqCanc TrqCmdScl TuningSelAuth VehDyn VehPwrMd VehSpdLmt /end SUB_GROUP
/end GROUP
/begin GROUP Sweep "MICROSAR RTE" /begin SUB_GROUP Sweep.ReceiverPorts Sweep.SenderPorts /end SUB_GROUP /end GROUP
/begin GROUP Sweep.InputHwTrq.HwNm_f32 "MICROSAR RTE" /begin REF_MEASUREMENT Rte_DigHwTrqSENT_HwTorque_HwNm_f32 /end REF_MEASUREMENT /end GROUP
/begin GROUP Sweep.ReceiverPorts "MICROSAR RTE"
 /begin SUB_GROUP Sweep.InputHwTrq.HwNm_f32 Sweep.VehSpd.Kph_f32 Sweep.VehSpdValid.Cnt_lgc /end SUB_GROUP
/end GROUP
/begin GROUP Sweep.SenderPorts "MICROSAR RTE" /begin SUB_GROUP Sweep.OutputHwTrq.HwNm_f32 /end SUB_GROUP /end GROUP
/begin GROUP Sweep2 "MICROSAR RTE" /begin SUB_GROUP Sweep2.ReceiverPorts Sweep2.SenderPorts /end SUB_GROUP /end GROUP
/begin GROUP Sweep2.OutputMtrTrq.MtrNm_f32 "MICROSAR RTE" /begin REF_MEASUREMENT Rte_Sweep2_OutputMtrTrq_MtrNm_f32 /end REF_MEASUREMENT /end GROUP
/begin GROUP Sweep2.ReceiverPorts "MICROSAR RTE" /begin SUB_GROUP Sweep2.InputMtrTrq.MtrNm_f32 /end SUB_GROUP /end GROUP
/begin GROUP Sweep2.SenderPorts "MICROSAR RTE" /begin SUB_GROUP Sweep2.OutputMtrTrq.MtrNm_f32 /end SUB_GROUP /end GROUP
/begin GROUP ThrmlDutyCycle "MICROSAR RTE"
 /begin SUB_GROUP ThrmlDutyCycle.PerInstanceMemories ThrmlDutyCycle.ReceiverPorts ThrmlDutyCycle.SenderPorts /end SUB_GROUP
/end GROUP
/begin GROUP ThrmlDutyCycle.CuTempEst.DegC_f32 "MICROSAR RTE" /begin REF_MEASUREMENT Rte_MtrTempEst_CuTempEst_DegC_f32 /end REF_MEASUREMENT /end GROUP
/begin GROUP ThrmlDutyCycle.FilteredPkCurr.AmpSq_f32 "MICROSAR RTE" /begin REF_MEASUREMENT Rte_PeakCurrEst_FiltEstPkCurr_AmpSq_f32 /end REF_MEASUREMENT /end GROUP
/begin GROUP ThrmlDutyCycle.IgnTimeOff.Cnt_u32 "MICROSAR RTE" /begin REF_MEASUREMENT Rte_ThrmlDutyCycle_IgnTimeOff_Cnt_u32 /end REF_MEASUREMENT /end GROUP
/begin GROUP ThrmlDutyCycle.MagTempEst.DegC_f32 "MICROSAR RTE" /begin REF_MEASUREMENT Rte_MtrTempEst_MagTempEst_DegC_f32 /end REF_MEASUREMENT /end GROUP
/begin GROUP ThrmlDutyCycle.MtrPkCurr.AmpSq_f32 "MICROSAR RTE" /begin REF_MEASUREMENT Rte_PeakCurrEst_EstPkCurr_AmpSq_f32 /end REF_MEASUREMENT /end GROUP
/begin GROUP ThrmlDutyCycle.PerInstanceMemories "MICROSAR RTE" /begin SUB_GROUP ThrmlDutyCycle.ThrmlDutyCycle_FltStVal /end SUB_GROUP /end GROUP
/begin GROUP ThrmlDutyCycle.ReceiverPorts "MICROSAR RTE"
 /begin SUB_GROUP ThrmlDutyCycle.CuTempEst.DegC_f32 ThrmlDutyCycle.DefeatDutySvc.Cnt_lgc ThrmlDutyCycle.FilteredPkCurr.AmpSq_f32 ThrmlDutyCycle.FiltMeasTemp.DegC_f32 ThrmlDutyCycle.IgnTimeOff.Cnt_u32 ThrmlDutyCycle.MagTempEst.DegC_f32 ThrmlDutyCycle.MotorVelCRF.MtrRadpS_f32 ThrmlDutyCycle.MtrPkCurr.AmpSq_f32 ThrmlDutyCycle.SiTempEst.DegC_f32 ThrmlDutyCycle.VehTimeValid.Cnt_lgc /end SUB_GROUP
/end GROUP
/begin GROUP ThrmlDutyCycle.SenderPorts "MICROSAR RTE"
 /begin SUB_GROUP ThrmlDutyCycle.DutyCycleLevel.Uls_f32 ThrmlDutyCycle.ThermalLimit.MtrNm_f32 ThrmlDutyCycle.ThermLimitPerc.Uls_f32 /end SUB_GROUP
/end GROUP
/begin GROUP ThrmlDutyCycle.SiTempEst.DegC_f32 "MICROSAR RTE" /begin REF_MEASUREMENT Rte_MtrTempEst_SiTempEst_DegC_f32 /end REF_MEASUREMENT /end GROUP
/begin GROUP ThrmlDutyCycle.ThermalLimit.MtrNm_f32 "MICROSAR RTE" /begin REF_MEASUREMENT Rte_ThrmlDutyCycle_ThermalLimit_MtrNm_f32 /end REF_MEASUREMENT /end GROUP
/begin GROUP ThrmlDutyCycle.ThrmlDutyCycle_FltStVal "MICROSAR RTE"
 /begin REF_MEASUREMENT Rte_ThrmlDutyCycle_ThrmlDutyCycle_FltStVal.Filt3Val_Cnt_u8 Rte_ThrmlDutyCycle_ThrmlDutyCycle_FltStVal.Filt4Val_Cnt_u8 Rte_ThrmlDutyCycle_ThrmlDutyCycle_FltStVal.Filt5Val_Cnt_u8 Rte_ThrmlDutyCycle_ThrmlDutyCycle_FltStVal.Filt6Val_Cnt_u8 /end REF_MEASUREMENT
/end GROUP
/begin GROUP ThrmlDutyCycle.VehTimeValid.Cnt_lgc "MICROSAR RTE" /begin REF_MEASUREMENT Rte_ThrmlDutyCycle_VehTimeValid_Cnt_lgc /end REF_MEASUREMENT /end GROUP
/begin GROUP TmprlMon "MICROSAR RTE"
 /begin SUB_GROUP TmprlMon.ModeRequirePorts TmprlMon.ReceiverPorts TmprlMon.SenderPorts /end SUB_GROUP
/end GROUP
/begin GROUP TmprlMon.ModeRequirePorts "MICROSAR RTE" /begin SUB_GROUP TmprlMon.SystemState.Mode /end SUB_GROUP /end GROUP
/begin GROUP TmprlMon.ReceiverPorts "MICROSAR RTE" /begin SUB_GROUP TmprlMon.TMFTestStart.Cnt_lgc /end SUB_GROUP /end GROUP
/begin GROUP TmprlMon.SenderPorts "MICROSAR RTE" /begin SUB_GROUP TmprlMon.TMFTestComplete.Cnt_lgc /end SUB_GROUP /end GROUP
/begin GROUP TmprlMon.TMFTestComplete.Cnt_lgc "MICROSAR RTE" /begin REF_MEASUREMENT Rte_TmprlMon_TMFTestComplete_Cnt_lgc /end REF_MEASUREMENT /end GROUP
/begin GROUP TmprlMon.TMFTestStart.Cnt_lgc "MICROSAR RTE" /begin REF_MEASUREMENT Rte_HwPwUp_TMFTestStart_Cnt_lgc /end REF_MEASUREMENT /end GROUP
/begin GROUP TqRsDg "MICROSAR RTE" /begin SUB_GROUP TqRsDg.ModeRequirePorts TqRsDg.ReceiverPorts /end SUB_GROUP /end GROUP
/begin GROUP TqRsDg.DervLambdaAlphaDiag.Volt_f32 "MICROSAR RTE" /begin REF_MEASUREMENT Rte_PICurrCntrl_DervLambdaAlphaDiag_Volt_f32 /end REF_MEASUREMENT /end GROUP
/begin GROUP TqRsDg.DervLambdaBetaDiag.Volt_f32 "MICROSAR RTE" /begin REF_MEASUREMENT Rte_PICurrCntrl_DervLambdaBetaDiag_Volt_f32 /end REF_MEASUREMENT /end GROUP
/begin GROUP TqRsDg.ModeRequirePorts "MICROSAR RTE" /begin SUB_GROUP TqRsDg.SystemState.Mode /end SUB_GROUP /end GROUP
/begin GROUP TqRsDg.OutputRampMult.Uls_f32 "MICROSAR RTE" /begin REF_MEASUREMENT Rte_StOpCtrl_OutputRampMult_Uls_f32 /end REF_MEASUREMENT /end GROUP
/begin GROUP TqRsDg.ReceiverPorts "MICROSAR RTE"
 /begin SUB_GROUP TqRsDg.DervLambdaAlphaDiag.Volt_f32 TqRsDg.DervLambdaBetaDiag.Volt_f32 TqRsDg.OutputRampMult.Uls_f32 TqRsDg.TrqLimitMin.MtrNm_f32 /end SUB_GROUP
/end GROUP
/begin GROUP TrqCanc "MICROSAR RTE" /begin SUB_GROUP TrqCanc.PerInstanceMemories TrqCanc.ReceiverPorts /end SUB_GROUP /end GROUP
/begin GROUP TrqCanc.CogTrqCal "MICROSAR RTE" /begin REF_MEASUREMENT Rte_TrqCanc_CogTrqCal /end REF_MEASUREMENT /end GROUP
/begin GROUP TrqCanc.CogTrqRplComp "MICROSAR RTE" /begin REF_MEASUREMENT Rte_TrqCanc_CogTrqRplComp /end REF_MEASUREMENT /end GROUP
/begin GROUP TrqCanc.EstKe.VpRadpS_f32 "MICROSAR RTE" /begin REF_MEASUREMENT Rte_CurrParamComp_EstKe_VpRadpS_f32 /end REF_MEASUREMENT /end GROUP
/begin GROUP TrqCanc.EstLd.Henry_f32 "MICROSAR RTE" /begin REF_MEASUREMENT Rte_CurrParamComp_EstLd_Henry_f32 /end REF_MEASUREMENT /end GROUP
/begin GROUP TrqCanc.EstLq.Henry_f32 "MICROSAR RTE" /begin REF_MEASUREMENT Rte_CurrParamComp_EstLq_Henry_f32 /end REF_MEASUREMENT /end GROUP
/begin GROUP TrqCanc.MtrCurrDaxRef.Amp_f32 "MICROSAR RTE" /begin REF_MEASUREMENT Rte_CurrCmd_MtrCurrDaxRef_Amp_f32 /end REF_MEASUREMENT /end GROUP
/begin GROUP TrqCanc.MtrCurrQaxRef.Amp_f32 "MICROSAR RTE" /begin REF_MEASUREMENT Rte_CurrCmd_MtrCurrQaxRef_Amp_f32 /end REF_MEASUREMENT /end GROUP
/begin GROUP TrqCanc.MtrTrqCmdMRFScl.MtrNm_f32 "MICROSAR RTE" /begin REF_MEASUREMENT Rte_TrqCmdScl_MRFMtrTrqCmdScl_MtrNm_f32 /end REF_MEASUREMENT /end GROUP
/begin GROUP TrqCanc.PerInstanceMemories "MICROSAR RTE" /begin SUB_GROUP TrqCanc.CogTrqCal TrqCanc.CogTrqRplComp /end SUB_GROUP /end GROUP
/begin GROUP TrqCanc.ReceiverPorts "MICROSAR RTE"
 /begin SUB_GROUP TrqCanc.EstKe.VpRadpS_f32 TrqCanc.EstLd.Henry_f32 TrqCanc.EstLq.Henry_f32 TrqCanc.MRFMtrVel.MtrRadpS_f32 TrqCanc.MtrCurrDaxRef.Amp_f32 TrqCanc.MtrCurrQaxRef.Amp_f32 TrqCanc.MtrTrqCmdMRFScl.MtrNm_f32 /end SUB_GROUP
/end GROUP
/begin GROUP TrqCmdScl "MICROSAR RTE"
 /begin SUB_GROUP TrqCmdScl.PerInstanceMemories TrqCmdScl.ReceiverPorts TrqCmdScl.SenderPorts /end SUB_GROUP
/end GROUP
/begin GROUP TrqCmdScl.MRFMtrTrqCmd.MtrNm_f32 "MICROSAR RTE" /begin REF_MEASUREMENT Rte_PwrLmtFuncCr_MRFMtrTrqCmd_MtrNm_f32 /end REF_MEASUREMENT /end GROUP
/begin GROUP TrqCmdScl.MRFMtrTrqCmdScl.MtrNm_f32 "MICROSAR RTE" /begin REF_MEASUREMENT Rte_TrqCmdScl_MRFMtrTrqCmdScl_MtrNm_f32 /end REF_MEASUREMENT /end GROUP
/begin GROUP TrqCmdScl.PerInstanceMemories "MICROSAR RTE" /begin SUB_GROUP TrqCmdScl.TorqueCmdSF_Uls_f32 /end SUB_GROUP /end GROUP
/begin GROUP TrqCmdScl.ReceiverPorts "MICROSAR RTE" /begin SUB_GROUP TrqCmdScl.MRFMtrTrqCmd.MtrNm_f32 /end SUB_GROUP /end GROUP
/begin GROUP TrqCmdScl.SenderPorts "MICROSAR RTE" /begin SUB_GROUP TrqCmdScl.MRFMtrTrqCmdScl.MtrNm_f32 /end SUB_GROUP /end GROUP
/begin GROUP TrqCmdScl.TorqueCmdSF_Uls_f32 "MICROSAR RTE" /begin REF_MEASUREMENT Rte_TrqCmdScl_TorqueCmdSF_Uls_f32 /end REF_MEASUREMENT /end GROUP
/begin GROUP TuningSelAuth "MICROSAR RTE" /begin SUB_GROUP TuningSelAuth.ReceiverPorts TuningSelAuth.SenderPorts /end SUB_GROUP /end GROUP
/begin GROUP TuningSelAuth.DesiredTunPers.Cnt_u16 "MICROSAR RTE" /begin REF_MEASUREMENT Rte_SrlComInput_DesiredTunPers_Cnt_u16 /end REF_MEASUREMENT /end GROUP
/begin GROUP TuningSelAuth.ReceiverPorts "MICROSAR RTE"
 /begin SUB_GROUP TuningSelAuth.ActiveTunOvrPtrAddr.Cnt_u32 TuningSelAuth.DesiredTunPers.Cnt_u16 TuningSelAuth.DesiredTunSet.Cnt_u16 TuningSelAuth.HwTorque.HwNm_f32 TuningSelAuth.VehicleSpeed.Kph_f32 /end SUB_GROUP
/end GROUP
/begin GROUP TuningSelAuth.SenderPorts "MICROSAR RTE"
 /begin SUB_GROUP TuningSelAuth.ActiveTunPers.Cnt_u16 TuningSelAuth.ActiveTunSet.Cnt_u16 /end SUB_GROUP
/end GROUP
/begin GROUP VehDyn "MICROSAR RTE"
 /begin SUB_GROUP VehDyn.ModeRequirePorts VehDyn.PerInstanceMemories VehDyn.ReceiverPorts VehDyn.SenderPorts /end SUB_GROUP
/end GROUP
/begin GROUP VehDyn.CcwEOT.HwDeg_f32 "MICROSAR RTE" /begin REF_MEASUREMENT Rte_LrnEOT_CCWPosition_HwDeg_f32 /end REF_MEASUREMENT /end GROUP
/begin GROUP VehDyn.CwEOT.HwDeg_f32 "MICROSAR RTE" /begin REF_MEASUREMENT Rte_LrnEOT_CWPosition_HwDeg_f32 /end REF_MEASUREMENT /end GROUP
/begin GROUP VehDyn.ModeRequirePorts "MICROSAR RTE" /begin SUB_GROUP VehDyn.SystemState.Mode /end SUB_GROUP /end GROUP
/begin GROUP VehDyn.MotPosReset "MICROSAR RTE"
 /begin REF_MEASUREMENT Rte_VehDyn_MotPosReset.NVMStoredLastPosValid_Cnt_lgc Rte_VehDyn_MotPosReset.NVMStoredLastPos_HwDeg_f32 /end REF_MEASUREMENT
/end GROUP
/begin GROUP VehDyn.PerInstanceMemories "MICROSAR RTE" /begin SUB_GROUP VehDyn.MotPosReset /end SUB_GROUP /end GROUP
/begin GROUP VehDyn.ReceiverPorts "MICROSAR RTE"
 /begin SUB_GROUP VehDyn.CcwEOT.HwDeg_f32 VehDyn.CwEOT.HwDeg_f32 VehDyn.HandwheelPosition.HwDeg_f32 VehDyn.HwAuth.Uls_f32 VehDyn.HwTorque.HwNm_f32 VehDyn.MechMtrPos1.Rev_f32 VehDyn.MotorVelCRF.MtrRadpS_f32 VehDyn.RelHwPos.HwDeg_f32 VehDyn.TorqueCmdCRF.MtrNm_f32 VehDyn.VehicleSpeed.Kph_f32 VehDyn.VehicleSpeedValid.Cnt_lgc /end SUB_GROUP
/end GROUP
/begin GROUP VehDyn.SenderPorts "MICROSAR RTE"
 /begin SUB_GROUP VehDyn.SensorlessAuthority.Uls_f32 VehDyn.SensorlessHwPos.HwDeg_f32 /end SUB_GROUP
/end GROUP
/begin GROUP VehPwrMd "MICROSAR RTE"
 /begin SUB_GROUP VehPwrMd.ModeRequirePorts VehPwrMd.ReceiverPorts VehPwrMd.SenderPorts /end SUB_GROUP
/end GROUP
/begin GROUP VehPwrMd.ATermActive.Cnt_lgc "MICROSAR RTE" /begin REF_MEASUREMENT Rte_VehPwrMd_ATermActive_Cnt_lgc /end REF_MEASUREMENT /end GROUP
/begin GROUP VehPwrMd.CTermActive.Cnt_lgc "MICROSAR RTE" /begin REF_MEASUREMENT Rte_VehPwrMd_CTermActive_Cnt_lgc /end REF_MEASUREMENT /end GROUP
/begin GROUP VehPwrMd.ModeRequirePorts "MICROSAR RTE" /begin SUB_GROUP VehPwrMd.SystemState.Mode /end SUB_GROUP /end GROUP
/begin GROUP VehPwrMd.OperRampRate.XpmS_f32 "MICROSAR RTE" /begin REF_MEASUREMENT Rte_VehPwrMd_OperRampRate_XpmS_f32 /end REF_MEASUREMENT /end GROUP
/begin GROUP VehPwrMd.OperRampValue.Uls_f32 "MICROSAR RTE" /begin REF_MEASUREMENT Rte_VehPwrMd_OperRampValue_Uls_f32 /end REF_MEASUREMENT /end GROUP
/begin GROUP VehPwrMd.ReceiverPorts "MICROSAR RTE"
 /begin SUB_GROUP VehPwrMd.EngONSrlComSvcDft.Cnt_lgc VehPwrMd.MEC.Cnt_enum VehPwrMd.VehicleSpeed.Kph_f32 VehPwrMd.VehicleSpeedValid.Cnt_lgc /end SUB_GROUP
/end GROUP
/begin GROUP VehPwrMd.SenderPorts "MICROSAR RTE"
 /begin SUB_GROUP VehPwrMd.ATermActive.Cnt_lgc VehPwrMd.CTermActive.Cnt_lgc VehPwrMd.OperRampRate.XpmS_f32 VehPwrMd.OperRampValue.Uls_f32 /end SUB_GROUP
/end GROUP
/begin GROUP VehSpdLmt "MICROSAR RTE" /begin SUB_GROUP VehSpdLmt.ReceiverPorts VehSpdLmt.SenderPorts /end SUB_GROUP /end GROUP
/begin GROUP VehSpdLmt.AstVehSpdLimit.MtrNm_f32 "MICROSAR RTE" /begin REF_MEASUREMENT Rte_VehSpdLmt_AstVehSpdLimit_MtrNm_f32 /end REF_MEASUREMENT /end GROUP
/begin GROUP VehSpdLmt.CCWPosition.HwDeg_f32 "MICROSAR RTE" /begin REF_MEASUREMENT Rte_LrnEOT_CCWPosition_HwDeg_f32 /end REF_MEASUREMENT /end GROUP
/begin GROUP VehSpdLmt.CWPosition.HwDeg_f32 "MICROSAR RTE" /begin REF_MEASUREMENT Rte_LrnEOT_CWPosition_HwDeg_f32 /end REF_MEASUREMENT /end GROUP
/begin GROUP VehSpdLmt.ReceiverPorts "MICROSAR RTE"
 /begin SUB_GROUP VehSpdLmt.CCWPosition.HwDeg_f32 VehSpdLmt.CWPosition.HwDeg_f32 VehSpdLmt.HwPos.HwDeg_f32 VehSpdLmt.HwPosAuth.Uls_f32 VehSpdLmt.VehSpd.Kph_f32 /end SUB_GROUP
/end GROUP
/begin GROUP VehSpdLmt.SenderPorts "MICROSAR RTE" /begin SUB_GROUP VehSpdLmt.AstVehSpdLimit.MtrNm_f32 /end SUB_GROUP /end GROUP
/begin RECORD_LAYOUT __SWORD_Z FNC_VALUES 1 SWORD ROW_DIR DIRECT /end RECORD_LAYOUT
/begin RECORD_LAYOUT __SLONG_Z FNC_VALUES 1 SLONG ROW_DIR DIRECT /end RECORD_LAYOUT
/begin RECORD_LAYOUT __FLOAT32_IEEE_Z FNC_VALUES 1 FLOAT32_IEEE ROW_DIR DIRECT /end RECORD_LAYOUT
/begin RECORD_LAYOUT __FLOAT64_IEEE_Z FNC_VALUES 1 FLOAT64_IEEE ROW_DIR DIRECT /end RECORD_LAYOUT
/begin RECORD_LAYOUT __UBYTE_S FNC_VALUES 1 UBYTE COLUMN_DIR DIRECT /end RECORD_LAYOUT
/begin RECORD_LAYOUT __UWORD_S FNC_VALUES 1 UWORD COLUMN_DIR DIRECT /end RECORD_LAYOUT
/begin RECORD_LAYOUT __ULONG_S FNC_VALUES 1 ULONG COLUMN_DIR DIRECT /end RECORD_LAYOUT
/begin RECORD_LAYOUT __SBYTE_S FNC_VALUES 1 SBYTE COLUMN_DIR DIRECT /end RECORD_LAYOUT
/begin RECORD_LAYOUT __SWORD_S FNC_VALUES 1 SWORD COLUMN_DIR DIRECT /end RECORD_LAYOUT
/begin RECORD_LAYOUT __SLONG_S FNC_VALUES 1 SLONG COLUMN_DIR DIRECT /end RECORD_LAYOUT
/begin RECORD_LAYOUT __FLOAT32_IEEE_S FNC_VALUES 1 FLOAT32_IEEE COLUMN_DIR DIRECT /end RECORD_LAYOUT
/begin RECORD_LAYOUT __FLOAT64_IEEE_S FNC_VALUES 1 FLOAT64_IEEE COLUMN_DIR DIRECT /end RECORD_LAYOUT
/begin RECORD_LAYOUT SSV__UBYTE_S AXIS_PTS_X 1 UBYTE INDEX_INCR DIRECT /end RECORD_LAYOUT
/begin RECORD_LAYOUT SSV__UWORD_S AXIS_PTS_X 1 UWORD INDEX_INCR DIRECT /end RECORD_LAYOUT
/begin RECORD_LAYOUT SSV__ULONG_S AXIS_PTS_X 1 ULONG INDEX_INCR DIRECT /end RECORD_LAYOUT
/begin RECORD_LAYOUT SSV__SBYTE_S AXIS_PTS_X 1 SBYTE INDEX_INCR DIRECT /end RECORD_LAYOUT
/begin RECORD_LAYOUT SSV__SWORD_S AXIS_PTS_X 1 SWORD INDEX_INCR DIRECT /end RECORD_LAYOUT
/begin RECORD_LAYOUT SSV__SLONG_S AXIS_PTS_X 1 SLONG INDEX_INCR DIRECT /end RECORD_LAYOUT
/begin RECORD_LAYOUT SSV__FLOAT32_IEEE_S AXIS_PTS_X 1 FLOAT32_IEEE INDEX_INCR DIRECT /end RECORD_LAYOUT
/begin RECORD_LAYOUT SSV__FLOAT64_IEEE_S AXIS_PTS_X 1 FLOAT64_IEEE INDEX_INCR DIRECT /end RECORD_LAYOUT
/begin RECORD_LAYOUT __A_UINT64_Z FNC_VALUES 1 A_UINT64 ROW_DIR DIRECT /end RECORD_LAYOUT
/begin RECORD_LAYOUT __A_INT64_Z FNC_VALUES 1 A_INT64 ROW_DIR DIRECT /end RECORD_LAYOUT
/begin RECORD_LAYOUT __A_UINT64_S FNC_VALUES 1 A_UINT64 COLUMN_DIR DIRECT /end RECORD_LAYOUT
/begin RECORD_LAYOUT __A_INT64_S FNC_VALUES 1 A_INT64 COLUMN_DIR DIRECT /end RECORD_LAYOUT
/begin RECORD_LAYOUT SSV__A_UINT64_S AXIS_PTS_X 1 A_UINT64 INDEX_INCR DIRECT /end RECORD_LAYOUT
/begin RECORD_LAYOUT SSV__A_INT64_S AXIS_PTS_X 1 A_INT64 INDEX_INCR DIRECT /end RECORD_LAYOUT
/end MODULE
/end PROJECT
